/dts-v1/;

/ {

	__fixups__ {
		accdet = "/fragment@16:target:0";
		auxadc = "/fragment@33:target:0", "/fragment@34/__overlay__:io-channels:0";
		chosen = "/fragment@0:target:0";
		dispsys_config = "/fragment@12:target:0";
		dsi0 = "/fragment@13:target:0";
		dsi_te = "/fragment@57:target:0";
		fpsensor_fp_eint = "/fragment@24:target:0";
		gpio = "/fragment@47:target:0";
		gpio_usage_mapping = "/fragment@46:target:0";
		gps = "/fragment@20:target:0";
		i2c0 = "/fragment@36:target:0", "/fragment@68:target:0", "/fragment@69:target:0";
		i2c1 = "/fragment@37:target:0";
		i2c2 = "/fragment@29:target:0", "/fragment@38:target:0";
		i2c3 = "/fragment@18:target:0", "/fragment@39:target:0";
		i2c4 = "/fragment@30:target:0", "/fragment@40:target:0";
		i2c5 = "/fragment@41:target:0";
		i2c6 = "/fragment@32:target:0", "/fragment@42:target:0", "/fragment@67:target:0";
		i2c7 = "/fragment@43:target:0";
		i2c8 = "/fragment@31:target:0", "/fragment@44:target:0";
		i2c9 = "/fragment@6:target:0", "/fragment@45:target:0";
		irq_nfc = "/fragment@51:target:0";
		irtx_pwm = "/fragment@70:target:0";
		kd_camera_hw1 = "/fragment@27:target:0", "/fragment@28:target:0", "/fragment@61:target:0";
		keypad = "/fragment@63:target:0";
		maxim_ds28e16 = "/fragment@9:target:0";
		md1_sim1_hot_plug_eint = "/fragment@58:target:0";
		md_auxadc = "/fragment@34:target:0";
		mrdump_ext_rst = "/fragment@48:target:0";
		msdc1_ins = "/fragment@50:target:0";
		mt6360_ldo = "/fragment@1:target:0";
		mt6360_pmic = "/fragment@3:target:0";
		mt6360_pmu = "/fragment@2:target:0";
		mt6360_typec = "/fragment@4:target:0";
		mt_pmic_vcamio_ldo_reg = "/fragment@27/__overlay__:cam1_vcamio-supply:0", "/fragment@27/__overlay__:cam2_vcamio-supply:0", "/fragment@27/__overlay__:cam4_vcamio-supply:0", "/fragment@59:target:0";
		mt_pmic_vcn13_ldo_reg = "/fragment@13/__overlay__/panel1@0:lcd_dvdd-supply:0", "/fragment@13/__overlay__/panel2@0:lcd_dvdd-supply:0", "/fragment@13/__overlay__/panel3@0:lcd_dvdd-supply:0";
		mt_pmic_vfp_ldo_reg = "/fragment@23/__overlay__/fpc_spi@0:vfp-supply:0";
		mt_pmic_vtp_ldo_reg = "/fragment@27/__overlay__:cam0_vcamio-supply:0", "/fragment@60:target:0", "/fragment@62/__overlay__:vtouch-supply:0";
		mtkfb = "/fragment@11:target:0";
		odm = "/fragment@17:target:0", "/fragment@65:target:0";
		onewire_gpio = "/fragment@8:target:0";
		pio = "/fragment@2/__overlay__:mt6360,intr_gpio:0", "/fragment@4/__overlay__:mt6360pd,intr_gpio:0", "/fragment@5:target:0", "/fragment@6/__overlay__/aw8697_haptic@5a:reset-gpio:0", "/fragment@6/__overlay__/aw8697_haptic@5a:irq-gpio:0", "/fragment@7:target:0", "/fragment@8/__overlay__:xiaomi,ow_gpio:0", "/fragment@10:target:0", "/fragment@13/__overlay__/panel1@0:pm-enable-gpios:0", "/fragment@13/__overlay__/panel1@0:lcm-bl-enable-gpios:0", "/fragment@13/__overlay__/panel1@0:reset-gpios:0", "/fragment@13/__overlay__/panel1@0:bias-gpios:0", "/fragment@13/__overlay__/panel1@0:bias-gpios:12", "/fragment@13/__overlay__/panel2@0:pm-enable-gpios:0", "/fragment@13/__overlay__/panel2@0:lcm-bl-enable-gpios:0", "/fragment@13/__overlay__/panel2@0:reset-gpios:0", "/fragment@13/__overlay__/panel2@0:bias-gpios:0", "/fragment@13/__overlay__/panel2@0:bias-gpios:12", "/fragment@13/__overlay__/panel3@0:pm-enable-gpios:0", "/fragment@13/__overlay__/panel3@0:lcm-bl-enable-gpios:0", "/fragment@13/__overlay__/panel3@0:reset-gpios:0", "/fragment@13/__overlay__/panel3@0:bias-gpios:0", "/fragment@13/__overlay__/panel3@0:bias-gpios:12", "/fragment@14/__overlay__/novatek@0:novatek,reset-gpio:0", "/fragment@14/__overlay__/novatek@0:novatek,irq-gpio:0", "/fragment@15:target:0", "/fragment@18/__overlay__/st21nfc@8:gpio-rst-std:0", "/fragment@18/__overlay__/st21nfc@8:gpio-irq-std:0", "/fragment@19:target:0", "/fragment@21:target:0", "/fragment@22:target:0", "/fragment@24/__overlay__:interrupt-parent:0", "/fragment@24/__overlay__:int-gpios:0", "/fragment@26:target:0", "/fragment@32/__overlay__/wl2866d@28:en-gpio:0", "/fragment@46/__overlay__:GPIO_FDD_BAND_SUPPORT_DETECT_1ST_PIN:0", "/fragment@46/__overlay__:GPIO_FDD_BAND_SUPPORT_DETECT_2ND_PIN:0", "/fragment@46/__overlay__:GPIO_FDD_BAND_SUPPORT_DETECT_3RD_PIN:0", "/fragment@46/__overlay__:GPIO_FDD_BAND_SUPPORT_DETECT_4TH_PIN:0", "/fragment@46/__overlay__:GPIO_FDD_BAND_SUPPORT_DETECT_5TH_PIN:0", "/fragment@46/__overlay__:GPIO_SIM1_HOT_PLUG:0", "/fragment@46/__overlay__:GPIO_SIM2_HOT_PLUG:0", "/fragment@46/__overlay__:GPIO_SIM2_SCLK:0", "/fragment@46/__overlay__:GPIO_SIM2_SRST:0", "/fragment@46/__overlay__:GPIO_SIM2_SIO:0", "/fragment@46/__overlay__:GPIO_SIM1_SIO:0", "/fragment@46/__overlay__:GPIO_SIM1_SRST:0", "/fragment@46/__overlay__:GPIO_SIM1_SCLK:0", "/fragment@46/__overlay__:GPIO_RF_PWREN_RST_PIN:0", "/fragment@48/__overlay__:interrupt-parent:0", "/fragment@48/__overlay__:deb-gpios:0", "/fragment@49/__overlay__:interrupt-parent:0", "/fragment@49/__overlay__:deb-gpios:0", "/fragment@50/__overlay__:interrupt-parent:0", "/fragment@51/__overlay__:interrupt-parent:0", "/fragment@52/__overlay__:interrupt-parent:0", "/fragment@53/__overlay__:interrupt-parent:0", "/fragment@54/__overlay__:interrupt-parent:0", "/fragment@54/__overlay__:deb-gpios:0", "/fragment@55/__overlay__:interrupt-parent:0", "/fragment@55/__overlay__:deb-gpios:0", "/fragment@56/__overlay__:interrupt-parent:0", "/fragment@56/__overlay__:deb-gpios:0", "/fragment@57/__overlay__:interrupt-parent:0", "/fragment@64:target:0", "/fragment@65/__overlay__/sia81xx@L:si,sia81xx_reset:0", "/fragment@65/__overlay__/sia81xx@L:si,sia81xx_owi:0", "/fragment@68/__overlay__/sc8551-charger@66:sc,sc8551,interrupt_gpios:0", "/fragment@71:target:0";
		pmic_clock_buffer_ctrl = "/fragment@35:target:0";
		sound = "/fragment@66:target:0";
		spi1 = "/fragment@14:target:0";
		spi5 = "/fragment@23:target:0";
		subpmic_pmu_eint = "/fragment@52:target:0";
		swtp = "/fragment@56:target:0";
		swtp_1 = "/fragment@55:target:0";
		swtp_2 = "/fragment@49:target:0";
		swtp_3 = "/fragment@54:target:0";
		touch = "/fragment@53:target:0", "/fragment@62:target:0";
		ufshci = "/fragment@25:target:0";
	};

	__local_fixups__ {

		fragment@11 {

			__overlay__ {
				pinctrl-0 = <0x0>;
				pinctrl-1 = <0x0>;
				pinctrl-2 = <0x0>;
				pinctrl-3 = <0x0>;
				pinctrl-4 = <0x0>;
				pinctrl-5 = <0x0>;
				pinctrl-6 = <0x0>;
			};
		};

		fragment@12 {

			__overlay__ {
				pinctrl-0 = <0x0>;
				pinctrl-1 = <0x0>;
				pinctrl-2 = <0x0>;
			};
		};

		fragment@13 {

			__overlay__ {

				panel1@0 {

					port {

						endpoint {
							remote-endpoint = <0x0>;
						};
					};
				};

				panel2@0 {

					port {

						endpoint {
							remote-endpoint = <0x0>;
						};
					};
				};

				panel3@0 {

					port {

						endpoint {
							remote-endpoint = <0x0>;
						};
					};
				};

				ports {

					port {

						endpoint {
							remote-endpoint = <0x0>;
						};
					};
				};
			};
		};

		fragment@14 {

			__overlay__ {
				pinctrl-0 = <0x0>;
				pinctrl-1 = <0x0>;

				novatek@0 {
					panel1 = <0x0>;
					panel2 = <0x0>;
				};
			};
		};

		fragment@20 {

			__overlay__ {
				pinctrl-0 = <0x0>;
				pinctrl-1 = <0x0>;
				pinctrl-2 = <0x0>;
				pinctrl-3 = <0x0>;
				pinctrl-4 = <0x0>;
				pinctrl-5 = <0x0>;
				pinctrl-6 = <0x0>;
			};
		};

		fragment@23 {

			__overlay__ {

				fpc_spi@0 {
					pinctrl-0 = <0x0>;
					pinctrl-1 = <0x0>;
				};
			};
		};

		fragment@24 {

			__overlay__ {
				pinctrl-0 = <0x0>;
				pinctrl-1 = <0x0>;
			};
		};

		fragment@27 {

			__overlay__ {
				cam0_vcama-supply = <0x0>;
				cam0_vcamd-supply = <0x0>;
				cam1_vcama-supply = <0x0>;
				cam1_vcamd-supply = <0x0>;
				cam2_vcama-supply = <0x0>;
				cam2_vcamd-supply = <0x0>;
				cam4_vcama-supply = <0x0>;
				pinctrl-0 = <0x0>;
				pinctrl-1 = <0x0>;
				pinctrl-10 = <0x0>;
				pinctrl-11 = <0x0>;
				pinctrl-12 = <0x0>;
				pinctrl-13 = <0x0>;
				pinctrl-14 = <0x0>;
				pinctrl-15 = <0x0>;
				pinctrl-16 = <0x0>;
				pinctrl-17 = <0x0>;
				pinctrl-18 = <0x0>;
				pinctrl-19 = <0x0>;
				pinctrl-2 = <0x0>;
				pinctrl-20 = <0x0>;
				pinctrl-21 = <0x0>;
				pinctrl-22 = <0x0>;
				pinctrl-23 = <0x0>;
				pinctrl-24 = <0x0>;
				pinctrl-25 = <0x0>;
				pinctrl-26 = <0x0>;
				pinctrl-27 = <0x0>;
				pinctrl-28 = <0x0>;
				pinctrl-29 = <0x0>;
				pinctrl-3 = <0x0>;
				pinctrl-30 = <0x0>;
				pinctrl-31 = <0x0>;
				pinctrl-32 = <0x0>;
				pinctrl-33 = <0x0>;
				pinctrl-34 = <0x0>;
				pinctrl-4 = <0x0>;
				pinctrl-5 = <0x0>;
				pinctrl-6 = <0x0>;
				pinctrl-7 = <0x0>;
				pinctrl-8 = <0x0>;
				pinctrl-9 = <0x0>;
			};
		};

		fragment@6 {

			__overlay__ {

				aw8697_haptic@5a {
					pinctrl-0 = <0x0>;
					pinctrl-1 = <0x0>;
					pinctrl-2 = <0x0>;
				};
			};
		};

		fragment@65 {

			__overlay__ {

				sia81xx@L {
					pinctrl-0 = <0x0>;
				};
			};
		};

		fragment@66 {

			__overlay__ {
				si,sia81xx-aux-devs = <0x0 0x4>;
			};
		};

		fragment@67 {

			__overlay__ {

				sia81xx_i2c@L {
					si,sia81xx-dev = <0x0>;
				};

				sia81xx_i2c@R {
					si,sia81xx-dev = <0x0>;
				};
			};
		};

		fragment@70 {

			__overlay__ {
				pinctrl-0 = <0x0>;
				pinctrl-1 = <0x0>;
			};
		};

		fragment@8 {

			__overlay__ {
				pinctrl-0 = <0x0>;
				pinctrl-1 = <0x0>;
			};
		};
	};

	__symbols__ {
		awinic_interrupt = "/fragment@5/__overlay__/awinic_interrupt_high";
		awinic_reset_high = "/fragment@5/__overlay__/awinic_reset_high";
		awinic_reset_low = "/fragment@5/__overlay__/awinic_reset_low";
		camera_main_af_mtk = "/fragment@38/__overlay__/camera_main_af@18";
		camera_main_mtk = "/fragment@38/__overlay__/camera_main@5a";
		camera_main_three_mtk = "/fragment@44/__overlay__/camera_main_three@7d";
		camera_main_two_mtk = "/fragment@40/__overlay__/camera_main_two@2b";
		camera_pins_cam0_mclk_2ma = "/fragment@26/__overlay__/camera_pins_cam0_mclk_2ma";
		camera_pins_cam0_mclk_4ma = "/fragment@26/__overlay__/camera_pins_cam0_mclk_4ma";
		camera_pins_cam0_mclk_6ma = "/fragment@26/__overlay__/camera_pins_cam0_mclk_6ma";
		camera_pins_cam0_mclk_8ma = "/fragment@26/__overlay__/camera_pins_cam0_mclk_8ma";
		camera_pins_cam0_mclk_off = "/fragment@26/__overlay__/camera_pins_cam0_mclk_off";
		camera_pins_cam0_rst_0 = "/fragment@26/__overlay__/cam0@0";
		camera_pins_cam0_rst_1 = "/fragment@26/__overlay__/cam0@1";
		camera_pins_cam1_dvdd_off = "/fragment@26/__overlay__/ldo_vcamd@0";
		camera_pins_cam1_dvdd_on = "/fragment@26/__overlay__/ldo_vcamd@1";
		camera_pins_cam1_mclk_2ma = "/fragment@26/__overlay__/camera_pins_cam1_mclk_2ma";
		camera_pins_cam1_mclk_4ma = "/fragment@26/__overlay__/camera_pins_cam1_mclk_4ma";
		camera_pins_cam1_mclk_6ma = "/fragment@26/__overlay__/camera_pins_cam1_mclk_6ma";
		camera_pins_cam1_mclk_8ma = "/fragment@26/__overlay__/camera_pins_cam1_mclk_8ma";
		camera_pins_cam1_mclk_off = "/fragment@26/__overlay__/camera_pins_cam1_mclk_off";
		camera_pins_cam1_rst_0 = "/fragment@26/__overlay__/cam1@0";
		camera_pins_cam1_rst_1 = "/fragment@26/__overlay__/cam1@1";
		camera_pins_cam2_dvdd_off = "/fragment@26/__overlay__/ldo_vcamd2@0";
		camera_pins_cam2_dvdd_on = "/fragment@26/__overlay__/ldo_vcamd2@1";
		camera_pins_cam2_mclk_2ma = "/fragment@26/__overlay__/camera_pins_cam2_mclk_2ma";
		camera_pins_cam2_mclk_4ma = "/fragment@26/__overlay__/camera_pins_cam2_mclk_4ma";
		camera_pins_cam2_mclk_6ma = "/fragment@26/__overlay__/camera_pins_cam2_mclk_6ma";
		camera_pins_cam2_mclk_8ma = "/fragment@26/__overlay__/camera_pins_cam2_mclk_8ma";
		camera_pins_cam2_mclk_off = "/fragment@26/__overlay__/camera_pins_cam2_mclk_off";
		camera_pins_cam2_rst_0 = "/fragment@26/__overlay__/cam2@0";
		camera_pins_cam2_rst_1 = "/fragment@26/__overlay__/cam2@1";
		camera_pins_cam4_mclk_2ma = "/fragment@26/__overlay__/camera_pins_cam4_mclk_2ma";
		camera_pins_cam4_mclk_4ma = "/fragment@26/__overlay__/camera_pins_cam4_mclk_4ma";
		camera_pins_cam4_mclk_6ma = "/fragment@26/__overlay__/camera_pins_cam4_mclk_6ma";
		camera_pins_cam4_mclk_8ma = "/fragment@26/__overlay__/camera_pins_cam4_mclk_8ma";
		camera_pins_cam4_mclk_off = "/fragment@26/__overlay__/camera_pins_cam4_mclk_off";
		camera_pins_cam4_rst_0 = "/fragment@26/__overlay__/cam4@0";
		camera_pins_cam4_rst_1 = "/fragment@26/__overlay__/cam4@1";
		camera_pins_cam_mipi_switch_sel_0 = "/fragment@26/__overlay__/mipi_sel@0";
		camera_pins_cam_mipi_switch_sel_1 = "/fragment@26/__overlay__/mipi_sel@1";
		camera_pins_default = "/fragment@26/__overlay__/camdefault";
		camera_sub_mtk = "/fragment@40/__overlay__/camera_sub@12";
		camera_sub_two_mtk = "/fragment@44/__overlay__/camera_sub_two@71";
		ctp_nt36672c_pins_default = "/fragment@15/__overlay__/pins_default";
		ctp_nt36672c_spi_mode = "/fragment@15/__overlay__/spimode_default";
		dsi_out = "/fragment@13/__overlay__/ports/port/endpoint";
		fpsensor_fpc_rst_high = "/fragment@21/__overlay__/fpsensor_fpc_rst_high";
		fpsensor_fpc_rst_low = "/fragment@21/__overlay__/fpsensor_fpc_rst_low";
		fpsensor_goodix_rst_high = "/fragment@22/__overlay__/fpsensor_goodix_rst_high";
		fpsensor_goodix_rst_low = "/fragment@22/__overlay__/fpsensor_goodix_rst_low";
		gps_l1_lna_pins_dsp_ctrl = "/fragment@19/__overlay__/gps_l1_lna@1";
		gps_l1_lna_pins_oh = "/fragment@19/__overlay__/gps_l1_lna@2";
		gps_l1_lna_pins_ol = "/fragment@19/__overlay__/gps_l1_lna@0";
		gps_l5_lna_pins_dsp_ctrl = "/fragment@19/__overlay__/gps_l5_lna@1";
		gps_l5_lna_pins_oh = "/fragment@19/__overlay__/gps_l5_lna@2";
		gps_l5_lna_pins_ol = "/fragment@19/__overlay__/gps_l5_lna@0";
		gps_pins_default = "/fragment@19/__overlay__/gps_default";
		i2c_lcd_bias_mtk = "/fragment@42/__overlay__/i2c_lcd_bias@11";
		irtx_gpio_led_default = "/fragment@71/__overlay__/irtx_gpio_led_def@gpio139";
		irtx_gpio_led_set = "/fragment@71/__overlay__/irtx_gpio_led_set@gpio139";
		led0 = "/fragment@17/__overlay__/led@0";
		led1 = "/fragment@17/__overlay__/led@1";
		led2 = "/fragment@17/__overlay__/led@2";
		led3 = "/fragment@17/__overlay__/led@3";
		led4 = "/fragment@17/__overlay__/led@4";
		led5 = "/fragment@17/__overlay__/led@5";
		led6 = "/fragment@17/__overlay__/led@6";
		mtk_camera_eeprom0 = "/fragment@29/__overlay__/camera_eeprom0@50";
		mtk_camera_eeprom1 = "/fragment@30/__overlay__/camera_eeprom1@51";
		mtk_camera_eeprom2 = "/fragment@30/__overlay__/camera_eeprom2@50";
		mtk_camera_eeprom4 = "/fragment@31/__overlay__/camera_eeprom4@51";
		mtkfb_pins_lcd_bias_enn0 = "/fragment@10/__overlay__/lcd_bias_enn0_gpio";
		mtkfb_pins_lcd_bias_enn1 = "/fragment@10/__overlay__/lcd_bias_enn1_gpio";
		mtkfb_pins_lcd_bias_enp0 = "/fragment@10/__overlay__/lcd_bias_enp0_gpio";
		mtkfb_pins_lcd_bias_enp1 = "/fragment@10/__overlay__/lcd_bias_enp1_gpio";
		mtkfb_pins_lcm_dsi_te = "/fragment@10/__overlay__/lcm_dsi_te";
		mtkfb_pins_lcm_rst_out0_gpio = "/fragment@10/__overlay__/lcm_rst_out0_gpio";
		mtkfb_pins_lcm_rst_out1_gpio = "/fragment@10/__overlay__/lcm_rst_out1_gpio";
		nfc_mtk = "/fragment@39/__overlay__/nfc@08";
		onewire_gpio_active = "/fragment@7/__overlay__/onewire_gpio_active@gpio53";
		onewire_gpio_sleep = "/fragment@7/__overlay__/onewire_gpio_sleep@gpio53";
		panel1 = "/fragment@13/__overlay__/panel1@0";
		panel2 = "/fragment@13/__overlay__/panel2@0";
		panel3 = "/fragment@13/__overlay__/panel3@0";
		panel_in1 = "/fragment@13/__overlay__/panel1@0/port/endpoint";
		panel_in2 = "/fragment@13/__overlay__/panel2@0/port/endpoint";
		panel_in4 = "/fragment@13/__overlay__/panel3@0/port/endpoint";
		sia81xx_L = "/fragment@65/__overlay__/sia81xx@L";
		sia81xx_R = "/fragment@65/__overlay__/sia81xx@R";
		sia81xx_gpio_L = "/fragment@64/__overlay__/sia81xx_gpio_L";
		sia81xx_i2c_L = "/fragment@67/__overlay__/sia81xx_i2c@L";
		sia81xx_i2c_R = "/fragment@67/__overlay__/sia81xx_i2c@R";
		st21nfc = "/fragment@18/__overlay__/st21nfc@8";
		subpmic_ldo_mtk = "/fragment@41/__overlay__/subpmic_ldo@64";
		subpmic_mtk = "/fragment@41/__overlay__/subpmic@34";
		subpmic_pmic_mtk = "/fragment@41/__overlay__/subpmic_pmic@1a";
		usb_type_c_mtk = "/fragment@41/__overlay__/usb_type_c@4e";
		vibrator0 = "/fragment@17/__overlay__/vibrator@0";
		wl2866d = "/fragment@32/__overlay__/wl2866d@28";
		wl2866d_avdd1 = "/fragment@32/__overlay__/wl2866d@28/wl2866d_avdd1@2";
		wl2866d_avdd2 = "/fragment@32/__overlay__/wl2866d@28/wl2866d_avdd2@3";
		wl2866d_dvdd1 = "/fragment@32/__overlay__/wl2866d@28/wl2866d_dvdd1@0";
		wl2866d_dvdd2 = "/fragment@32/__overlay__/wl2866d@28/wl2866d_dvdd2@1";
	};

	fragment@0 {
		target = <0xffffffff>;

		__overlay__ {
			atag,videolfb-fb_base_h = <0x0>;
			atag,videolfb-fb_base_l = "~`P";
			atag,videolfb-fps = <0x1770>;
			atag,videolfb-islcm_inited = <0x0>;
			atag,videolfb-islcmfound = <0x1>;
			atag,videolfb-lcmname = "nt35595_fhd_dsi_cmd_truly_nt50358_drv";
			atag,videolfb-vramSize = <0x1be0000>;
		};
	};

	fragment@1 {
		target = <0xffffffff>;

		__overlay__ {
			sdcard_det_en = <0x1>;
			sdcard_hlact = <0x0>;
		};
	};

	fragment@10 {
		target = <0xffffffff>;

		__overlay__ {

			lcd_bias_enn0_gpio {
				phandle = <0x9>;

				pins_cmd_dat {
					output-low;
					pinmux = <0x8a00>;
					slew-rate = <0x1>;
				};
			};

			lcd_bias_enn1_gpio {
				phandle = <0x8>;

				pins_cmd_dat {
					output-high;
					pinmux = <0x8a00>;
					slew-rate = <0x1>;
				};
			};

			lcd_bias_enp0_gpio {
				phandle = <0x7>;

				pins_cmd_dat {
					output-low;
					pinmux = <0x8900>;
					slew-rate = <0x1>;
				};
			};

			lcd_bias_enp1_gpio {
				phandle = <0x6>;

				pins_cmd_dat {
					output-high;
					pinmux = <0x8900>;
					slew-rate = <0x1>;
				};
			};

			lcm_dsi_te {
				phandle = <0xc>;

				pins_cmd_dat {
					pinmux = <0x5401>;
				};
			};

			lcm_rst_out0_gpio {
				phandle = <0xb>;

				pins_cmd_dat {
					output-low;
					pinmux = <0x5600>;
					slew-rate = <0x1>;
				};
			};

			lcm_rst_out1_gpio {
				phandle = <0xa>;

				pins_cmd_dat {
					output-high;
					pinmux = <0x5600>;
					slew-rate = <0x1>;
				};
			};
		};
	};

	fragment@11 {
		target = <0xffffffff>;

		__overlay__ {
			pinctrl-0 = <0x6>;
			pinctrl-1 = <0x7>;
			pinctrl-2 = <0x8>;
			pinctrl-3 = <0x9>;
			pinctrl-4 = <0xa>;
			pinctrl-5 = <0xb>;
			pinctrl-6 = <0xc>;
			pinctrl-names = "lcd_bias_enp1_gpio", "lcd_bias_enp0_gpio", "lcd_bias_enn1_gpio", "lcd_bias_enn0_gpio", "lcm_rst_out1_gpio", "lcm_rst_out0_gpio", "mode_te_te";
			status = "okay";
		};
	};

	fragment@12 {
		target = <0xffffffff>;

		__overlay__ {
			pinctrl-0 = <0xa>;
			pinctrl-1 = <0xb>;
			pinctrl-2 = <0xc>;
			pinctrl-names = "lcm_rst_out1_gpio", "lcm_rst_out0_gpio", "mode_te_te";
			status = "okay";
		};
	};

	fragment@13 {
		target = <0xffffffff>;

		__overlay__ {
			#address-cells = <0x1>;
			#size-cells = <0x0>;
			status = "okay";

			panel1@0 {
				bias-gpios = <0xffffffff 0x89 0x0 0xffffffff 0x8a 0x0>;
				compatible = "k16a_36_02_0a_vdo,lcm";
				lcd_dvdd-supply = <0xffffffff>;
				lcm-bl-enable-gpios = <0xffffffff 0x57 0x0>;
				phandle = <0x11>;
				pinctrl-names = "default";
				pm-enable-gpios = <0xffffffff 0x88 0x0>;
				reg = <0x0>;
				reset-gpios = <0xffffffff 0x56 0x0>;

				port {

					endpoint {
						phandle = <0xe>;
						remote-endpoint = <0xd>;
					};
				};
			};

			panel2@0 {
				bias-gpios = <0xffffffff 0x89 0x0 0xffffffff 0x8a 0x0>;
				compatible = "k16a_42_02_0b_vdo,lcm";
				lcd_dvdd-supply = <0xffffffff>;
				lcm-bl-enable-gpios = <0xffffffff 0x57 0x0>;
				phandle = <0x12>;
				pinctrl-names = "default";
				pm-enable-gpios = <0xffffffff 0x88 0x0>;
				reg = <0x1>;
				reset-gpios = <0xffffffff 0x56 0x0>;

				port {

					endpoint {
						phandle = <0x4a>;
						remote-endpoint = <0xd>;
					};
				};
			};

			panel3@0 {
				bias-gpios = <0xffffffff 0x89 0x0 0xffffffff 0x8a 0x0>;
				compatible = "virtual,default,vdo";
				lcd_dvdd-supply = <0xffffffff>;
				lcm-bl-enable-gpios = <0xffffffff 0x57 0x0>;
				phandle = <0x4b>;
				pinctrl-names = "default";
				pm-enable-gpios = <0xffffffff 0x88 0x0>;
				reg = <0x3>;
				reset-gpios = <0xffffffff 0x56 0x0>;

				port {

					endpoint {
						phandle = <0x4c>;
						remote-endpoint = <0xd>;
					};
				};
			};

			ports {

				port {

					endpoint {
						phandle = <0xd>;
						remote-endpoint = <0xe>;
					};
				};
			};
		};
	};

	fragment@14 {
		target = <0xffffffff>;

		__overlay__ {
			#address-cells = <0x1>;
			#size-cells = <0x0>;
			pinctrl-0 = <0xf>;
			pinctrl-1 = <0x10>;
			pinctrl-names = "default", "nt36672c_spi_mode";
			status = "okay";

			novatek@0 {
				compatible = "novatek,NVT-ts-spi";
				novatek,irq-gpio = <0xffffffff 0xe 0x0>;
				novatek,mp-support-dt;
				novatek,reset-gpio = <0xffffffff 0xd 0x0>;
				novatek,spi-rd-fast-addr = <0x3f310>;
				novatek,swrst-n8-addr = <0x3f0fe>;
				panel1 = <0x11>;
				panel2 = <0x12>;
				reg = <0x0>;
				spi-max-frequency = <0x927c00>;
				status = "okay";

				novatek-mp-criteria-595E@0 {
					#address-cells = <0x1>;
					#size-cells = <0x0>;
					AIN_KEY = <0x0 0x1 0x2 0xff>;
					AIN_X = <0x0 0x1 0x2 0x3 0x4 0x5 0x6 0x7 0x8 0x9 0xa 0xb 0xc 0xd 0xe 0xf>;
					AIN_Y = <0x0 0x1 0x2 0x3 0x4 0x5 0x6 0x7 0x8 0x9 0xa 0xb 0xc 0xd 0xe 0xf 0x10 0x11 0x12 0x13 0x14 0x15 0x16 0x17 0x18 0x19 0x1a 0x1b 0x1c 0x1d 0x1e 0x1f 0x20 0x21 0x22 0x23>;
					IC_KEY_CFG_SIZE = <0x4>;
					IC_X_CFG_SIZE = <0x10>;
					IC_Y_CFG_SIZE = <0x24>;
					PS_Config_Diff_Test_Frame = <0x32>;
					PS_Config_Lmt_FW_CC_N = <0x18 0x18 0x18 0x18 0x18 0x18 0x18 0x18 0x18 0x18 0x18 0x18 0x18 0x18 0x18 0x18 0x18 0x18 0x18 0x18 0x18 0x18 0x18 0x18 0x18 0x18 0x18 0x18 0x18 0x18 0x18 0x18 0x18 0x18 0x18 0x18 0x18 0x18 0x18 0x18 0x18 0x18 0x18 0x18 0x18 0x18 0x18 0x18 0x18 0x18 0x18 0x18 0x18 0x18 0x18 0x18 0x18 0x18 0x18 0x18 0x18 0x18 0x18 0x18 0x18 0x18 0x18 0x18 0x18 0x18 0x18 0x18 0x18 0x18 0x18 0x18 0x18 0x18 0x18 0x18 0x19 0x18 0x18 0x18 0x18 0x18 0x18 0x19 0x18 0x18 0x18 0x18 0x18 0x18 0x18 0x18 0x18 0x18 0x18 0x18 0x18 0x18 0x18 0x18 0x18 0x18 0x18 0x18 0x18 0x18 0x18 0x18 0x18 0x18 0x18 0x18 0x18 0x18 0x18 0x19 0x18 0x18 0x18 0x18 0x18 0x18 0x18 0x18 0x18 0x18 0x18 0x18 0x18 0x18 0x18 0x18 0x18 0x18 0x18 0x18 0x18 0x18 0x18 0x18 0x18 0x18 0x18 0x18 0x18 0x18 0x18 0x19 0x18 0x18 0x18 0x18 0x18 0x18 0x18 0x18 0x18 0x18 0x18 0x18 0x18 0x18 0x18 0x18 0x18 0x18 0x18 0x18 0x18 0x18 0x18 0x18 0x18 0x18 0x18 0x18 0x18 0x18 0x18 0x19 0x18 0x18 0x18 0x18 0x18 0x18 0x18 0x18 0x18 0x18 0x18 0x18 0x18 0x18 0x18 0x18 0x18 0x18 0x18 0x18 0x18 0x18 0x18 0x18 0x18 0x18 0x18 0x18 0x18 0x18 0x18 0x19 0x18 0x18 0x18 0x18 0x18 0x18 0x18 0x18 0x18 0x18 0x18 0x18 0x18 0x18 0x18 0x18 0x18 0x18 0x18 0x18 0x18 0x18 0x18 0x18 0x18 0x18 0x18 0x18 0x18 0x19 0x18 0x19 0x18 0x18 0x18 0x18 0x18 0x18 0x18 0x19 0x18 0x18 0x18 0x18 0x18 0x18 0x18 0x19 0x18 0x18 0x18 0x18 0x18 0x18 0x18 0x18 0x18 0x18 0x18 0x18 0x18 0x19 0x18 0x19 0x18 0x18 0x18 0x18 0x18 0x18 0x18 0x19 0x18 0x18 0x18 0x18 0x18 0x18 0x18 0x18 0x18 0x18 0x18 0x18 0x18 0x18 0x18 0x18 0x19 0x18 0x18 0x18 0x18 0x18 0x18 0x18 0x18 0x18 0x18 0x18 0x18 0x18 0x18 0x18 0x18 0x18 0x18 0x18 0x18 0x18 0x18 0x18 0x18 0x18 0x18 0x18 0x18 0x18 0x18 0x18 0x19 0x18 0x18 0x18 0x18 0x18 0x18 0x18 0x18 0x18 0x18 0x18 0x18 0x18 0x18 0x18 0x18 0x18 0x18 0x18 0x18 0x18 0x18 0x18 0x18 0x18 0x18 0x18 0x18 0x18 0x18 0x18 0x18 0x18 0x18 0x18 0x18 0x18 0x18 0x18 0x18 0x18 0x18 0x18 0x18 0x18 0x18 0x18 0x18 0x18 0x18 0x18 0x18 0x18 0x18 0x18 0x18 0x18 0x18 0x18 0x18 0x18 0x18 0x18 0x19 0x18 0x18 0x18 0x18 0x18 0x18 0x18 0x18 0x18 0x18 0x18 0x18 0x18 0x18 0x18 0x18 0x18 0x18 0x18 0x18 0x18 0x18 0x18 0x18 0x18 0x18 0x18 0x18 0x18 0x18 0x18 0x19 0x18 0x18 0x18 0x18 0x18 0x18 0x18 0x18 0x18 0x18 0x18 0x18 0x18 0x18 0x18 0x18 0x18 0x18 0x18 0x18 0x18 0x18 0x18 0x18 0x18 0x18 0x18 0x18 0x18 0x18 0x18 0x18 0x18 0x18 0x18 0x18 0x18 0x18 0x18 0x18 0x18 0x18 0x18 0x18 0x18 0x18 0x18 0x18 0x18 0x18 0x18 0x18 0x18 0x18 0x18 0x18 0x18 0x18 0x18 0x18 0x18 0x18 0x18 0x18 0x18 0x18 0x18 0x18 0x18 0x18 0x18 0x18 0x18 0x18 0x18 0x18 0x18 0x18 0x19 0x18 0x18 0x18 0x18 0x18 0x18 0x18 0x18 0x18 0x18 0x18 0x18 0x18 0x18 0x18 0x18 0x18 0x18 0x18 0x18 0x18 0x18 0x18 0x18 0x18 0x18 0x18 0x18 0x18 0x18 0x18 0x18 0x18 0x18 0x18 0x18 0x18 0x18 0x18 0x18 0x18 0x18 0x18 0x18 0x18 0x18 0x18 0x18 0x18 0x18 0x18 0x18 0x18 0x18 0x18 0x18 0x18 0x18 0x18 0x18 0x18 0x18 0x18 0x18 0x0 0x0 0x0>;
					PS_Config_Lmt_FW_CC_P = <0x35 0x35 0x37 0x37 0x37 0x37 0x37 0x37 0x37 0x37 0x37 0x37 0x37 0x37 0x35 0x35 0x37 0x37 0x37 0x37 0x37 0x37 0x37 0x37 0x37 0x37 0x37 0x37 0x37 0x37 0x37 0x37 0x37 0x35 0x35 0x35 0x35 0x35 0x35 0x37 0x37 0x37 0x37 0x37 0x37 0x37 0x37 0x37 0x37 0x37 0x37 0x37 0x37 0x37 0x37 0x37 0x37 0x37 0x37 0x37 0x37 0x37 0x37 0x37 0x37 0x35 0x37 0x37 0x35 0x37 0x37 0x37 0x37 0x37 0x37 0x37 0x37 0x37 0x37 0x37 0x38 0x37 0x37 0x37 0x37 0x37 0x37 0x38 0x37 0x37 0x37 0x37 0x37 0x37 0x37 0x37 0x37 0x37 0x35 0x37 0x35 0x37 0x37 0x37 0x37 0x37 0x37 0x37 0x37 0x35 0x35 0x37 0x37 0x37 0x37 0x37 0x37 0x37 0x37 0x38 0x37 0x37 0x37 0x37 0x37 0x35 0x35 0x37 0x37 0x35 0x37 0x37 0x37 0x37 0x37 0x37 0x37 0x37 0x37 0x37 0x37 0x37 0x35 0x37 0x37 0x37 0x37 0x37 0x37 0x37 0x37 0x38 0x37 0x37 0x37 0x37 0x37 0x37 0x35 0x37 0x37 0x37 0x35 0x37 0x37 0x37 0x37 0x37 0x37 0x37 0x37 0x37 0x37 0x37 0x37 0x37 0x37 0x37 0x37 0x37 0x37 0x37 0x37 0x38 0x37 0x37 0x37 0x37 0x37 0x37 0x35 0x37 0x37 0x37 0x37 0x37 0x37 0x37 0x37 0x37 0x37 0x37 0x37 0x37 0x37 0x37 0x37 0x37 0x37 0x37 0x37 0x37 0x37 0x37 0x37 0x38 0x37 0x37 0x37 0x37 0x37 0x37 0x35 0x37 0x37 0x37 0x37 0x37 0x37 0x37 0x37 0x37 0x37 0x37 0x37 0x37 0x37 0x37 0x37 0x37 0x37 0x37 0x37 0x37 0x37 0x38 0x37 0x38 0x37 0x37 0x37 0x37 0x37 0x37 0x37 0x38 0x37 0x37 0x37 0x37 0x37 0x37 0x37 0x38 0x37 0x37 0x37 0x37 0x37 0x37 0x37 0x37 0x37 0x37 0x37 0x37 0x37 0x38 0x37 0x38 0x37 0x37 0x37 0x37 0x37 0x35 0x35 0x38 0x37 0x35 0x35 0x35 0x35 0x35 0x35 0x35 0x37 0x37 0x37 0x37 0x37 0x35 0x35 0x37 0x38 0x37 0x37 0x37 0x37 0x37 0x37 0x37 0x37 0x37 0x37 0x37 0x37 0x37 0x37 0x37 0x37 0x35 0x35 0x35 0x35 0x35 0x35 0x37 0x37 0x37 0x37 0x37 0x37 0x37 0x37 0x37 0x38 0x37 0x37 0x37 0x37 0x37 0x37 0x37 0x37 0x37 0x37 0x35 0x37 0x37 0x37 0x37 0x37 0x35 0x35 0x35 0x35 0x35 0x37 0x37 0x37 0x37 0x37 0x37 0x37 0x37 0x37 0x37 0x37 0x37 0x37 0x37 0x35 0x35 0x37 0x37 0x37 0x35 0x37 0x35 0x35 0x35 0x35 0x37 0x37 0x35 0x35 0x35 0x35 0x35 0x35 0x37 0x37 0x37 0x37 0x37 0x37 0x37 0x37 0x37 0x38 0x37 0x37 0x37 0x37 0x37 0x37 0x37 0x37 0x37 0x37 0x35 0x35 0x37 0x37 0x37 0x37 0x35 0x35 0x35 0x35 0x35 0x35 0x35 0x37 0x37 0x37 0x37 0x37 0x37 0x37 0x37 0x38 0x37 0x37 0x37 0x37 0x37 0x37 0x37 0x37 0x37 0x37 0x37 0x37 0x37 0x37 0x37 0x37 0x37 0x37 0x37 0x37 0x37 0x37 0x37 0x37 0x37 0x37 0x37 0x37 0x37 0x37 0x37 0x37 0x37 0x37 0x35 0x35 0x35 0x37 0x37 0x37 0x35 0x37 0x35 0x35 0x35 0x35 0x37 0x37 0x35 0x35 0x35 0x35 0x35 0x35 0x37 0x37 0x37 0x37 0x37 0x37 0x37 0x37 0x37 0x37 0x37 0x37 0x37 0x37 0x37 0x37 0x37 0x37 0x37 0x37 0x37 0x37 0x37 0x35 0x38 0x37 0x35 0x35 0x35 0x37 0x35 0x35 0x37 0x37 0x37 0x37 0x37 0x37 0x37 0x35 0x37 0x37 0x37 0x37 0x37 0x37 0x37 0x37 0x37 0x37 0x37 0x35 0x35 0x37 0x37 0x35 0x37 0x35 0x35 0x35 0x35 0x35 0x35 0x35 0x35 0x35 0x35 0x35 0x35 0x35 0x35 0x35 0x37 0x35 0x35 0x35 0x37 0x37 0x37 0x37 0x37 0x37 0x37 0x37 0x37 0x37 0x35 0x35 0x35 0x13a 0x13a 0x13a>;
					PS_Config_Lmt_FW_Diff_N = <0xffffffce 0xffffffce 0xffffffce 0xffffffce 0xffffffce 0xffffffce 0xffffffce 0xffffffce 0xffffffce 0xffffffce 0xffffffce 0xffffffce 0xffffffce 0xffffffce 0xffffffce 0xffffffce 0xffffffce 0xffffffce 0xffffffce 0xffffffce 0xffffffce 0xffffffce 0xffffffce 0xffffffce 0xffffffce 0xffffffce 0xffffffce 0xffffffce 0xffffffce 0xffffffce 0xffffffce 0xffffffce 0xffffffce 0xffffffce 0xffffffce 0xffffffce 0xffffffce 0xffffffce 0xffffffce 0xffffffce 0xffffffce 0xffffffce 0xffffffce 0xffffffce 0xffffffce 0xffffffce 0xffffffce 0xffffffce 0xffffffce 0xffffffce 0xffffffce 0xffffffce 0xffffffce 0xffffffce 0xffffffce 0xffffffce 0xffffffce 0xffffffce 0xffffffce 0xffffffce 0xffffffce 0xffffffce 0xffffffce 0xffffffce 0xffffffce 0xffffffce 0xffffffce 0xffffffce 0xffffffce 0xffffffce 0xffffffce 0xffffffce 0xffffffce 0xffffffce 0xffffffce 0xffffffce 0xffffffce 0xffffffce 0xffffffce 0xffffffce 0xffffffce 0xffffffce 0xffffffce 0xffffffce 0xffffffce 0xffffffce 0xffffffce 0xffffffce 0xffffffce 0xffffffce 0xffffffce 0xffffffce 0xffffffce 0xffffffce 0xffffffce 0xffffffce 0xffffffce 0xffffffce 0xffffffce 0xffffffce 0xffffffce 0xffffffce 0xffffffce 0xffffffce 0xffffffce 0xffffffce 0xffffffce 0xffffffce 0xffffffce 0xffffffce 0xffffffce 0xffffffce 0xffffffce 0xffffffce 0xffffffce 0xffffffce 0xffffffce 0xffffffce 0xffffffce 0xffffffce 0xffffffce 0xffffffce 0xffffffce 0xffffffce 0xffffffce 0xffffffce 0xffffffce 0xffffffce 0xffffffce 0xffffffce 0xffffffce 0xffffffce 0xffffffce 0xffffffce 0xffffffce 0xffffffce 0xffffffce 0xffffffce 0xffffffce 0xffffffce 0xffffffce 0xffffffce 0xffffffce 0xffffffce 0xffffffce 0xffffffce 0xffffffce 0xffffffce 0xffffffce 0xffffffce 0xffffffce 0xffffffce 0xffffffce 0xffffffce 0xffffffce 0xffffffce 0xffffffce 0xffffffce 0xffffffce 0xffffffce 0xffffffce 0xffffffce 0xffffffce 0xffffffce 0xffffffce 0xffffffce 0xffffffce 0xffffffce 0xffffffce 0xffffffce 0xffffffce 0xffffffce 0xffffffce 0xffffffce 0xffffffce 0xffffffce 0xffffffce 0xffffffce 0xffffffce 0xffffffce 0xffffffce 0xffffffce 0xffffffce 0xffffffce 0xffffffce 0xffffffce 0xffffffce 0xffffffce 0xffffffce 0xffffffce 0xffffffce 0xffffffce 0xffffffce 0xffffffce 0xffffffce 0xffffffce 0xffffffce 0xffffffce 0xffffffce 0xffffffce 0xffffffce 0xffffffce 0xffffffce 0xffffffce 0xffffffce 0xffffffce 0xffffffce 0xffffffce 0xffffffce 0xffffffce 0xffffffce 0xffffffce 0xffffffce 0xffffffce 0xffffffce 0xffffffce 0xffffffce 0xffffffce 0xffffffce 0xffffffce 0xffffffce 0xffffffce 0xffffffce 0xffffffce 0xffffffce 0xffffffce 0xffffffce 0xffffffce 0xffffffce 0xffffffce 0xffffffce 0xffffffce 0xffffffce 0xffffffce 0xffffffce 0xffffffce 0xffffffce 0xffffffce 0xffffffce 0xffffffce 0xffffffce 0xffffffce 0xffffffce 0xffffffce 0xffffffce 0xffffffce 0xffffffce 0xffffffce 0xffffffce 0xffffffce 0xffffffce 0xffffffce 0xffffffce 0xffffffce 0xffffffce 0xffffffce 0xffffffce 0xffffffce 0xffffffce 0xffffffce 0xffffffce 0xffffffce 0xffffffce 0xffffffce 0xffffffce 0xffffffce 0xffffffce 0xffffffce 0xffffffce 0xffffffce 0xffffffce 0xffffffce 0xffffffce 0xffffffce 0xffffffce 0xffffffce 0xffffffce 0xffffffce 0xffffffce 0xffffffce 0xffffffce 0xffffffce 0xffffffce 0xffffffce 0xffffffce 0xffffffce 0xffffffce 0xffffffce 0xffffffce 0xffffffce 0xffffffce 0xffffffce 0xffffffce 0xffffffce 0xffffffce 0xffffffce 0xffffffce 0xffffffce 0xffffffce 0xffffffce 0xffffffce 0xffffffce 0xffffffce 0xffffffce 0xffffffce 0xffffffce 0xffffffce 0xffffffce 0xffffffce 0xffffffce 0xffffffce 0xffffffce 0xffffffce 0xffffffce 0xffffffce 0xffffffce 0xffffffce 0xffffffce 0xffffffce 0xffffffce 0xffffffce 0xffffffce 0xffffffce 0xffffffce 0xffffffce 0xffffffce 0xffffffce 0xffffffce 0xffffffce 0xffffffce 0xffffffce 0xffffffce 0xffffffce 0xffffffce 0xffffffce 0xffffffce 0xffffffce 0xffffffce 0xffffffce 0xffffffce 0xffffffce 0xffffffce 0xffffffce 0xffffffce 0xffffffce 0xffffffce 0xffffffce 0xffffffce 0xffffffce 0xffffffce 0xffffffce 0xffffffce 0xffffffce 0xffffffce 0xffffffce 0xffffffce 0xffffffce 0xffffffce 0xffffffce 0xffffffce 0xffffffce 0xffffffce 0xffffffce 0xffffffce 0xffffffce 0xffffffce 0xffffffce 0xffffffce 0xffffffce 0xffffffce 0xffffffce 0xffffffce 0xffffffce 0xffffffce 0xffffffce 0xffffffce 0xffffffce 0xffffffce 0xffffffce 0xffffffce 0xffffffce 0xffffffce 0xffffffce 0xffffffce 0xffffffce 0xffffffce 0xffffffce 0xffffffce 0xffffffce 0xffffffce 0xffffffce 0xffffffce 0xffffffce 0xffffffce 0xffffffce 0xffffffce 0xffffffce 0xffffffce 0xffffffce 0xffffffce 0xffffffce 0xffffffce 0xffffffce 0xffffffce 0xffffffce 0xffffffce 0xffffffce 0xffffffce 0xffffffce 0xffffffce 0xffffffce 0xffffffce 0xffffffce 0xffffffce 0xffffffce 0xffffffce 0xffffffce 0xffffffce 0xffffffce 0xffffffce 0xffffffce 0xffffffce 0xffffffce 0xffffffce 0xffffffce 0xffffffce 0xffffffce 0xffffffce 0xffffffce 0xffffffce 0xffffffce 0xffffffce 0xffffffce 0xffffffce 0xffffffce 0xffffffce 0xffffffce 0xffffffce 0xffffffce 0xffffffce 0xffffffce 0xffffffce 0xffffffce 0xffffffce 0xffffffce 0xffffffce 0xffffffce 0xffffffce 0xffffffce 0xffffffce 0xffffffce 0xffffffce 0xffffffce 0xffffffce 0xffffffce 0xffffffce 0xffffffce 0xffffffce 0xffffffce 0xffffffce 0xffffffce 0xffffffce 0xffffffce 0xffffffce 0xffffffce 0xffffffce 0xffffffce 0xffffffce 0xffffffce 0xffffffce 0xffffffce 0xffffffce 0xffffffce 0xffffffce 0xffffffce 0xffffffce 0xffffffce 0xffffffce 0xffffffce 0xffffffce 0xffffffce 0xffffffce 0xffffffce 0xffffffce 0xffffffce 0xffffffce 0xffffffce 0xffffffce 0xffffffce 0xffffffce 0xffffffce 0xffffffce 0xffffffce 0xffffffce 0xffffffce 0xffffffce 0xffffffce 0xffffffce 0xffffffce 0xffffffce 0xffffffce 0xffffffce 0xffffffce 0xffffffce 0xffffffce 0xffffffce 0xffffffce 0xffffffce 0xffffffce 0xffffffce 0xffffffce 0xffffffce 0xffffffce 0xffffffce 0xffffffce 0xffffffce 0xffffffce 0xffffffce 0xffffffce 0xffffffce 0xffffffce 0xffffffce 0xffffffce 0xffffffce 0xffffffce 0xffffffce 0xffffffce 0xffffffce 0xffffffce 0xffffffce 0xffffffce 0xffffffce 0xffffffce 0xffffffce 0xffffffce 0xffffffce 0xffffffce 0xffffffce 0xffffffce 0xffffffce 0xffffffce 0xffffffce 0xffffffce 0xffffffce 0xffffffce 0xffffffce 0xffffffce 0xffffffce 0xffffffce 0xffffffce 0xffffffce 0xffffffce 0xffffffce 0xffffffce 0xffffffce 0xffffffce 0xffffffce 0xffffffce 0xffffffce 0xffffffce 0xffffffce 0xffffffce 0xffffffce 0xffffffce 0xffffffce 0xffffffce 0xffffffce 0xffffffce 0xffffffce 0xffffffce 0xffffffce 0xffffffce 0xffffffce 0xffffffce 0xffffffce 0xffffffce 0xffffffb5 0xffffffb5 0xffffffb5>;
					PS_Config_Lmt_FW_Diff_P = <0x32 0x32 0x32 0x32 0x32 0x32 0x32 0x32 0x32 0x32 0x32 0x32 0x32 0x32 0x32 0x32 0x32 0x32 0x32 0x32 0x32 0x32 0x32 0x32 0x32 0x32 0x32 0x32 0x32 0x32 0x32 0x32 0x32 0x32 0x32 0x32 0x32 0x32 0x32 0x32 0x32 0x32 0x32 0x32 0x32 0x32 0x32 0x32 0x32 0x32 0x32 0x32 0x32 0x32 0x32 0x32 0x32 0x32 0x32 0x32 0x32 0x32 0x32 0x32 0x32 0x32 0x32 0x32 0x32 0x32 0x32 0x32 0x32 0x32 0x32 0x32 0x32 0x32 0x32 0x32 0x32 0x32 0x32 0x32 0x32 0x32 0x32 0x32 0x32 0x32 0x32 0x32 0x32 0x32 0x32 0x32 0x32 0x32 0x32 0x32 0x32 0x32 0x32 0x32 0x32 0x32 0x32 0x32 0x32 0x32 0x32 0x32 0x32 0x32 0x32 0x32 0x32 0x32 0x32 0x32 0x32 0x32 0x32 0x32 0x32 0x32 0x32 0x32 0x32 0x32 0x32 0x32 0x32 0x32 0x32 0x32 0x32 0x32 0x32 0x32 0x32 0x32 0x32 0x32 0x32 0x32 0x32 0x32 0x32 0x32 0x32 0x32 0x32 0x32 0x32 0x32 0x32 0x32 0x32 0x32 0x32 0x32 0x32 0x32 0x32 0x32 0x32 0x32 0x32 0x32 0x32 0x32 0x32 0x32 0x32 0x32 0x32 0x32 0x32 0x32 0x32 0x32 0x32 0x32 0x32 0x32 0x32 0x32 0x32 0x32 0x32 0x32 0x32 0x32 0x32 0x32 0x32 0x32 0x32 0x32 0x32 0x32 0x32 0x32 0x32 0x32 0x32 0x32 0x32 0x32 0x32 0x32 0x32 0x32 0x32 0x32 0x32 0x32 0x32 0x32 0x32 0x32 0x32 0x32 0x32 0x32 0x32 0x32 0x32 0x32 0x32 0x32 0x32 0x32 0x32 0x32 0x32 0x32 0x32 0x32 0x32 0x32 0x32 0x32 0x32 0x32 0x32 0x32 0x32 0x32 0x32 0x32 0x32 0x32 0x32 0x32 0x32 0x32 0x32 0x32 0x32 0x32 0x32 0x32 0x32 0x32 0x32 0x32 0x32 0x32 0x32 0x32 0x32 0x32 0x32 0x32 0x32 0x32 0x32 0x32 0x32 0x32 0x32 0x32 0x32 0x32 0x32 0x32 0x32 0x32 0x32 0x32 0x32 0x32 0x32 0x32 0x32 0x32 0x32 0x32 0x32 0x32 0x32 0x32 0x32 0x32 0x32 0x32 0x32 0x32 0x32 0x32 0x32 0x32 0x32 0x32 0x32 0x32 0x32 0x32 0x32 0x32 0x32 0x32 0x32 0x32 0x32 0x32 0x32 0x32 0x32 0x32 0x32 0x32 0x32 0x32 0x32 0x32 0x32 0x32 0x32 0x32 0x32 0x32 0x32 0x32 0x32 0x32 0x32 0x32 0x32 0x32 0x32 0x32 0x32 0x32 0x32 0x32 0x32 0x32 0x32 0x32 0x32 0x32 0x32 0x32 0x32 0x32 0x32 0x32 0x32 0x32 0x32 0x32 0x32 0x32 0x32 0x32 0x32 0x32 0x32 0x32 0x32 0x32 0x32 0x32 0x32 0x32 0x32 0x32 0x32 0x32 0x32 0x32 0x32 0x32 0x32 0x32 0x32 0x32 0x32 0x32 0x32 0x32 0x32 0x32 0x32 0x32 0x32 0x32 0x32 0x32 0x32 0x32 0x32 0x32 0x32 0x32 0x32 0x32 0x32 0x32 0x32 0x32 0x32 0x32 0x32 0x32 0x32 0x32 0x32 0x32 0x32 0x32 0x32 0x32 0x32 0x32 0x32 0x32 0x32 0x32 0x32 0x32 0x32 0x32 0x32 0x32 0x32 0x32 0x32 0x32 0x32 0x32 0x32 0x32 0x32 0x32 0x32 0x32 0x32 0x32 0x32 0x32 0x32 0x32 0x32 0x32 0x32 0x32 0x32 0x32 0x32 0x32 0x32 0x32 0x32 0x32 0x32 0x32 0x32 0x32 0x32 0x32 0x32 0x32 0x32 0x32 0x32 0x32 0x32 0x32 0x32 0x32 0x32 0x32 0x32 0x32 0x32 0x32 0x32 0x32 0x32 0x32 0x32 0x32 0x32 0x32 0x32 0x32 0x32 0x32 0x32 0x32 0x32 0x32 0x32 0x32 0x32 0x32 0x32 0x32 0x32 0x32 0x32 0x32 0x32 0x32 0x32 0x32 0x32 0x32 0x32 0x32 0x32 0x32 0x32 0x32 0x32 0x32 0x32 0x32 0x32 0x32 0x32 0x32 0x32 0x32 0x32 0x32 0x32 0x32 0x32 0x32 0x32 0x32 0x32 0x32 0x32 0x32 0x32 0x32 0x32 0x32 0x32 0x32 0x32 0x32 0x32 0x32 0x32 0x32 0x32 0x32 0x32 0x32 0x4b 0x4b 0x4b>;
					PS_Config_Lmt_FW_Rawdata_N = <0x1e1 0x1da 0x1e0 0x1db 0x1e3 0x1de 0x1e3 0x1e3 0x1e1 0x1da 0x1da 0x1dc 0x1d9 0x1e7 0x1d8 0x1e3 0x1e0 0x1e1 0x1e0 0x1e1 0x1dd 0x1e1 0x1e0 0x1e1 0x1e3 0x1e3 0x1e2 0x1e0 0x1e2 0x1e3 0x1e4 0x1dc 0x1d8 0x1e3 0x1e3 0x1e0 0x1e5 0x1e1 0x1e4 0x1db 0x1e2 0x1e1 0x1e1 0x1df 0x1e2 0x1e1 0x1e0 0x1e4 0x1e0 0x1dc 0x1e0 0x1de 0x1dd 0x1df 0x1de 0x1e1 0x1e3 0x1e2 0x1dd 0x1e3 0x1de 0x1dc 0x1de 0x1e1 0x1e0 0x1e0 0x1dd 0x1de 0x1dd 0x1de 0x1de 0x1e3 0x1e1 0x1e1 0x1e3 0x1e6 0x1e2 0x1e1 0x1dd 0x1e4 0x1db 0x1e1 0x1e2 0x1e1 0x1e0 0x1e1 0x1e1 0x1dd 0x1e1 0x1e1 0x1e1 0x1e1 0x1e0 0x1e3 0x1e1 0x1da 0x1e3 0x1de 0x1df 0x1e0 0x1e0 0x1df 0x1df 0x1e1 0x1dd 0x1db 0x1db 0x1db 0x1dd 0x1dd 0x1dd 0x1da 0x1dc 0x1e0 0x1dd 0x1dd 0x1dd 0x1dd 0x1dd 0x1e3 0x1e3 0x1e4 0x1e9 0x1e7 0x1e7 0x1e1 0x1df 0x1d8 0x1e4 0x1e0 0x1e0 0x1de 0x1de 0x1de 0x1de 0x1e1 0x1de 0x1dc 0x1e0 0x1de 0x1df 0x1e0 0x1e1 0x1de 0x1dd 0x1dd 0x1de 0x1e0 0x1e0 0x1e1 0x1e0 0x1dd 0x1db 0x1db 0x1e0 0x1e0 0x1df 0x1e4 0x1e1 0x1db 0x1dd 0x1db 0x1dc 0x1da 0x1dd 0x1dd 0x1dc 0x1e1 0x1e0 0x1e0 0x1e4 0x1e2 0x1e3 0x1e0 0x1dd 0x1e0 0x1e0 0x1e2 0x1e3 0x1df 0x1e0 0x1e5 0x1e1 0x1dd 0x1de 0x1dd 0x1df 0x1e0 0x1e0 0x1e0 0x1e0 0x1e0 0x1d9 0x1e0 0x1df 0x1dd 0x1dd 0x1db 0x1dd 0x1e0 0x1e0 0x1e1 0x1e1 0x1e0 0x1e0 0x1df 0x1de 0x1de 0x1dd 0x1dd 0x1de 0x1e0 0x1e1 0x1dd 0x1de 0x1e1 0x1dc 0x1db 0x1e0 0x1e0 0x1e1 0x1e0 0x1e0 0x1dd 0x1e5 0x1e0 0x1e1 0x1e2 0x1e1 0x1e4 0x1e4 0x1db 0x1e0 0x1df 0x1de 0x1dd 0x1dd 0x1e1 0x1e1 0x1e0 0x1e0 0x1e0 0x1e0 0x1dd 0x1df 0x1de 0x1de 0x1df 0x1dc 0x1db 0x1de 0x1db 0x1de 0x1e3 0x1e4 0x1dd 0x1dd 0x1e1 0x1e0 0x1dd 0x1dd 0x1df 0x1dc 0x1e3 0x1df 0x1e3 0x1e3 0x1e0 0x1db 0x1dc 0x1dd 0x1e1 0x1e0 0x1dc 0x1e1 0x1e1 0x1e0 0x1dd 0x1e0 0x1e1 0x1d9 0x1dd 0x1de 0x1db 0x1e3 0x1e3 0x1e2 0x1e1 0x1dd 0x1e1 0x1e3 0x1e0 0x1e3 0x1dc 0x1de 0x1df 0x1df 0x1de 0x1de 0x1de 0x1de 0x1e0 0x1dd 0x1de 0x1db 0x1dd 0x1de 0x1df 0x1dc 0x1de 0x1de 0x1e1 0x1da 0x1e0 0x1e3 0x1e0 0x1df 0x1df 0x1de 0x1e0 0x1e2 0x1dd 0x1e1 0x1da 0x1e1 0x1db 0x1d8 0x1d8 0x1e3 0x1e2 0x1e1 0x1db 0x1dd 0x1db 0x1db 0x1e3 0x1dc 0x1e3 0x1de 0x1e1 0x1e0 0x1e2 0x1e3 0x1e2 0x1dd 0x1e1 0x1e1 0x1e3 0x1e2 0x1e1 0x1e0 0x1de 0x1dd 0x1e1 0x1e0 0x1e2 0x1e0 0x1e0 0x1df 0x1de 0x1e3 0x1e3 0x1e3 0x1e0 0x1e3 0x1e1 0x1df 0x1dc 0x1df 0x1dd 0x1dd 0x1dd 0x1dd 0x1dd 0x1e0 0x1e0 0x1dd 0x1e1 0x1e2 0x1e1 0x1e3 0x1e2 0x1e0 0x1de 0x1de 0x1dc 0x1dd 0x1da 0x1e0 0x1de 0x1db 0x1de 0x1e0 0x1e0 0x1de 0x1de 0x1de 0x1de 0x1dd 0x1e3 0x1e0 0x1dd 0x1dd 0x1df 0x1df 0x1e0 0x1e1 0x1de 0x1e1 0x1e0 0x1e0 0x1de 0x1e0 0x1e0 0x1e0 0x1e0 0x1db 0x1e1 0x1e3 0x1e3 0x1e0 0x1e1 0x1e3 0x1e1 0x1da 0x1db 0x1da 0x1dd 0x1dd 0x1de 0x1de 0x1e1 0x1e0 0x1e0 0x1e0 0x1e0 0x1df 0x1e0 0x1dd 0x1db 0x1dd 0x1e1 0x1e0 0x1de 0x1de 0x1e0 0x1db 0x1db 0x1e4 0x1db 0x1db 0x1dc 0x1dd 0x1dd 0x1e0 0x1e1 0x1dd 0x1dd 0x1dd 0x1de 0x1de 0x1dc 0x1dd 0x1e3 0x1dd 0x1e1 0x1e3 0x1e0 0x1e0 0x1e0 0x1e3 0x1e0 0x1e0 0x1e1 0x1e1 0x1e1 0x1e0 0x1e0 0x1e1 0x1dd 0x1de 0x1de 0x1da 0x1e1 0x1e1 0x1e1 0x1dd 0x1dc 0x1df 0x1e1 0x1e0 0x1dd 0x1dc 0x1df 0x1de 0x1e3 0x1db 0x1e1 0x1e1 0x1e0 0x1e3 0x1e1 0x1e3 0x1e1 0x1db 0x1db 0x1e3 0x1dd 0x1e4 0x1de 0x1e0 0x1de 0x1e0 0x1e1 0x1e3 0x1de 0x1e3 0x1e1 0x1e3 0x1e1 0x1e0 0x1df 0x1e0 0x1e2 0x1e2 0x1df 0x1e0 0x1de 0x1de 0x1de 0x1df 0x1dd 0x1de 0x1dd 0x1e0 0x1e1 0x1e2 0x1e2 0x1e1 0x1e2 0x1e0 0x1de 0x1dd 0x1da 0x1e3 0x1df 0x1df 0x1de 0x1de 0x1df 0x1de 0x1df 0x1df 0x1de 0x1de 0x1de 0x1e0 0x1de 0x1e0 0x1de 0x1de 0x1dd 0x1da 0x1e0 0x1e1 0x1e1 0x1e2 0x1de 0x1dc 0x1e3 0x1e3 0x1e4 0x1e3 0x1da 0x1da 0x1dd 0xf0 0xf0 0xf0>;
					PS_Config_Lmt_FW_Rawdata_P = <0x462 0x453 0x461 0x454 0x468 0x45d 0x467 0x468 0x464 0x453 0x452 0x457 0x450 0x470 0x44f 0x467 0x460 0x464 0x460 0x464 0x459 0x462 0x460 0x462 0x467 0x468 0x465 0x461 0x465 0x468 0x469 0x457 0x44f 0x468 0x467 0x461 0x46c 0x464 0x469 0x454 0x465 0x464 0x462 0x45e 0x465 0x464 0x460 0x469 0x461 0x457 0x460 0x45d 0x45a 0x45e 0x45d 0x462 0x467 0x465 0x459 0x467 0x45d 0x457 0x45b 0x464 0x461 0x460 0x459 0x45d 0x45a 0x45b 0x45d 0x468 0x462 0x464 0x468 0x46f 0x465 0x462 0x45a 0x469 0x454 0x462 0x465 0x462 0x460 0x464 0x462 0x459 0x462 0x464 0x462 0x462 0x460 0x467 0x462 0x452 0x467 0x45b 0x45e 0x460 0x460 0x45e 0x45e 0x462 0x459 0x456 0x454 0x454 0x45a 0x459 0x45a 0x453 0x457 0x461 0x459 0x459 0x459 0x45a 0x459 0x467 0x467 0x46b 0x475 0x472 0x472 0x464 0x45e 0x44f 0x469 0x461 0x461 0x45b 0x45d 0x45d 0x45d 0x464 0x45b 0x457 0x460 0x45d 0x45e 0x461 0x464 0x45d 0x459 0x459 0x45b 0x460 0x461 0x462 0x460 0x459 0x454 0x456 0x461 0x461 0x45e 0x469 0x462 0x454 0x459 0x454 0x457 0x452 0x459 0x45a 0x457 0x464 0x461 0x460 0x46b 0x465 0x467 0x461 0x459 0x461 0x461 0x465 0x467 0x45e 0x460 0x46c 0x462 0x459 0x45d 0x459 0x45e 0x460 0x460 0x460 0x461 0x461 0x450 0x460 0x45e 0x45a 0x45a 0x454 0x459 0x461 0x460 0x464 0x462 0x460 0x461 0x45e 0x45d 0x45b 0x45a 0x45a 0x45b 0x460 0x462 0x45a 0x45d 0x462 0x457 0x456 0x460 0x460 0x462 0x461 0x461 0x459 0x46c 0x460 0x462 0x465 0x462 0x46b 0x469 0x454 0x461 0x45e 0x45b 0x459 0x45a 0x464 0x464 0x461 0x461 0x460 0x461 0x459 0x45e 0x45d 0x45d 0x45e 0x457 0x454 0x45b 0x456 0x45d 0x468 0x469 0x45a 0x459 0x462 0x460 0x459 0x45a 0x45e 0x457 0x468 0x45e 0x468 0x467 0x460 0x456 0x457 0x459 0x464 0x461 0x457 0x462 0x462 0x461 0x45a 0x460 0x462 0x450 0x45a 0x45b 0x456 0x467 0x467 0x465 0x462 0x45a 0x464 0x468 0x461 0x468 0x457 0x45b 0x45e 0x45e 0x45b 0x45d 0x45d 0x45b 0x460 0x459 0x45d 0x454 0x459 0x45b 0x45e 0x457 0x45b 0x45b 0x462 0x452 0x460 0x467 0x460 0x45e 0x45e 0x45b 0x460 0x465 0x45a 0x462 0x453 0x462 0x456 0x44d 0x44f 0x467 0x465 0x464 0x456 0x459 0x454 0x454 0x468 0x457 0x468 0x45d 0x464 0x460 0x465 0x467 0x465 0x459 0x464 0x462 0x467 0x465 0x464 0x461 0x45d 0x45a 0x462 0x460 0x465 0x461 0x460 0x45e 0x45d 0x467 0x467 0x467 0x461 0x467 0x464 0x45e 0x457 0x45e 0x45a 0x459 0x45a 0x45a 0x459 0x460 0x461 0x459 0x464 0x465 0x462 0x467 0x465 0x460 0x45d 0x45d 0x457 0x45a 0x452 0x460 0x45d 0x456 0x45d 0x461 0x460 0x45d 0x45b 0x45b 0x45d 0x459 0x467 0x460 0x459 0x459 0x45e 0x45e 0x460 0x462 0x45b 0x462 0x460 0x460 0x45d 0x461 0x460 0x460 0x461 0x456 0x464 0x467 0x467 0x461 0x464 0x467 0x462 0x453 0x456 0x453 0x459 0x45a 0x45b 0x45d 0x462 0x461 0x461 0x461 0x460 0x45e 0x460 0x459 0x456 0x45a 0x462 0x461 0x45d 0x45b 0x460 0x456 0x456 0x469 0x454 0x454 0x457 0x459 0x459 0x461 0x464 0x45a 0x45a 0x459 0x45d 0x45b 0x457 0x459 0x468 0x459 0x462 0x467 0x461 0x461 0x461 0x467 0x460 0x461 0x464 0x462 0x462 0x460 0x461 0x462 0x45a 0x45b 0x45d 0x453 0x464 0x462 0x464 0x45a 0x457 0x45e 0x462 0x460 0x45a 0x457 0x45e 0x45b 0x467 0x454 0x462 0x464 0x461 0x468 0x464 0x467 0x462 0x454 0x456 0x467 0x459 0x46b 0x45d 0x460 0x45b 0x460 0x464 0x468 0x45d 0x468 0x462 0x468 0x464 0x461 0x45e 0x461 0x465 0x465 0x45e 0x461 0x45b 0x45d 0x45b 0x45e 0x45a 0x45b 0x45a 0x461 0x464 0x465 0x465 0x464 0x465 0x460 0x45d 0x45a 0x453 0x468 0x45e 0x45e 0x45b 0x45d 0x45e 0x45d 0x45e 0x45e 0x45d 0x45d 0x45d 0x460 0x45b 0x460 0x45b 0x45d 0x45a 0x453 0x461 0x462 0x464 0x465 0x45d 0x457 0x467 0x468 0x46b 0x468 0x453 0x452 0x459 0xf00 0xf00 0xf00>;
					PS_Config_Lmt_Open_Rawdata_N = <0x70b 0x73e 0x766 0x7d1 0x7ac 0x7c9 0x7a7 0x77b 0x754 0x7a8 0x7ac 0x7bc 0x7c4 0x777 0x742 0x72c 0x75f 0x79b 0x7ab 0x7de 0x7bd 0x7d7 0x7af 0x799 0x75f 0x7b0 0x7b6 0x7c7 0x7cb 0x7c3 0x798 0x78b 0x799 0x7b1 0x7c8 0x808 0x7ea 0x7fa 0x7f2 0x7fe 0x7de 0x7f2 0x7dc 0x7ed 0x7f9 0x7d8 0x7b3 0x7a7 0x7aa 0x7ae 0x7d7 0x81a 0x7f8 0x808 0x7fc 0x807 0x7ea 0x7ef 0x7e5 0x7f6 0x7fc 0x7de 0x7b3 0x7ab 0x7bf 0x7dd 0x7e8 0x832 0x816 0x828 0x812 0x820 0x808 0x825 0x7fc 0x815 0x810 0x7f0 0x7c2 0x7bd 0x7c3 0x7de 0x7dd 0x833 0x81c 0x832 0x817 0x825 0x805 0x820 0x7e7 0x80e 0x806 0x7e6 0x7bd 0x7b6 0x7cb 0x7e7 0x7ff 0x83b 0x828 0x841 0x823 0x831 0x820 0x839 0x817 0x822 0x811 0x7fb 0x7c8 0x7c3 0x7c8 0x7e7 0x802 0x82b 0x82f 0x849 0x825 0x831 0x828 0x83b 0x81d 0x81c 0x80e 0x7f5 0x7c9 0x7be 0x7e6 0x802 0x819 0x856 0x84f 0x863 0x845 0x84c 0x84f 0x85e 0x840 0x853 0x826 0x80e 0x7e4 0x7d3 0x7ed 0x804 0x81b 0x85b 0x84a 0x867 0x848 0x84b 0x852 0x860 0x83e 0x855 0x817 0x807 0x7da 0x7cd 0x7eb 0x80b 0x81d 0x864 0x866 0x866 0x84f 0x85e 0x859 0x873 0x84c 0x86a 0x82c 0x801 0x7de 0x7d6 0x7fc 0x81c 0x82b 0x871 0x875 0x88a 0x85d 0x866 0x858 0x871 0x84b 0x86d 0x82e 0x817 0x7e0 0x7d5 0x807 0x822 0x838 0x879 0x88b 0x8a3 0x862 0x871 0x86c 0x880 0x864 0x879 0x837 0x823 0x7da 0x7d7 0x801 0x81d 0x835 0x86f 0x888 0x8a1 0x873 0x867 0x876 0x88b 0x86e 0x888 0x837 0x828 0x7f3 0x7da 0x81e 0x838 0x84f 0x889 0x8a3 0x8be 0x897 0x875 0x896 0x8a3 0x880 0x89d 0x84f 0x831 0x804 0x7d5 0x81f 0x83a 0x84c 0x883 0x8a4 0x8bc 0x89d 0x890 0x8a1 0x8aa 0x889 0x8a6 0x84d 0x832 0x801 0x7e3 0x823 0x841 0x847 0x883 0x8a6 0x8c7 0x89a 0x898 0x8ac 0x8bd 0x894 0x8b5 0x854 0x83b 0x802 0x7ec 0x820 0x841 0x841 0x87e 0x8a4 0x8c3 0x89d 0x89a 0x8a4 0x8b6 0x88e 0x8ab 0x84c 0x835 0x7f3 0x7e3 0x7f7 0x7e7 0x7ce 0x7d1 0x7aa 0x7b6 0x7b1 0x7ca 0x795 0x7c4 0x7ba 0x7c2 0x7c3 0x7ef 0x7f0 0x837 0x7f9 0x7f4 0x7d1 0x7d4 0x7b1 0x7be 0x7b6 0x7d2 0x797 0x7c1 0x7c0 0x7c7 0x7cb 0x7f3 0x7f1 0x834 0x7fc 0x7ff 0x7dd 0x7de 0x7bd 0x7c8 0x7c0 0x7d9 0x7a8 0x7d5 0x7d2 0x7da 0x7d8 0x806 0x7fe 0x82f 0x7fe 0x7ff 0x7de 0x7de 0x7b9 0x7c6 0x7c1 0x7d5 0x7a3 0x7d5 0x7d5 0x7de 0x7dd 0x805 0x7f9 0x82c 0x803 0x80e 0x7e5 0x7e5 0x7c9 0x7cf 0x7c9 0x7db 0x7b2 0x7e0 0x7da 0x7f2 0x7ec 0x80b 0x801 0x82c 0x808 0x817 0x7ec 0x7f3 0x7cd 0x7d4 0x7cf 0x7e1 0x7b4 0x7da 0x7d8 0x7ed 0x7ea 0x805 0x7fc 0x823 0x7fc 0x812 0x7ea 0x7ed 0x7cb 0x7d4 0x7cb 0x7dd 0x7bb 0x7e4 0x7de 0x7f2 0x7f0 0x813 0x805 0x828 0x7ff 0x81a 0x7f0 0x7f4 0x7d1 0x7e1 0x7d4 0x7e9 0x7bd 0x7dd 0x7d8 0x7ed 0x7ea 0x80e 0x7ff 0x819 0x7f8 0x814 0x7f0 0x7f2 0x7d0 0x7d9 0x7d6 0x7e8 0x7c6 0x7e5 0x7e7 0x7f8 0x7f8 0x816 0x811 0x81c 0x7f7 0x814 0x7f1 0x7f1 0x7d1 0x7dd 0x7d8 0x7e7 0x7bf 0x7db 0x7d8 0x7eb 0x7e6 0x808 0x7ff 0x807 0x7fd 0x825 0x7fa 0x807 0x7de 0x7ec 0x7e6 0x7f6 0x7c9 0x7e8 0x7dd 0x7f7 0x7f1 0x811 0x808 0x808 0x7f0 0x813 0x7ed 0x7fb 0x7d3 0x7df 0x7dd 0x7ea 0x7bf 0x7da 0x7cd 0x7e5 0x7e2 0x800 0x7f5 0x7f6 0x7e7 0x810 0x7f3 0x7fc 0x7d4 0x7e5 0x7dd 0x7e9 0x7c1 0x7e2 0x7da 0x7e9 0x7e6 0x80b 0x7f0 0x7f3 0x74b 0x807 0x751 0x7f9 0x738 0x7e9 0x73e 0x7e5 0x72a 0x7e1 0x739 0x7e7 0x745 0x808 0x74c 0x7ed 0x756 0x76f 0x760 0x769 0x748 0x75b 0x74f 0x758 0x73a 0x754 0x745 0x756 0x750 0x76b 0x753 0x757 0x753 0x769 0x75f 0x76a 0x746 0x758 0x74c 0x756 0x73d 0x757 0x743 0x756 0x74e 0x769 0x74e 0x753 0x712 0x747 0x73b 0x748 0x726 0x739 0x72a 0x738 0x71d 0x73c 0x721 0x738 0x72f 0x74b 0x72a 0x718 0x67f 0x69a 0x6ae 0x756 0x730 0x742 0x734 0x743 0x71f 0x740 0x724 0x738 0x730 0x6ba 0x675 0x67d 0xfffffe01 0xfffffe01 0xfffffe01>;
					PS_Config_Lmt_Open_Rawdata_P = <0x1070 0x10e7 0x1143 0x123e 0x11e7 0x122a 0x11dc 0x1174 0x111b 0x11df 0x11e7 0x120d 0x121f 0x116c 0x10ef 0x10bc 0x1133 0x11bf 0x11e4 0x125d 0x1210 0x124c 0x11ee 0x11bc 0x1133 0x11f1 0x11ff 0x1226 0x1230 0x121e 0x11b8 0x119a 0x11bc 0x11f2 0x1228 0x12bd 0x1277 0x129d 0x128b 0x12a7 0x125d 0x128a 0x1257 0x127e 0x129a 0x124f 0x11f8 0x11dc 0x11e2 0x11eb 0x124b 0x12e9 0x1299 0x12bf 0x12a3 0x12bc 0x1277 0x1284 0x126c 0x1295 0x12a1 0x125b 0x11f8 0x11e4 0x1214 0x125a 0x1273 0x131f 0x12df 0x1308 0x12d5 0x12f7 0x12bd 0x1302 0x12a3 0x12dc 0x12d0 0x1285 0x121b 0x120e 0x121c 0x125b 0x1259 0x1322 0x12ec 0x131f 0x12e0 0x1302 0x12b8 0x12f7 0x1270 0x12cd 0x12b9 0x126f 0x1210 0x11ff 0x122f 0x1270 0x12aa 0x1336 0x1309 0x1344 0x12fc 0x131d 0x12f7 0x1330 0x12e2 0x12fa 0x12d4 0x129f 0x1229 0x121c 0x1229 0x1272 0x12b1 0x130f 0x1318 0x1356 0x1302 0x131e 0x1308 0x1336 0x12ee 0x12ec 0x12cd 0x1292 0x122a 0x1211 0x126f 0x12af 0x12e6 0x1373 0x1364 0x1392 0x134c 0x135d 0x1363 0x1387 0x1340 0x136e 0x1303 0x12cb 0x1269 0x1242 0x127e 0x12b5 0x12ea 0x137f 0x1357 0x139c 0x1353 0x135a 0x136a 0x138b 0x133b 0x1371 0x12e0 0x12bc 0x1253 0x1234 0x127a 0x12c4 0x12f0 0x1395 0x1399 0x1399 0x1363 0x1386 0x137c 0x13b7 0x135c 0x13a3 0x1313 0x12ae 0x125d 0x1249 0x12a1 0x12ed 0x130f 0x13b4 0x13bc 0x13ed 0x1384 0x1399 0x1378 0x13b2 0x135a 0x13aa 0x1316 0x12e0 0x1260 0x1248 0x12bc 0x12fa 0x132f 0x13c6 0x13f0 0x1428 0x138f 0x13b4 0x13a7 0x13d7 0x1394 0x13c5 0x132b 0x12fe 0x1252 0x124c 0x12ae 0x12ee 0x1328 0x13ae 0x13e8 0x1422 0x13b8 0x139c 0x13bf 0x13f0 0x13ad 0x13e9 0x132b 0x1308 0x128c 0x1253 0x12f1 0x132d 0x1363 0x13ec 0x1428 0x1466 0x140c 0x13bc 0x1409 0x1427 0x13d5 0x1419 0x1363 0x131e 0x12b4 0x1248 0x12f3 0x1333 0x135d 0x13de 0x1429 0x1463 0x1419 0x13fb 0x1422 0x1437 0x13ec 0x142e 0x135e 0x131f 0x12ae 0x1268 0x12fc 0x1344 0x1352 0x13de 0x142f 0x147b 0x1413 0x140d 0x143d 0x1464 0x1404 0x1452 0x136f 0x1336 0x12af 0x127c 0x12f7 0x1344 0x1342 0x13d1 0x1429 0x1472 0x1419 0x1413 0x142b 0x1455 0x13f7 0x143a 0x135c 0x1328 0x128e 0x1267 0x1296 0x1272 0x1236 0x123d 0x11e3 0x11fe 0x11f2 0x122d 0x11b1 0x121f 0x1209 0x121a 0x121e 0x1284 0x1285 0x132b 0x129a 0x128f 0x123d 0x1245 0x11f4 0x1211 0x11fe 0x1241 0x11b6 0x1218 0x1215 0x1226 0x122f 0x128e 0x1288 0x1325 0x12a3 0x12aa 0x125a 0x125b 0x120e 0x1228 0x1217 0x1250 0x11dd 0x1246 0x123f 0x1252 0x124f 0x12b9 0x12a7 0x131a 0x12a6 0x12aa 0x125d 0x125d 0x1206 0x1223 0x1218 0x1246 0x11d2 0x1246 0x1248 0x125d 0x125a 0x12b8 0x129a 0x1311 0x12b2 0x12cd 0x126c 0x126c 0x122c 0x123a 0x122a 0x1254 0x11f5 0x1260 0x1252 0x128a 0x127c 0x12c4 0x12ad 0x1311 0x12bd 0x12e0 0x127d 0x128e 0x1234 0x1245 0x123a 0x1262 0x11fb 0x1252 0x124d 0x1280 0x1277 0x12b8 0x12a3 0x12fc 0x12a1 0x12d5 0x1277 0x1280 0x122f 0x1244 0x122f 0x1259 0x120a 0x1269 0x125b 0x128b 0x1285 0x12d8 0x12b6 0x1309 0x12aa 0x12e9 0x1287 0x128f 0x123d 0x1264 0x1245 0x1275 0x1210 0x125a 0x124d 0x127e 0x1279 0x12cb 0x12a8 0x12e5 0x1298 0x12db 0x1285 0x128b 0x123b 0x1250 0x1249 0x1273 0x1223 0x126c 0x1270 0x1298 0x1299 0x12df 0x12d4 0x12ed 0x1296 0x12d9 0x1288 0x1288 0x123e 0x1259 0x124d 0x1270 0x1214 0x1254 0x124f 0x127a 0x126f 0x12bf 0x12aa 0x12bb 0x12a4 0x1302 0x129d 0x12bc 0x125b 0x127c 0x126e 0x1295 0x122a 0x1273 0x125a 0x1296 0x1288 0x12d4 0x12bd 0x12bd 0x1287 0x12d7 0x127e 0x12a0 0x1242 0x125e 0x125a 0x1279 0x1213 0x1253 0x1234 0x126c 0x1265 0x12ab 0x1291 0x1295 0x1272 0x12d1 0x128c 0x12a1 0x1244 0x126c 0x125a 0x1276 0x1218 0x1265 0x1253 0x1276 0x126e 0x12c6 0x1287 0x128e 0x1104 0x12bc 0x1112 0x129a 0x10d8 0x1275 0x10e6 0x126c 0x10b9 0x1264 0x10da 0x1270 0x10f8 0x12bd 0x1107 0x1280 0x111f 0x1158 0x1135 0x114c 0x10ff 0x112a 0x110e 0x1123 0x10dd 0x1119 0x10f8 0x111e 0x1111 0x1150 0x1117 0x1120 0x1118 0x114c 0x1133 0x114d 0x10f9 0x1123 0x1107 0x111f 0x10e4 0x1122 0x10f2 0x111f 0x110b 0x114a 0x110b 0x1117 0x1081 0x10fc 0x10e0 0x10fd 0x10af 0x10da 0x10b7 0x10d8 0x109a 0x10e3 0x10a4 0x10d9 0x10c4 0x1104 0x10b7 0x108f 0xf28 0xf67 0xf96 0x111e 0x10c7 0x10f1 0x10cf 0x10f2 0x109e 0x10eb 0x10a9 0x10d8 0x10c7 0xfb2 0xf12 0xf24 0x1400 0x1400 0x1400>;
					PS_Config_Lmt_Short_Rawdata_N = <0x2774 0x2774 0x2774 0x2774 0x2774 0x2774 0x2774 0x2774 0x2774 0x2774 0x2774 0x2774 0x2774 0x2774 0x2774 0x2774 0x2774 0x2774 0x2774 0x2774 0x2774 0x2774 0x2774 0x2774 0x2774 0x2774 0x2774 0x2774 0x2774 0x2774 0x2774 0x2774 0x2774 0x2774 0x2774 0x2774 0x2774 0x2774 0x2774 0x2774 0x2774 0x2774 0x2774 0x2774 0x2774 0x2774 0x2774 0x2774 0x2774 0x2774 0x2774 0x2774 0x2774 0x2774 0x2774 0x2774 0x2774 0x2774 0x2774 0x2774 0x2774 0x2774 0x2774 0x2774 0x2774 0x2774 0x2774 0x2774 0x2774 0x2774 0x2774 0x2774 0x2774 0x2774 0x2774 0x2774 0x2774 0x2774 0x2774 0x2774 0x2774 0x2774 0x2774 0x2774 0x2774 0x2774 0x2774 0x2774 0x2774 0x2774 0x2774 0x2774 0x2774 0x2774 0x2774 0x2774 0x2774 0x2774 0x2774 0x2774 0x2774 0x2774 0x2774 0x2774 0x2774 0x2774 0x2774 0x2774 0x2774 0x2774 0x2774 0x2774 0x2774 0x2774 0x2774 0x2774 0x2774 0x2774 0x2774 0x2774 0x2774 0x2774 0x2774 0x2774 0x2774 0x2774 0x2774 0x2774 0x2774 0x2774 0x2774 0x2774 0x2774 0x2774 0x2774 0x2774 0x2774 0x2774 0x2774 0x2774 0x2774 0x2774 0x2774 0x2774 0x2774 0x2774 0x2774 0x2774 0x2774 0x2774 0x2774 0x2774 0x2774 0x2774 0x2774 0x2774 0x2774 0x2774 0x2774 0x2774 0x2774 0x2774 0x2774 0x2774 0x2774 0x2774 0x2774 0x2774 0x2774 0x2774 0x2774 0x2774 0x2774 0x2774 0x2774 0x2774 0x2774 0x2774 0x2774 0x2774 0x2774 0x2774 0x2774 0x2774 0x2774 0x2774 0x2774 0x2774 0x2774 0x2774 0x2774 0x2774 0x2774 0x2774 0x2774 0x2774 0x2774 0x2774 0x2774 0x2774 0x2774 0x2774 0x2774 0x2774 0x2774 0x2774 0x2774 0x2774 0x2774 0x2774 0x2774 0x2774 0x2774 0x2774 0x2774 0x2774 0x2774 0x2774 0x2774 0x2774 0x2774 0x2774 0x2774 0x2774 0x2774 0x2774 0x2774 0x2774 0x2774 0x2774 0x2774 0x2774 0x2774 0x2774 0x2774 0x2774 0x2774 0x2774 0x2774 0x2774 0x2774 0x2774 0x2774 0x2774 0x2774 0x2774 0x2774 0x2774 0x2774 0x2774 0x2774 0x2774 0x2774 0x2774 0x2774 0x2774 0x2774 0x2774 0x2774 0x2774 0x2774 0x2774 0x2774 0x2774 0x2774 0x2774 0x2774 0x2774 0x2774 0x2774 0x2774 0x2774 0x2774 0x2774 0x2774 0x2774 0x2774 0x2774 0x2774 0x2774 0x2774 0x2774 0x2774 0x2774 0x2774 0x2774 0x2774 0x2774 0x2774 0x2774 0x2774 0x2774 0x2774 0x2774 0x2774 0x2774 0x2774 0x2774 0x2774 0x2774 0x2774 0x2774 0x2774 0x2774 0x2774 0x2774 0x2774 0x2774 0x2774 0x2774 0x2774 0x2774 0x2774 0x2774 0x2774 0x2774 0x2774 0x2774 0x2774 0x2774 0x2774 0x2774 0x2774 0x2774 0x2774 0x2774 0x2774 0x2774 0x2774 0x2774 0x2774 0x2774 0x2774 0x2774 0x2774 0x2774 0x2774 0x2774 0x2774 0x2774 0x2774 0x2774 0x2774 0x2774 0x2774 0x2774 0x2774 0x2774 0x2774 0x2774 0x2774 0x2774 0x2774 0x2774 0x2774 0x2774 0x2774 0x2774 0x2774 0x2774 0x2774 0x2774 0x2774 0x2774 0x2774 0x2774 0x2774 0x2774 0x2774 0x2774 0x2774 0x2774 0x2774 0x2774 0x2774 0x2774 0x2774 0x2774 0x2774 0x2774 0x2774 0x2774 0x2774 0x2774 0x2774 0x2774 0x2774 0x2774 0x2774 0x2774 0x2774 0x2774 0x2774 0x2774 0x2774 0x2774 0x2774 0x2774 0x2774 0x2774 0x2774 0x2774 0x2774 0x2774 0x2774 0x2774 0x2774 0x2774 0x2774 0x2774 0x2774 0x2774 0x2774 0x2774 0x2774 0x2774 0x2774 0x2774 0x2774 0x2774 0x2774 0x2774 0x2774 0x2774 0x2774 0x2774 0x2774 0x2774 0x2774 0x2774 0x2774 0x2774 0x2774 0x2774 0x2774 0x2774 0x2774 0x2774 0x2774 0x2774 0x2774 0x2774 0x2774 0x2774 0x2774 0x2774 0x2774 0x2774 0x2774 0x2774 0x2774 0x2774 0x2774 0x2774 0x2774 0x2774 0x2774 0x2774 0x2774 0x2774 0x2774 0x2774 0x2774 0x2774 0x2774 0x2774 0x2774 0x2774 0x2774 0x2774 0x2774 0x2774 0x2774 0x2774 0x2774 0x2774 0x2774 0x2774 0x2774 0x2774 0x2774 0x2774 0x2774 0x2774 0x2774 0x2774 0x2774 0x2774 0x2774 0x2774 0x2774 0x2774 0x2774 0x2774 0x2774 0x2774 0x2774 0x2774 0x2774 0x2774 0x2774 0x2774 0x2774 0x2774 0x2774 0x2774 0x2774 0x2774 0x2774 0x2774 0x2774 0x2774 0x2774 0x2774 0x2774 0x2774 0x2774 0x2774 0x2774 0x2774 0x2774 0x2774 0x2774 0x2774 0x2774 0x2774 0x2774 0x2774 0x2774 0x2774 0x2774 0x2774 0x2774 0x2774 0x2774 0x2774 0x2774 0x2774 0x2774 0x2774 0x2774 0x2774 0x2774 0x2774 0x2774 0x2774 0x2774 0x2774 0x2774 0x2774 0x2774 0x2774 0x2774 0x2774 0x2774 0x2774 0x2774 0x2774 0x2774 0x2774 0x2774 0x2774 0x2774 0x2774 0x2774 0x2774 0x2774 0x2774 0x2774 0x2774 0x2774 0x2774 0x2774 0x2774 0x2774 0x2774 0x2710 0x2710 0x2710>;
					PS_Config_Lmt_Short_Rawdata_P = <0x36b8 0x36b8 0x36b8 0x36b8 0x36b8 0x36b8 0x36b8 0x36b8 0x36b8 0x36b8 0x36b8 0x36b8 0x36b8 0x36b8 0x36b8 0x36b8 0x36b8 0x36b8 0x36b8 0x36b8 0x36b8 0x36b8 0x36b8 0x36b8 0x36b8 0x36b8 0x36b8 0x36b8 0x36b8 0x36b8 0x36b8 0x36b8 0x36b8 0x36b8 0x36b8 0x36b8 0x36b8 0x36b8 0x36b8 0x36b8 0x36b8 0x36b8 0x36b8 0x36b8 0x36b8 0x36b8 0x36b8 0x36b8 0x36b8 0x36b8 0x36b8 0x36b8 0x36b8 0x36b8 0x36b8 0x36b8 0x36b8 0x36b8 0x36b8 0x36b8 0x36b8 0x36b8 0x36b8 0x36b8 0x36b8 0x36b8 0x36b8 0x36b8 0x36b8 0x36b8 0x36b8 0x36b8 0x36b8 0x36b8 0x36b8 0x36b8 0x36b8 0x36b8 0x36b8 0x36b8 0x36b8 0x36b8 0x36b8 0x36b8 0x36b8 0x36b8 0x36b8 0x36b8 0x36b8 0x36b8 0x36b8 0x36b8 0x36b8 0x36b8 0x36b8 0x36b8 0x36b8 0x36b8 0x36b8 0x36b8 0x36b8 0x36b8 0x36b8 0x36b8 0x36b8 0x36b8 0x36b8 0x36b8 0x36b8 0x36b8 0x36b8 0x36b8 0x36b8 0x36b8 0x36b8 0x36b8 0x36b8 0x36b8 0x36b8 0x36b8 0x36b8 0x36b8 0x36b8 0x36b8 0x36b8 0x36b8 0x36b8 0x36b8 0x36b8 0x36b8 0x36b8 0x36b8 0x36b8 0x36b8 0x36b8 0x36b8 0x36b8 0x36b8 0x36b8 0x36b8 0x36b8 0x36b8 0x36b8 0x36b8 0x36b8 0x36b8 0x36b8 0x36b8 0x36b8 0x36b8 0x36b8 0x36b8 0x36b8 0x36b8 0x36b8 0x36b8 0x36b8 0x36b8 0x36b8 0x36b8 0x36b8 0x36b8 0x36b8 0x36b8 0x36b8 0x36b8 0x36b8 0x36b8 0x36b8 0x36b8 0x36b8 0x36b8 0x36b8 0x36b8 0x36b8 0x36b8 0x36b8 0x36b8 0x36b8 0x36b8 0x36b8 0x36b8 0x36b8 0x36b8 0x36b8 0x36b8 0x36b8 0x36b8 0x36b8 0x36b8 0x36b8 0x36b8 0x36b8 0x36b8 0x36b8 0x36b8 0x36b8 0x36b8 0x36b8 0x36b8 0x36b8 0x36b8 0x36b8 0x36b8 0x36b8 0x36b8 0x36b8 0x36b8 0x36b8 0x36b8 0x36b8 0x36b8 0x36b8 0x36b8 0x36b8 0x36b8 0x36b8 0x36b8 0x36b8 0x36b8 0x36b8 0x36b8 0x36b8 0x36b8 0x36b8 0x36b8 0x36b8 0x36b8 0x36b8 0x36b8 0x36b8 0x36b8 0x36b8 0x36b8 0x36b8 0x36b8 0x36b8 0x36b8 0x36b8 0x36b8 0x36b8 0x36b8 0x36b8 0x36b8 0x36b8 0x36b8 0x36b8 0x36b8 0x36b8 0x36b8 0x36b8 0x36b8 0x36b8 0x36b8 0x36b8 0x36b8 0x36b8 0x36b8 0x36b8 0x36b8 0x36b8 0x36b8 0x36b8 0x36b8 0x36b8 0x36b8 0x36b8 0x36b8 0x36b8 0x36b8 0x36b8 0x36b8 0x36b8 0x36b8 0x36b8 0x36b8 0x36b8 0x36b8 0x36b8 0x36b8 0x36b8 0x36b8 0x36b8 0x36b8 0x36b8 0x36b8 0x36b8 0x36b8 0x36b8 0x36b8 0x36b8 0x36b8 0x36b8 0x36b8 0x36b8 0x36b8 0x36b8 0x36b8 0x36b8 0x36b8 0x36b8 0x36b8 0x36b8 0x36b8 0x36b8 0x36b8 0x36b8 0x36b8 0x36b8 0x36b8 0x36b8 0x36b8 0x36b8 0x36b8 0x36b8 0x36b8 0x36b8 0x36b8 0x36b8 0x36b8 0x36b8 0x36b8 0x36b8 0x36b8 0x36b8 0x36b8 0x36b8 0x36b8 0x36b8 0x36b8 0x36b8 0x36b8 0x36b8 0x36b8 0x36b8 0x36b8 0x36b8 0x36b8 0x36b8 0x36b8 0x36b8 0x36b8 0x36b8 0x36b8 0x36b8 0x36b8 0x36b8 0x36b8 0x36b8 0x36b8 0x36b8 0x36b8 0x36b8 0x36b8 0x36b8 0x36b8 0x36b8 0x36b8 0x36b8 0x36b8 0x36b8 0x36b8 0x36b8 0x36b8 0x36b8 0x36b8 0x36b8 0x36b8 0x36b8 0x36b8 0x36b8 0x36b8 0x36b8 0x36b8 0x36b8 0x36b8 0x36b8 0x36b8 0x36b8 0x36b8 0x36b8 0x36b8 0x36b8 0x36b8 0x36b8 0x36b8 0x36b8 0x36b8 0x36b8 0x36b8 0x36b8 0x36b8 0x36b8 0x36b8 0x36b8 0x36b8 0x36b8 0x36b8 0x36b8 0x36b8 0x36b8 0x36b8 0x36b8 0x36b8 0x36b8 0x36b8 0x36b8 0x36b8 0x36b8 0x36b8 0x36b8 0x36b8 0x36b8 0x36b8 0x36b8 0x36b8 0x36b8 0x36b8 0x36b8 0x36b8 0x36b8 0x36b8 0x36b8 0x36b8 0x36b8 0x36b8 0x36b8 0x36b8 0x36b8 0x36b8 0x36b8 0x36b8 0x36b8 0x36b8 0x36b8 0x36b8 0x36b8 0x36b8 0x36b8 0x36b8 0x36b8 0x36b8 0x36b8 0x36b8 0x36b8 0x36b8 0x36b8 0x36b8 0x36b8 0x36b8 0x36b8 0x36b8 0x36b8 0x36b8 0x36b8 0x36b8 0x36b8 0x36b8 0x36b8 0x36b8 0x36b8 0x36b8 0x36b8 0x36b8 0x36b8 0x36b8 0x36b8 0x36b8 0x36b8 0x36b8 0x36b8 0x36b8 0x36b8 0x36b8 0x36b8 0x36b8 0x36b8 0x36b8 0x36b8 0x36b8 0x36b8 0x36b8 0x36b8 0x36b8 0x36b8 0x36b8 0x36b8 0x36b8 0x36b8 0x36b8 0x36b8 0x36b8 0x36b8 0x36b8 0x36b8 0x36b8 0x36b8 0x36b8 0x36b8 0x36b8 0x36b8 0x36b8 0x36b8 0x36b8 0x36b8 0x36b8 0x36b8 0x36b8 0x36b8 0x36b8 0x36b8 0x36b8 0x36b8 0x36b8 0x36b8 0x36b8 0x36b8 0x36b8 0x36b8 0x36b8 0x36b8 0x36b8 0x36b8 0x36b8 0x36b8 0x36b8 0x36b8 0x36b8 0x36b8 0x36b8 0x36b8 0x36b8 0x36b8 0x36b8 0x36b8 0x36b8 0x36b8 0x36b8 0x36b8 0x36b8 0x36b8 0x36b8 0x36b8 0x36b8 0x36b8 0x36b8 0x36b8 0x36b8 0x36b8 0x36b8 0x36b8 0x36b8 0x36b8 0x36b8 0x36b8 0x36b8 0x36b8 0x36b8 0x36b8 0x36b8 0x36b8 0x36b8 0x36b8 0x36b8 0x36b8 0x36b8 0x36b8 0x36b8 0x36b8 0x36b8 0x36b8 0x36b8 0x36b8 0x36b8 0x36b8 0x36b8 0x36b8 0x36b8 0x36b8>;
					X_Channel = <0x10>;
					Y_Channel = <0x24>;
					compatible = "novatek-mp-criteria-595E";
				};

				novatek-mp-criteria-595F@0 {
					#address-cells = <0x1>;
					#size-cells = <0x0>;
					AIN_KEY = <0x0 0x1 0x2 0xff>;
					AIN_X = <0x0 0x1 0x2 0x3 0x4 0x5 0x6 0x7 0x8 0x9 0xa 0xb 0xc 0xd 0xe 0xf>;
					AIN_Y = <0x0 0x1 0x2 0x3 0x4 0x5 0x6 0x7 0x8 0x9 0xa 0xb 0xc 0xd 0xe 0xf 0x10 0x11 0x12 0x13 0x14 0x15 0x16 0x17 0x18 0x19 0x1a 0x1b 0x1c 0x1d 0x1e 0x1f 0x20 0x21 0x22 0x23>;
					IC_KEY_CFG_SIZE = <0x4>;
					IC_X_CFG_SIZE = <0x10>;
					IC_Y_CFG_SIZE = <0x24>;
					PS_Config_Diff_Test_Frame = <0x32>;
					PS_Config_Lmt_FW_CC_N = <0x17 0x17 0x17 0x17 0x17 0x17 0x18 0x18 0x18 0x18 0x18 0x18 0x18 0x17 0x17 0x17 0x18 0x17 0x18 0x18 0x17 0x17 0x17 0x18 0x17 0x17 0x17 0x17 0x17 0x17 0x17 0x18 0x18 0x17 0x17 0x17 0x17 0x17 0x17 0x17 0x18 0x17 0x17 0x17 0x17 0x17 0x17 0x18 0x18 0x17 0x18 0x17 0x17 0x17 0x17 0x18 0x17 0x17 0x18 0x17 0x18 0x18 0x17 0x18 0x18 0x17 0x17 0x17 0x17 0x17 0x17 0x17 0x18 0x17 0x17 0x17 0x17 0x17 0x17 0x18 0x18 0x17 0x17 0x17 0x17 0x18 0x18 0x18 0x18 0x18 0x18 0x17 0x18 0x18 0x17 0x18 0x18 0x17 0x17 0x17 0x17 0x17 0x17 0x17 0x18 0x17 0x18 0x18 0x18 0x18 0x18 0x18 0x18 0x18 0x18 0x18 0x18 0x18 0x18 0x18 0x17 0x17 0x17 0x17 0x18 0x18 0x18 0x18 0x18 0x17 0x17 0x17 0x17 0x18 0x18 0x18 0x18 0x18 0x18 0x18 0x18 0x18 0x18 0x18 0x18 0x18 0x18 0x18 0x18 0x18 0x18 0x18 0x18 0x18 0x18 0x18 0x18 0x18 0x18 0x18 0x18 0x17 0x17 0x17 0x17 0x18 0x18 0x18 0x18 0x18 0x18 0x17 0x17 0x17 0x18 0x18 0x18 0x18 0x18 0x18 0x18 0x18 0x18 0x18 0x18 0x18 0x18 0x18 0x18 0x18 0x18 0x18 0x18 0x17 0x17 0x17 0x17 0x18 0x18 0x18 0x18 0x18 0x18 0x18 0x18 0x18 0x17 0x18 0x18 0x17 0x18 0x18 0x18 0x18 0x18 0x18 0x18 0x18 0x18 0x18 0x18 0x18 0x18 0x18 0x18 0x17 0x17 0x18 0x18 0x18 0x18 0x18 0x18 0x18 0x18 0x17 0x18 0x17 0x17 0x18 0x18 0x18 0x18 0x18 0x18 0x18 0x18 0x18 0x18 0x18 0x18 0x17 0x18 0x18 0x17 0x18 0x18 0x17 0x18 0x18 0x18 0x18 0x18 0x18 0x18 0x18 0x18 0x17 0x17 0x17 0x17 0x18 0x18 0x18 0x18 0x18 0x18 0x18 0x18 0x18 0x18 0x18 0x18 0x18 0x18 0x17 0x17 0x18 0x18 0x17 0x17 0x17 0x17 0x17 0x17 0x17 0x18 0x18 0x18 0x18 0x17 0x17 0x17 0x18 0x18 0x18 0x18 0x18 0x18 0x18 0x18 0x18 0x18 0x18 0x18 0x18 0x18 0x18 0x18 0x18 0x18 0x17 0x17 0x17 0x17 0x17 0x17 0x17 0x18 0x18 0x18 0x18 0x18 0x17 0x17 0x18 0x18 0x18 0x18 0x18 0x18 0x18 0x18 0x18 0x18 0x18 0x18 0x18 0x18 0x18 0x18 0x18 0x18 0x17 0x17 0x17 0x17 0x17 0x18 0x18 0x18 0x18 0x18 0x18 0x17 0x17 0x17 0x18 0x18 0x17 0x17 0x17 0x17 0x17 0x18 0x18 0x18 0x18 0x18 0x18 0x18 0x18 0x18 0x18 0x18 0x17 0x17 0x17 0x17 0x17 0x18 0x18 0x18 0x18 0x17 0x18 0x17 0x17 0x17 0x18 0x18 0x18 0x18 0x18 0x18 0x18 0x18 0x18 0x18 0x18 0x17 0x17 0x17 0x17 0x17 0x18 0x18 0x17 0x17 0x17 0x17 0x17 0x18 0x18 0x18 0x18 0x18 0x18 0x18 0x17 0x17 0x18 0x18 0x18 0x18 0x18 0x18 0x18 0x18 0x18 0x18 0x18 0x18 0x18 0x18 0x18 0x18 0x18 0x18 0x17 0x17 0x17 0x17 0x17 0x17 0x18 0x18 0x18 0x18 0x18 0x18 0x17 0x17 0x18 0x18 0x18 0x18 0x18 0x18 0x18 0x18 0x18 0x18 0x18 0x18 0x18 0x18 0x18 0x17 0x18 0x18 0x17 0x17 0x17 0x17 0x17 0x18 0x18 0x18 0x18 0x18 0x18 0x18 0x18 0x17 0x18 0x18 0x17 0x17 0x17 0x18 0x17 0x18 0x18 0x18 0x18 0x18 0x18 0x17 0x17 0x17 0x18 0x18 0x17 0x17 0x17 0x17 0x17 0x17 0x17 0x18 0x18 0x18 0x18 0x17 0x17 0x17 0x18 0x18 0x18 0x18 0x17 0x18 0x18 0x18 0x18 0x18 0x18 0x18 0x17 0x17 0x18 0x17 0x17 0x17 0x17 0x17 0x17 0x17 0x17 0x17 0x17 0x18 0x17 0x17 0x17 0x17 0x17 0x17 0x18 0x18 0x18 0x18 0x18 0x18 0x18 0x18 0x18 0x18 0x18 0x18 0x17 0x17 0x17 0x18 0x18 0x0 0x0 0x0>;
					PS_Config_Lmt_FW_CC_P = <0x34 0x34 0x34 0x34 0x34 0x34 0x35 0x35 0x35 0x35 0x35 0x35 0x35 0x34 0x34 0x34 0x35 0x34 0x35 0x35 0x34 0x34 0x34 0x35 0x34 0x34 0x34 0x34 0x34 0x34 0x34 0x35 0x35 0x34 0x34 0x34 0x34 0x34 0x34 0x34 0x35 0x34 0x34 0x34 0x34 0x34 0x34 0x35 0x35 0x34 0x35 0x34 0x34 0x34 0x34 0x35 0x34 0x34 0x35 0x34 0x35 0x35 0x34 0x35 0x35 0x34 0x34 0x34 0x34 0x34 0x34 0x34 0x35 0x34 0x34 0x34 0x34 0x34 0x34 0x35 0x35 0x34 0x34 0x34 0x34 0x35 0x35 0x35 0x35 0x35 0x35 0x34 0x35 0x35 0x34 0x35 0x35 0x34 0x34 0x34 0x34 0x34 0x34 0x34 0x35 0x34 0x35 0x35 0x35 0x35 0x35 0x35 0x35 0x35 0x35 0x35 0x35 0x35 0x35 0x35 0x34 0x34 0x34 0x34 0x35 0x35 0x35 0x35 0x35 0x34 0x34 0x34 0x34 0x35 0x35 0x35 0x35 0x35 0x35 0x35 0x35 0x35 0x35 0x35 0x35 0x35 0x35 0x35 0x35 0x35 0x35 0x35 0x35 0x35 0x35 0x35 0x35 0x35 0x35 0x35 0x35 0x34 0x34 0x34 0x34 0x35 0x35 0x35 0x35 0x35 0x35 0x34 0x34 0x34 0x35 0x35 0x35 0x35 0x35 0x35 0x35 0x35 0x35 0x37 0x35 0x35 0x35 0x35 0x35 0x35 0x35 0x35 0x35 0x34 0x34 0x34 0x34 0x35 0x35 0x35 0x35 0x35 0x35 0x35 0x35 0x35 0x34 0x35 0x35 0x34 0x35 0x35 0x35 0x35 0x35 0x37 0x35 0x35 0x35 0x35 0x35 0x35 0x35 0x35 0x35 0x34 0x34 0x35 0x35 0x35 0x35 0x35 0x35 0x35 0x35 0x34 0x35 0x34 0x34 0x35 0x35 0x35 0x35 0x35 0x35 0x35 0x35 0x37 0x35 0x35 0x35 0x34 0x35 0x35 0x34 0x35 0x35 0x34 0x35 0x35 0x35 0x35 0x35 0x35 0x35 0x35 0x35 0x34 0x34 0x34 0x34 0x35 0x35 0x35 0x35 0x35 0x35 0x35 0x35 0x37 0x35 0x35 0x35 0x35 0x35 0x34 0x34 0x35 0x35 0x34 0x34 0x34 0x34 0x34 0x34 0x34 0x35 0x35 0x35 0x35 0x34 0x34 0x34 0x35 0x35 0x35 0x35 0x35 0x35 0x35 0x35 0x35 0x35 0x35 0x35 0x35 0x35 0x35 0x35 0x35 0x35 0x34 0x34 0x34 0x34 0x34 0x34 0x34 0x35 0x35 0x35 0x35 0x35 0x34 0x34 0x35 0x35 0x35 0x35 0x35 0x35 0x35 0x35 0x35 0x35 0x35 0x35 0x35 0x35 0x35 0x35 0x35 0x35 0x34 0x34 0x34 0x34 0x34 0x35 0x35 0x35 0x35 0x35 0x35 0x34 0x34 0x34 0x35 0x35 0x34 0x34 0x34 0x34 0x34 0x35 0x35 0x35 0x35 0x35 0x35 0x35 0x35 0x35 0x35 0x35 0x34 0x34 0x34 0x34 0x34 0x35 0x35 0x35 0x35 0x34 0x35 0x34 0x34 0x34 0x35 0x35 0x35 0x35 0x35 0x35 0x35 0x35 0x35 0x35 0x35 0x34 0x34 0x34 0x34 0x34 0x35 0x35 0x34 0x34 0x34 0x34 0x34 0x35 0x35 0x35 0x35 0x35 0x35 0x35 0x34 0x34 0x35 0x35 0x35 0x35 0x35 0x35 0x35 0x35 0x35 0x35 0x35 0x35 0x35 0x35 0x35 0x35 0x35 0x35 0x34 0x34 0x34 0x34 0x34 0x34 0x35 0x35 0x35 0x35 0x35 0x35 0x34 0x34 0x35 0x35 0x35 0x35 0x35 0x35 0x35 0x35 0x35 0x35 0x35 0x35 0x35 0x35 0x35 0x34 0x35 0x35 0x34 0x34 0x34 0x34 0x34 0x35 0x35 0x35 0x35 0x35 0x35 0x35 0x35 0x34 0x35 0x35 0x34 0x34 0x34 0x35 0x34 0x35 0x35 0x35 0x35 0x35 0x35 0x34 0x34 0x34 0x35 0x35 0x34 0x34 0x34 0x34 0x34 0x34 0x34 0x35 0x35 0x35 0x35 0x34 0x34 0x34 0x35 0x35 0x35 0x35 0x34 0x35 0x35 0x35 0x35 0x35 0x35 0x35 0x34 0x34 0x35 0x34 0x34 0x34 0x34 0x34 0x34 0x34 0x34 0x34 0x34 0x35 0x34 0x34 0x34 0x34 0x34 0x34 0x35 0x35 0x35 0x35 0x35 0x35 0x35 0x35 0x35 0x35 0x35 0x35 0x34 0x34 0x34 0x35 0x35 0x13a 0x13a 0x13a>;
					PS_Config_Lmt_FW_Diff_N = <0xffffffce 0xffffffce 0xffffffce 0xffffffce 0xffffffce 0xffffffce 0xffffffce 0xffffffce 0xffffffce 0xffffffce 0xffffffce 0xffffffce 0xffffffce 0xffffffce 0xffffffce 0xffffffce 0xffffffce 0xffffffce 0xffffffce 0xffffffce 0xffffffce 0xffffffce 0xffffffce 0xffffffce 0xffffffce 0xffffffce 0xffffffce 0xffffffce 0xffffffce 0xffffffce 0xffffffce 0xffffffce 0xffffffce 0xffffffce 0xffffffce 0xffffffce 0xffffffce 0xffffffce 0xffffffce 0xffffffce 0xffffffce 0xffffffce 0xffffffce 0xffffffce 0xffffffce 0xffffffce 0xffffffce 0xffffffce 0xffffffce 0xffffffce 0xffffffce 0xffffffce 0xffffffce 0xffffffce 0xffffffce 0xffffffce 0xffffffce 0xffffffce 0xffffffce 0xffffffce 0xffffffce 0xffffffce 0xffffffce 0xffffffce 0xffffffce 0xffffffce 0xffffffce 0xffffffce 0xffffffce 0xffffffce 0xffffffce 0xffffffce 0xffffffce 0xffffffce 0xffffffce 0xffffffce 0xffffffce 0xffffffce 0xffffffce 0xffffffce 0xffffffce 0xffffffce 0xffffffce 0xffffffce 0xffffffce 0xffffffce 0xffffffce 0xffffffce 0xffffffce 0xffffffce 0xffffffce 0xffffffce 0xffffffce 0xffffffce 0xffffffce 0xffffffce 0xffffffce 0xffffffce 0xffffffce 0xffffffce 0xffffffce 0xffffffce 0xffffffce 0xffffffce 0xffffffce 0xffffffce 0xffffffce 0xffffffce 0xffffffce 0xffffffce 0xffffffce 0xffffffce 0xffffffce 0xffffffce 0xffffffce 0xffffffce 0xffffffce 0xffffffce 0xffffffce 0xffffffce 0xffffffce 0xffffffce 0xffffffce 0xffffffce 0xffffffce 0xffffffce 0xffffffce 0xffffffce 0xffffffce 0xffffffce 0xffffffce 0xffffffce 0xffffffce 0xffffffce 0xffffffce 0xffffffce 0xffffffce 0xffffffce 0xffffffce 0xffffffce 0xffffffce 0xffffffce 0xffffffce 0xffffffce 0xffffffce 0xffffffce 0xffffffce 0xffffffce 0xffffffce 0xffffffce 0xffffffce 0xffffffce 0xffffffce 0xffffffce 0xffffffce 0xffffffce 0xffffffce 0xffffffce 0xffffffce 0xffffffce 0xffffffce 0xffffffce 0xffffffce 0xffffffce 0xffffffce 0xffffffce 0xffffffce 0xffffffce 0xffffffce 0xffffffce 0xffffffce 0xffffffce 0xffffffce 0xffffffce 0xffffffce 0xffffffce 0xffffffce 0xffffffce 0xffffffce 0xffffffce 0xffffffce 0xffffffce 0xffffffce 0xffffffce 0xffffffce 0xffffffce 0xffffffce 0xffffffce 0xffffffce 0xffffffce 0xffffffce 0xffffffce 0xffffffce 0xffffffce 0xffffffce 0xffffffce 0xffffffce 0xffffffce 0xffffffce 0xffffffce 0xffffffce 0xffffffce 0xffffffce 0xffffffce 0xffffffce 0xffffffce 0xffffffce 0xffffffce 0xffffffce 0xffffffce 0xffffffce 0xffffffce 0xffffffce 0xffffffce 0xffffffce 0xffffffce 0xffffffce 0xffffffce 0xffffffce 0xffffffce 0xffffffce 0xffffffce 0xffffffce 0xffffffce 0xffffffce 0xffffffce 0xffffffce 0xffffffce 0xffffffce 0xffffffce 0xffffffce 0xffffffce 0xffffffce 0xffffffce 0xffffffce 0xffffffce 0xffffffce 0xffffffce 0xffffffce 0xffffffce 0xffffffce 0xffffffce 0xffffffce 0xffffffce 0xffffffce 0xffffffce 0xffffffce 0xffffffce 0xffffffce 0xffffffce 0xffffffce 0xffffffce 0xffffffce 0xffffffce 0xffffffce 0xffffffce 0xffffffce 0xffffffce 0xffffffce 0xffffffce 0xffffffce 0xffffffce 0xffffffce 0xffffffce 0xffffffce 0xffffffce 0xffffffce 0xffffffce 0xffffffce 0xffffffce 0xffffffce 0xffffffce 0xffffffce 0xffffffce 0xffffffce 0xffffffce 0xffffffce 0xffffffce 0xffffffce 0xffffffce 0xffffffce 0xffffffce 0xffffffce 0xffffffce 0xffffffce 0xffffffce 0xffffffce 0xffffffce 0xffffffce 0xffffffce 0xffffffce 0xffffffce 0xffffffce 0xffffffce 0xffffffce 0xffffffce 0xffffffce 0xffffffce 0xffffffce 0xffffffce 0xffffffce 0xffffffce 0xffffffce 0xffffffce 0xffffffce 0xffffffce 0xffffffce 0xffffffce 0xffffffce 0xffffffce 0xffffffce 0xffffffce 0xffffffce 0xffffffce 0xffffffce 0xffffffce 0xffffffce 0xffffffce 0xffffffce 0xffffffce 0xffffffce 0xffffffce 0xffffffce 0xffffffce 0xffffffce 0xffffffce 0xffffffce 0xffffffce 0xffffffce 0xffffffce 0xffffffce 0xffffffce 0xffffffce 0xffffffce 0xffffffce 0xffffffce 0xffffffce 0xffffffce 0xffffffce 0xffffffce 0xffffffce 0xffffffce 0xffffffce 0xffffffce 0xffffffce 0xffffffce 0xffffffce 0xffffffce 0xffffffce 0xffffffce 0xffffffce 0xffffffce 0xffffffce 0xffffffce 0xffffffce 0xffffffce 0xffffffce 0xffffffce 0xffffffce 0xffffffce 0xffffffce 0xffffffce 0xffffffce 0xffffffce 0xffffffce 0xffffffce 0xffffffce 0xffffffce 0xffffffce 0xffffffce 0xffffffce 0xffffffce 0xffffffce 0xffffffce 0xffffffce 0xffffffce 0xffffffce 0xffffffce 0xffffffce 0xffffffce 0xffffffce 0xffffffce 0xffffffce 0xffffffce 0xffffffce 0xffffffce 0xffffffce 0xffffffce 0xffffffce 0xffffffce 0xffffffce 0xffffffce 0xffffffce 0xffffffce 0xffffffce 0xffffffce 0xffffffce 0xffffffce 0xffffffce 0xffffffce 0xffffffce 0xffffffce 0xffffffce 0xffffffce 0xffffffce 0xffffffce 0xffffffce 0xffffffce 0xffffffce 0xffffffce 0xffffffce 0xffffffce 0xffffffce 0xffffffce 0xffffffce 0xffffffce 0xffffffce 0xffffffce 0xffffffce 0xffffffce 0xffffffce 0xffffffce 0xffffffce 0xffffffce 0xffffffce 0xffffffce 0xffffffce 0xffffffce 0xffffffce 0xffffffce 0xffffffce 0xffffffce 0xffffffce 0xffffffce 0xffffffce 0xffffffce 0xffffffce 0xffffffce 0xffffffce 0xffffffce 0xffffffce 0xffffffce 0xffffffce 0xffffffce 0xffffffce 0xffffffce 0xffffffce 0xffffffce 0xffffffce 0xffffffce 0xffffffce 0xffffffce 0xffffffce 0xffffffce 0xffffffce 0xffffffce 0xffffffce 0xffffffce 0xffffffce 0xffffffce 0xffffffce 0xffffffce 0xffffffce 0xffffffce 0xffffffce 0xffffffce 0xffffffce 0xffffffce 0xffffffce 0xffffffce 0xffffffce 0xffffffce 0xffffffce 0xffffffce 0xffffffce 0xffffffce 0xffffffce 0xffffffce 0xffffffce 0xffffffce 0xffffffce 0xffffffce 0xffffffce 0xffffffce 0xffffffce 0xffffffce 0xffffffce 0xffffffce 0xffffffce 0xffffffce 0xffffffce 0xffffffce 0xffffffce 0xffffffce 0xffffffce 0xffffffce 0xffffffce 0xffffffce 0xffffffce 0xffffffce 0xffffffce 0xffffffce 0xffffffce 0xffffffce 0xffffffce 0xffffffce 0xffffffce 0xffffffce 0xffffffce 0xffffffce 0xffffffce 0xffffffce 0xffffffce 0xffffffce 0xffffffce 0xffffffce 0xffffffce 0xffffffce 0xffffffce 0xffffffce 0xffffffce 0xffffffce 0xffffffce 0xffffffce 0xffffffce 0xffffffce 0xffffffce 0xffffffce 0xffffffce 0xffffffce 0xffffffce 0xffffffce 0xffffffce 0xffffffce 0xffffffce 0xffffffce 0xffffffce 0xffffffce 0xffffffce 0xffffffce 0xffffffce 0xffffffce 0xffffffce 0xffffffce 0xffffffce 0xffffffce 0xffffffce 0xffffffce 0xffffffce 0xffffffce 0xffffffce 0xffffffce 0xffffffce 0xffffffce 0xffffffce 0xffffffce 0xffffffce 0xffffffce 0xffffffce 0xffffffce 0xffffffce 0xffffffce 0xffffffce 0xffffffce 0xffffffce 0xffffffce 0xffffffce 0xffffffce 0xffffffce 0xffffffce 0xffffffce 0xffffffce 0xffffffce 0xffffffce 0xffffffce 0xffffffce 0xffffffb5 0xffffffb5 0xffffffb5>;
					PS_Config_Lmt_FW_Diff_P = <0x32 0x32 0x32 0x32 0x32 0x32 0x32 0x32 0x32 0x32 0x32 0x32 0x32 0x32 0x32 0x32 0x32 0x32 0x32 0x32 0x32 0x32 0x32 0x32 0x32 0x32 0x32 0x32 0x32 0x32 0x32 0x32 0x32 0x32 0x32 0x32 0x32 0x32 0x32 0x32 0x32 0x32 0x32 0x32 0x32 0x32 0x32 0x32 0x32 0x32 0x32 0x32 0x32 0x32 0x32 0x32 0x32 0x32 0x32 0x32 0x32 0x32 0x32 0x32 0x32 0x32 0x32 0x32 0x32 0x32 0x32 0x32 0x32 0x32 0x32 0x32 0x32 0x32 0x32 0x32 0x32 0x32 0x32 0x32 0x32 0x32 0x32 0x32 0x32 0x32 0x32 0x32 0x32 0x32 0x32 0x32 0x32 0x32 0x32 0x32 0x32 0x32 0x32 0x32 0x32 0x32 0x32 0x32 0x32 0x32 0x32 0x32 0x32 0x32 0x32 0x32 0x32 0x32 0x32 0x32 0x32 0x32 0x32 0x32 0x32 0x32 0x32 0x32 0x32 0x32 0x32 0x32 0x32 0x32 0x32 0x32 0x32 0x32 0x32 0x32 0x32 0x32 0x32 0x32 0x32 0x32 0x32 0x32 0x32 0x32 0x32 0x32 0x32 0x32 0x32 0x32 0x32 0x32 0x32 0x32 0x32 0x32 0x32 0x32 0x32 0x32 0x32 0x32 0x32 0x32 0x32 0x32 0x32 0x32 0x32 0x32 0x32 0x32 0x32 0x32 0x32 0x32 0x32 0x32 0x32 0x32 0x32 0x32 0x32 0x32 0x32 0x32 0x32 0x32 0x32 0x32 0x32 0x32 0x32 0x32 0x32 0x32 0x32 0x32 0x32 0x32 0x32 0x32 0x32 0x32 0x32 0x32 0x32 0x32 0x32 0x32 0x32 0x32 0x32 0x32 0x32 0x32 0x32 0x32 0x32 0x32 0x32 0x32 0x32 0x32 0x32 0x32 0x32 0x32 0x32 0x32 0x32 0x32 0x32 0x32 0x32 0x32 0x32 0x32 0x32 0x32 0x32 0x32 0x32 0x32 0x32 0x32 0x32 0x32 0x32 0x32 0x32 0x32 0x32 0x32 0x32 0x32 0x32 0x32 0x32 0x32 0x32 0x32 0x32 0x32 0x32 0x32 0x32 0x32 0x32 0x32 0x32 0x32 0x32 0x32 0x32 0x32 0x32 0x32 0x32 0x32 0x32 0x32 0x32 0x32 0x32 0x32 0x32 0x32 0x32 0x32 0x32 0x32 0x32 0x32 0x32 0x32 0x32 0x32 0x32 0x32 0x32 0x32 0x32 0x32 0x32 0x32 0x32 0x32 0x32 0x32 0x32 0x32 0x32 0x32 0x32 0x32 0x32 0x32 0x32 0x32 0x32 0x32 0x32 0x32 0x32 0x32 0x32 0x32 0x32 0x32 0x32 0x32 0x32 0x32 0x32 0x32 0x32 0x32 0x32 0x32 0x32 0x32 0x32 0x32 0x32 0x32 0x32 0x32 0x32 0x32 0x32 0x32 0x32 0x32 0x32 0x32 0x32 0x32 0x32 0x32 0x32 0x32 0x32 0x32 0x32 0x32 0x32 0x32 0x32 0x32 0x32 0x32 0x32 0x32 0x32 0x32 0x32 0x32 0x32 0x32 0x32 0x32 0x32 0x32 0x32 0x32 0x32 0x32 0x32 0x32 0x32 0x32 0x32 0x32 0x32 0x32 0x32 0x32 0x32 0x32 0x32 0x32 0x32 0x32 0x32 0x32 0x32 0x32 0x32 0x32 0x32 0x32 0x32 0x32 0x32 0x32 0x32 0x32 0x32 0x32 0x32 0x32 0x32 0x32 0x32 0x32 0x32 0x32 0x32 0x32 0x32 0x32 0x32 0x32 0x32 0x32 0x32 0x32 0x32 0x32 0x32 0x32 0x32 0x32 0x32 0x32 0x32 0x32 0x32 0x32 0x32 0x32 0x32 0x32 0x32 0x32 0x32 0x32 0x32 0x32 0x32 0x32 0x32 0x32 0x32 0x32 0x32 0x32 0x32 0x32 0x32 0x32 0x32 0x32 0x32 0x32 0x32 0x32 0x32 0x32 0x32 0x32 0x32 0x32 0x32 0x32 0x32 0x32 0x32 0x32 0x32 0x32 0x32 0x32 0x32 0x32 0x32 0x32 0x32 0x32 0x32 0x32 0x32 0x32 0x32 0x32 0x32 0x32 0x32 0x32 0x32 0x32 0x32 0x32 0x32 0x32 0x32 0x32 0x32 0x32 0x32 0x32 0x32 0x32 0x32 0x32 0x32 0x32 0x32 0x32 0x32 0x32 0x32 0x32 0x32 0x32 0x32 0x32 0x32 0x32 0x32 0x32 0x32 0x32 0x32 0x32 0x32 0x32 0x32 0x32 0x32 0x32 0x32 0x32 0x32 0x32 0x32 0x32 0x32 0x32 0x32 0x32 0x32 0x32 0x32 0x32 0x32 0x32 0x32 0x32 0x4b 0x4b 0x4b>;
					PS_Config_Lmt_FW_Rawdata_N = <0x1d7 0x1d7 0x1dd 0x1e1 0x1e3 0x1e5 0x1e2 0x1dd 0x1e7 0x1da 0x1db 0x1da 0x1dd 0x1de 0x1dc 0x1e1 0x1db 0x1e6 0x1e3 0x1e2 0x1e4 0x1e6 0x1e6 0x1db 0x1e5 0x1e1 0x1e3 0x1e2 0x1e1 0x1e1 0x1e2 0x1dd 0x1d8 0x1e2 0x1df 0x1de 0x1e0 0x1dd 0x1dc 0x1dd 0x1d8 0x1e3 0x1e2 0x1e4 0x1e1 0x1e2 0x1e6 0x1d8 0x1df 0x1e4 0x1de 0x1e1 0x1e1 0x1e0 0x1e1 0x1dd 0x1e6 0x1e6 0x1e3 0x1e4 0x1e1 0x1e3 0x1e3 0x1db 0x1d9 0x1e3 0x1e3 0x1e3 0x1e1 0x1e5 0x1e4 0x1e1 0x1e3 0x1dd 0x1de 0x1dd 0x1dc 0x1da 0x1da 0x1e6 0x1d8 0x1de 0x1e2 0x1e3 0x1e1 0x1e1 0x1e3 0x1d8 0x1dd 0x1dd 0x1db 0x1de 0x1dd 0x1de 0x1dd 0x1de 0x1da 0x1e3 0x1e4 0x1e0 0x1e2 0x1dc 0x1dd 0x1da 0x1de 0x1dd 0x1db 0x1db 0x1dd 0x1de 0x1df 0x1e0 0x1e1 0x1dd 0x1e1 0x1de 0x1df 0x1de 0x1e1 0x1d9 0x1e4 0x1e0 0x1e7 0x1e0 0x1e7 0x1e5 0x1e4 0x1db 0x1d8 0x1e0 0x1dd 0x1d9 0x1d8 0x1db 0x1db 0x1da 0x1db 0x1dd 0x1e3 0x1dc 0x1dd 0x1dd 0x1db 0x1e1 0x1de 0x1e0 0x1e1 0x1e1 0x1e0 0x1d9 0x1da 0x1e6 0x1e1 0x1e0 0x1e2 0x1dd 0x1e0 0x1de 0x1de 0x1e1 0x1e3 0x1e1 0x1de 0x1e1 0x1e0 0x1e2 0x1e1 0x1dc 0x1de 0x1e0 0x1e3 0x1de 0x1e1 0x1e0 0x1df 0x1e0 0x1db 0x1db 0x1da 0x1db 0x1db 0x1de 0x1de 0x1dc 0x1da 0x1df 0x1e0 0x1db 0x1dd 0x1dd 0x1dd 0x1dd 0x1db 0x1da 0x1db 0x1dd 0x1dd 0x1df 0x1de 0x1de 0x1e3 0x1da 0x1d9 0x1e3 0x1df 0x1e1 0x1e4 0x1d8 0x1dd 0x1db 0x1de 0x1dd 0x1de 0x1de 0x1de 0x1de 0x1de 0x1dd 0x1df 0x1da 0x1de 0x1db 0x1db 0x1e1 0x1d5 0x1e4 0x1e0 0x1de 0x1e4 0x1d6 0x1d7 0x1de 0x1e2 0x1dc 0x1db 0x1e0 0x1dd 0x1de 0x1e0 0x1db 0x1dd 0x1da 0x1db 0x1db 0x1dd 0x1e0 0x1e1 0x1e0 0x1da 0x1dc 0x1db 0x1e0 0x1e3 0x1df 0x1e0 0x1da 0x1de 0x1e3 0x1e3 0x1e0 0x1d9 0x1d4 0x1d5 0x1e2 0x1df 0x1dc 0x1de 0x1dd 0x1dd 0x1e0 0x1de 0x1df 0x1de 0x1da 0x1de 0x1dd 0x1e1 0x1de 0x1dd 0x1e1 0x1de 0x1df 0x1e0 0x1e0 0x1de 0x1de 0x1df 0x1e0 0x1d8 0x1e5 0x1e1 0x1e5 0x1e6 0x1dc 0x1dc 0x1e5 0x1d7 0x1d8 0x1da 0x1da 0x1e1 0x1e3 0x1e1 0x1e1 0x1e0 0x1de 0x1dd 0x1dd 0x1de 0x1e0 0x1e0 0x1de 0x1de 0x1e0 0x1e3 0x1d9 0x1d9 0x1d7 0x1d6 0x1e1 0x1e1 0x1e1 0x1de 0x1e1 0x1e0 0x1e4 0x1e3 0x1e2 0x1de 0x1e1 0x1db 0x1d7 0x1d9 0x1da 0x1da 0x1e2 0x1e3 0x1e1 0x1de 0x1e1 0x1df 0x1de 0x1e1 0x1df 0x1db 0x1db 0x1e0 0x1de 0x1de 0x1e0 0x1de 0x1dc 0x1d7 0x1e0 0x1df 0x1e1 0x1de 0x1de 0x1d9 0x1d8 0x1d7 0x1d8 0x1de 0x1e0 0x1e2 0x1e4 0x1e3 0x1dd 0x1da 0x1e3 0x1dd 0x1e2 0x1df 0x1e0 0x1e1 0x1dd 0x1da 0x1da 0x1dd 0x1dd 0x1e0 0x1e0 0x1e1 0x1db 0x1e1 0x1de 0x1d9 0x1dd 0x1da 0x1da 0x1e1 0x1e1 0x1e3 0x1e2 0x1da 0x1db 0x1dd 0x1dc 0x1dc 0x1e1 0x1db 0x1e0 0x1db 0x1de 0x1dc 0x1db 0x1de 0x1e0 0x1db 0x1e0 0x1e6 0x1e6 0x1e6 0x1df 0x1de 0x1e1 0x1e1 0x1d9 0x1d9 0x1d8 0x1da 0x1db 0x1dd 0x1dc 0x1df 0x1de 0x1d8 0x1d7 0x1d9 0x1dc 0x1de 0x1e1 0x1de 0x1e1 0x1e0 0x1e0 0x1e2 0x1e4 0x1e1 0x1dd 0x1e3 0x1e1 0x1db 0x1d8 0x1d8 0x1d7 0x1db 0x1da 0x1dd 0x1dc 0x1dd 0x1dd 0x1de 0x1de 0x1de 0x1e0 0x1db 0x1dc 0x1e3 0x1e3 0x1e1 0x1e1 0x1df 0x1dd 0x1df 0x1dd 0x1db 0x1db 0x1dd 0x1db 0x1e1 0x1e3 0x1da 0x1da 0x1dd 0x1dd 0x1e0 0x1e1 0x1e3 0x1df 0x1db 0x1dd 0x1de 0x1dc 0x1dc 0x1de 0x1e1 0x1de 0x1e0 0x1df 0x1dc 0x1da 0x1df 0x1dd 0x1e0 0x1e1 0x1de 0x1db 0x1dd 0x1de 0x1df 0x1e0 0x1e0 0x1dc 0x1db 0x1da 0x1df 0x1da 0x1e7 0x1e4 0x1e4 0x1da 0x1dc 0x1dc 0x1db 0x1dd 0x1e1 0x1de 0x1e0 0x1df 0x1df 0x1db 0x1db 0x1dd 0x1dd 0x1dd 0x1e0 0x1de 0x1dd 0x1da 0x1d9 0x1de 0x1da 0x1dc 0x1d8 0x1df 0x1de 0x1df 0x1df 0x1df 0x1de 0x1de 0x1dd 0x1dd 0x1d9 0x1de 0x1de 0x1e1 0x1de 0x1de 0x1db 0x1de 0x1de 0x1e4 0x1de 0x1e1 0x1dd 0x1e0 0x1e0 0x1de 0x1e0 0x1da 0x1d8 0x1db 0x1db 0x1db 0x1e0 0x1e0 0x1e7 0x1e7 0x1e7 0x1e0 0x1db 0x1dd 0x1e0 0x1d7 0xf0 0xf0 0xf0>;
					PS_Config_Lmt_FW_Rawdata_P = <0x44c 0x44b 0x459 0x462 0x467 0x46c 0x465 0x45a 0x472 0x452 0x456 0x453 0x459 0x45d 0x457 0x462 0x456 0x46f 0x468 0x465 0x469 0x46e 0x46e 0x454 0x46c 0x462 0x468 0x465 0x464 0x462 0x465 0x459 0x44d 0x465 0x45e 0x45b 0x461 0x45a 0x457 0x459 0x44d 0x468 0x465 0x46b 0x462 0x465 0x46e 0x44f 0x45e 0x469 0x45b 0x464 0x464 0x461 0x462 0x459 0x46e 0x46f 0x467 0x469 0x462 0x468 0x467 0x454 0x450 0x467 0x468 0x467 0x464 0x46c 0x46b 0x462 0x467 0x45a 0x45b 0x459 0x457 0x453 0x453 0x46e 0x44d 0x45d 0x465 0x467 0x462 0x464 0x468 0x44f 0x45a 0x45a 0x454 0x45b 0x459 0x45d 0x45a 0x45b 0x453 0x467 0x46b 0x461 0x465 0x457 0x45a 0x452 0x45b 0x45a 0x456 0x456 0x459 0x45b 0x45e 0x461 0x462 0x459 0x462 0x45d 0x45e 0x45b 0x462 0x450 0x46b 0x460 0x470 0x461 0x470 0x46c 0x46b 0x456 0x44d 0x461 0x45a 0x450 0x44d 0x454 0x454 0x452 0x454 0x459 0x467 0x457 0x459 0x45a 0x456 0x464 0x45b 0x461 0x464 0x462 0x461 0x450 0x453 0x46f 0x462 0x461 0x465 0x459 0x460 0x45b 0x45b 0x462 0x468 0x462 0x45b 0x462 0x461 0x465 0x462 0x457 0x45b 0x460 0x467 0x45b 0x464 0x460 0x45e 0x461 0x456 0x456 0x452 0x454 0x456 0x45d 0x45d 0x457 0x453 0x45e 0x461 0x456 0x45a 0x459 0x459 0x45a 0x456 0x452 0x454 0x459 0x459 0x45e 0x45d 0x45d 0x468 0x452 0x450 0x467 0x45e 0x462 0x469 0x44d 0x45a 0x456 0x45d 0x45a 0x45b 0x45d 0x45d 0x45d 0x45d 0x45a 0x45e 0x453 0x45b 0x456 0x454 0x462 0x448 0x469 0x461 0x45b 0x469 0x449 0x44b 0x45d 0x465 0x457 0x456 0x461 0x459 0x45d 0x460 0x454 0x459 0x453 0x456 0x456 0x459 0x461 0x462 0x460 0x453 0x457 0x454 0x461 0x468 0x45e 0x461 0x453 0x45d 0x468 0x468 0x460 0x450 0x444 0x448 0x465 0x45e 0x457 0x45b 0x45a 0x45a 0x461 0x45d 0x45e 0x45b 0x453 0x45b 0x45a 0x464 0x45b 0x45a 0x462 0x45d 0x45e 0x461 0x460 0x45b 0x45d 0x45e 0x461 0x44f 0x46c 0x464 0x46c 0x46f 0x457 0x457 0x46c 0x44b 0x44f 0x453 0x453 0x464 0x468 0x462 0x464 0x461 0x45d 0x459 0x45a 0x45b 0x461 0x461 0x45d 0x45b 0x460 0x468 0x450 0x450 0x44b 0x449 0x464 0x464 0x462 0x45d 0x464 0x460 0x469 0x467 0x465 0x45b 0x462 0x456 0x44b 0x450 0x452 0x452 0x465 0x467 0x462 0x45b 0x462 0x45e 0x45d 0x462 0x45e 0x456 0x456 0x461 0x45d 0x45b 0x461 0x45d 0x457 0x44c 0x461 0x45e 0x462 0x45d 0x45b 0x450 0x44f 0x44b 0x44d 0x45b 0x461 0x465 0x469 0x468 0x459 0x453 0x467 0x45a 0x465 0x45e 0x461 0x464 0x45a 0x452 0x453 0x459 0x459 0x461 0x461 0x462 0x454 0x464 0x45b 0x450 0x459 0x452 0x452 0x464 0x462 0x468 0x465 0x453 0x454 0x45a 0x457 0x457 0x462 0x454 0x460 0x456 0x45d 0x457 0x456 0x45d 0x460 0x456 0x461 0x46e 0x46e 0x46f 0x45e 0x45b 0x462 0x462 0x450 0x450 0x44f 0x453 0x454 0x459 0x457 0x45e 0x45d 0x44d 0x44b 0x450 0x457 0x45d 0x464 0x45d 0x464 0x460 0x461 0x465 0x46b 0x462 0x459 0x467 0x462 0x454 0x44f 0x44d 0x44b 0x456 0x453 0x45a 0x457 0x45a 0x45a 0x45d 0x45d 0x45d 0x460 0x454 0x457 0x467 0x468 0x462 0x462 0x45e 0x45a 0x45e 0x45a 0x454 0x454 0x459 0x456 0x462 0x467 0x453 0x453 0x45a 0x45a 0x461 0x462 0x467 0x45e 0x456 0x459 0x45b 0x457 0x457 0x45d 0x462 0x45d 0x460 0x45e 0x457 0x453 0x45e 0x45a 0x461 0x462 0x45b 0x456 0x45a 0x45b 0x45e 0x461 0x460 0x457 0x456 0x452 0x45e 0x453 0x472 0x46b 0x46b 0x452 0x457 0x457 0x456 0x459 0x464 0x45d 0x460 0x45e 0x45e 0x454 0x454 0x459 0x45a 0x459 0x461 0x45b 0x45a 0x452 0x450 0x45b 0x452 0x457 0x44f 0x45e 0x45d 0x45e 0x45e 0x45e 0x45b 0x45d 0x45a 0x45a 0x450 0x45d 0x45d 0x464 0x45d 0x45b 0x456 0x45d 0x45d 0x469 0x45b 0x464 0x459 0x461 0x461 0x45b 0x461 0x453 0x44f 0x456 0x456 0x456 0x461 0x461 0x472 0x472 0x472 0x460 0x454 0x459 0x460 0x44c 0xf00 0xf00 0xf00>;
					PS_Config_Lmt_Open_Rawdata_N = <0x4b7 0x4dd 0x527 0x56e 0x585 0x598 0x5b3 0x5bf 0x5a1 0x5a0 0x583 0x571 0x552 0x51f 0x4d3 0x4b5 0x4e3 0x4f7 0x542 0x583 0x598 0x5a6 0x5a4 0x5b8 0x592 0x57c 0x57a 0x56d 0x559 0x52c 0x4e4 0x4cf 0x4ed 0x4fc 0x547 0x598 0x5bf 0x5ce 0x5e6 0x5f8 0x5cc 0x5b8 0x59f 0x58a 0x564 0x532 0x4ec 0x4e0 0x4f5 0x504 0x553 0x5a3 0x5bf 0x5ca 0x5d8 0x5ef 0x5c7 0x5b8 0x5a6 0x595 0x57d 0x54d 0x501 0x4fa 0x4f3 0x505 0x54e 0x5a1 0x5c8 0x5d7 0x5ef 0x602 0x5ce 0x5ba 0x5a3 0x58d 0x568 0x536 0x4f6 0x4eb 0x4ff 0x511 0x559 0x5a3 0x5c3 0x5c7 0x5df 0x5ef 0x5b4 0x5a6 0x598 0x586 0x56d 0x538 0x502 0x4f6 0x506 0x51d 0x56e 0x5b8 0x5e3 0x5f5 0x60f 0x623 0x5e3 0x5d0 0x5b5 0x5a0 0x585 0x552 0x514 0x501 0x507 0x522 0x56f 0x5a9 0x5ca 0x5e0 0x5ef 0x5fd 0x5b7 0x5ac 0x598 0x58c 0x56e 0x555 0x51d 0x50a 0x50e 0x529 0x574 0x5b3 0x5eb 0x5fb 0x612 0x621 0x5d0 0x5bc 0x5a7 0x58d 0x577 0x54d 0x516 0x505 0x51c 0x538 0x585 0x5bf 0x5f4 0x600 0x613 0x61f 0x5c8 0x5b9 0x5a9 0x594 0x585 0x561 0x52c 0x519 0x511 0x531 0x572 0x5c0 0x5f7 0x60a 0x61e 0x62f 0x5e2 0x5d1 0x5b1 0x5a6 0x589 0x559 0x51f 0x513 0x51e 0x540 0x585 0x5c1 0x5f2 0x600 0x60d 0x61e 0x5c2 0x5b5 0x5a3 0x595 0x582 0x55e 0x528 0x51f 0x524 0x53e 0x595 0x5d6 0x618 0x62c 0x641 0x64f 0x5e7 0x5d1 0x5c4 0x5b2 0x594 0x567 0x52b 0x520 0x523 0x548 0x593 0x5c2 0x5fe 0x60a 0x619 0x627 0x5c6 0x5bb 0x5a9 0x59e 0x588 0x56b 0x538 0x52f 0x515 0x543 0x58f 0x5d0 0x613 0x627 0x63a 0x640 0x5d0 0x5d0 0x5bb 0x5a3 0x586 0x562 0x52b 0x526 0x535 0x55e 0x5aa 0x5de 0x620 0x62e 0x640 0x656 0x5df 0x5c9 0x5ba 0x5a7 0x592 0x57c 0x547 0x53d 0x52a 0x553 0x598 0x5d6 0x61e 0x635 0x64d 0x654 0x5d6 0x5cf 0x5b8 0x5a1 0x587 0x564 0x532 0x52e 0x52f 0x559 0x59a 0x5ce 0x612 0x621 0x637 0x64c 0x5cb 0x5bb 0x5a2 0x58f 0x57b 0x566 0x536 0x532 0x508 0x516 0x539 0x573 0x593 0x5aa 0x5c7 0x5da 0x63f 0x630 0x613 0x5fc 0x5b1 0x559 0x521 0x4f8 0x510 0x519 0x53b 0x571 0x588 0x599 0x5ad 0x5bb 0x61f 0x616 0x5fe 0x5f0 0x5b1 0x561 0x52c 0x508 0x507 0x519 0x53b 0x571 0x592 0x5a7 0x5c3 0x5d4 0x630 0x621 0x605 0x5f2 0x5ac 0x55a 0x529 0x500 0x521 0x532 0x557 0x58d 0x5a2 0x5b0 0x5c8 0x5cf 0x62c 0x624 0x60a 0x5fd 0x5c5 0x571 0x53c 0x514 0x50e 0x524 0x547 0x57c 0x5a1 0x5b1 0x5cd 0x5da 0x626 0x61b 0x602 0x5ef 0x5aa 0x55d 0x527 0x502 0x519 0x52b 0x54c 0x580 0x594 0x59f 0x5b8 0x5bd 0x613 0x60e 0x5fa 0x5ea 0x5b6 0x569 0x531 0x513 0x511 0x52e 0x558 0x591 0x5ac 0x5bf 0x5df 0x5ec 0x633 0x62a 0x60b 0x5fa 0x5bf 0x56b 0x52c 0x50c 0x51c 0x534 0x55c 0x589 0x5a0 0x5ad 0x5c4 0x5cb 0x60c 0x608 0x5ee 0x5e2 0x5b2 0x56a 0x52c 0x512 0x510 0x528 0x556 0x58a 0x5aa 0x5bb 0x5da 0x5e6 0x621 0x614 0x5f5 0x5e2 0x5b2 0x561 0x523 0x508 0x522 0x536 0x56a 0x59b 0x5b4 0x5be 0x5d9 0x5e0 0x61b 0x612 0x5f8 0x5ea 0x5c1 0x573 0x531 0x519 0x515 0x52e 0x55f 0x594 0x5b0 0x5c0 0x5df 0x5ec 0x616 0x60a 0x5ed 0x5d9 0x5b0 0x561 0x51b 0x508 0x517 0x529 0x55e 0x590 0x5a5 0x5ad 0x5ca 0x5d0 0x5fb 0x5f7 0x5df 0x5d1 0x5b2 0x56b 0x522 0x514 0x516 0x52f 0x571 0x59d 0x5b8 0x5c8 0x5e9 0x5f7 0x61d 0x612 0x5ef 0x5de 0x5bb 0x570 0x523 0x50f 0x4ed 0x4fa 0x534 0x556 0x570 0x57c 0x58f 0x596 0x5ac 0x5a8 0x58f 0x584 0x56a 0x538 0x4f5 0x4ec 0x4ea 0x4f5 0x534 0x560 0x57e 0x58c 0x5a8 0x5b2 0x5ca 0x5bf 0x5a4 0x594 0x578 0x53b 0x4f2 0x4e9 0x4b6 0x506 0x548 0x571 0x58c 0x595 0x5ae 0x5b3 0x5c9 0x5c2 0x5ac 0x5a1 0x58c 0x550 0x50b 0x4bf 0x4ae 0x4f3 0x538 0x565 0x587 0x596 0x5b0 0x5bb 0x5c7 0x5bd 0x5a3 0x592 0x56e 0x535 0x4ed 0x4b0 0x4c7 0x4f2 0x53e 0x571 0x58a 0x593 0x5b0 0x5b0 0x5b6 0x5b9 0x59b 0x58e 0x576 0x53b 0x4ee 0x4da 0xfffffe01 0xfffffe01 0xfffffe01>;
					PS_Config_Lmt_Open_Rawdata_P = <0xb00 0xb59 0xc06 0xcab 0xce2 0xd0f 0xd4e 0xd68 0xd24 0xd20 0xcde 0xcb4 0xc6b 0xbf3 0xb42 0xafc 0xb68 0xb96 0xc45 0xcde 0xd0f 0xd2f 0xd29 0xd58 0xcff 0xccc 0xcc7 0xcaa 0xc7a 0xc13 0xb6b 0xb3a 0xb80 0xba3 0xc52 0xd0d 0xd68 0xd8b 0xdc5 0xdef 0xd87 0xd59 0xd1e 0xced 0xc95 0xc1f 0xb7c 0xb61 0xb92 0xbb5 0xc6c 0xd28 0xd6a 0xd83 0xda3 0xdda 0xd7b 0xd58 0xd2e 0xd08 0xcd0 0xc5e 0xbad 0xb9d 0xb8c 0xbb6 0xc61 0xd22 0xd7f 0xda2 0xdd8 0xe05 0xd8b 0xd5d 0xd27 0xcf4 0xc9d 0xc29 0xb95 0xb7a 0xbaa 0xbd4 0xc7a 0xd28 0xd72 0xd7c 0xdb4 0xdda 0xd4f 0xd2e 0xd0f 0xce3 0xcaa 0xc2f 0xbb1 0xb93 0xbb9 0xbee 0xcab 0xd59 0xdbc 0xde8 0xe23 0xe52 0xdbe 0xd90 0xd51 0xd21 0xce1 0xc6b 0xbdb 0xbae 0xbbc 0xbfa 0xcae 0xd36 0xd82 0xdb7 0xdda 0xdfa 0xd56 0xd3c 0xd0d 0xcf3 0xcab 0xc71 0xbf0 0xbc2 0xbcd 0xc0c 0xcb9 0xd4c 0xdd0 0xdf6 0xe2a 0xe4e 0xd91 0xd63 0xd30 0xcf4 0xcc2 0xc5e 0xbdf 0xbb8 0xbed 0xc2f 0xce2 0xd6a 0xde4 0xe00 0xe2e 0xe4a 0xd7d 0xd5c 0xd36 0xd05 0xce1 0xc8d 0xc13 0xbe6 0xbd2 0xc1e 0xcb5 0xd6b 0xdeb 0xe17 0xe46 0xe6e 0xdba 0xd92 0xd48 0xd2e 0xcec 0xc7a 0xbf3 0xbd7 0xbf1 0xc40 0xce1 0xd6e 0xde1 0xe00 0xe20 0xe46 0xd6f 0xd51 0xd27 0xd08 0xcda 0xc86 0xc09 0xbf4 0xbff 0xc3d 0xd08 0xd9f 0xe39 0xe67 0xe98 0xeb8 0xdc6 0xd94 0xd75 0xd4a 0xd05 0xc9c 0xc10 0xbf5 0xbfe 0xc53 0xd02 0xd71 0xdfb 0xe19 0xe3a 0xe5c 0xd79 0xd5f 0xd36 0xd1d 0xce9 0xca6 0xc2f 0xc1a 0xbdc 0xc47 0xcf8 0xd90 0xe2c 0xe5b 0xe89 0xe95 0xd91 0xd91 0xd60 0xd28 0xce5 0xc91 0xc10 0xc05 0xc26 0xc86 0xd37 0xdb1 0xe4b 0xe6b 0xe97 0xec9 0xdb4 0xd80 0xd5d 0xd32 0xcff 0xccc 0xc52 0xc39 0xc0d 0xc6c 0xd0d 0xd9e 0xe47 0xe7c 0xeb4 0xec4 0xd9f 0xd8e 0xd58 0xd22 0xce6 0xc95 0xc1f 0xc16 0xc1a 0xc7c 0xd12 0xd8b 0xe2a 0xe4e 0xe80 0xeb3 0xd86 0xd60 0xd25 0xcfa 0xcca 0xc99 0xc29 0xc1f 0xbbd 0xbde 0xc30 0xcb8 0xd02 0xd37 0xd7c 0xda9 0xe93 0xe71 0xe2c 0xdf7 0xd48 0xc7c 0xbf8 0xb99 0xbd0 0xbe6 0xc34 0xcb4 0xce9 0xd10 0xd3e 0xd5f 0xe4a 0xe33 0xdfd 0xddb 0xd48 0xc8e 0xc11 0xbbd 0xbbb 0xbe6 0xc34 0xcb4 0xcff 0xd30 0xd72 0xd99 0xe70 0xe4d 0xe0c 0xddf 0xd3d 0xc7d 0xc0c 0xbab 0xbf8 0xc21 0xc76 0xcf4 0xd25 0xd45 0xd7f 0xd8e 0xe67 0xe54 0xe19 0xdfa 0xd76 0xcb4 0xc37 0xbdb 0xbcd 0xbff 0xc52 0xccd 0xd22 0xd48 0xd8a 0xda7 0xe59 0xe40 0xe05 0xdda 0xd37 0xc84 0xc06 0xbb1 0xbe5 0xc0f 0xc5c 0xcd7 0xd05 0xd1e 0xd58 0xd64 0xe2c 0xe21 0xdf3 0xdcd 0xd53 0xca0 0xc1e 0xbd7 0xbd4 0xc16 0xc79 0xcfd 0xd3d 0xd6a 0xdb3 0xdd3 0xe77 0xe62 0xe1a 0xdf2 0xd68 0xca4 0xc11 0xbc7 0xbed 0xc24 0xc81 0xcec 0xd20 0xd40 0xd74 0xd86 0xe1c 0xe13 0xdd7 0xdba 0xd4b 0xca2 0xc13 0xbd5 0xbd0 0xc08 0xc75 0xced 0xd39 0xd5f 0xda9 0xdc5 0xe4d 0xe2f 0xde6 0xdba 0xd4a 0xc8d 0xbfc 0xbbf 0xbfa 0xc29 0xca2 0xd16 0xd4f 0xd66 0xda6 0xdb7 0xe3f 0xe2a 0xdef 0xdcd 0xd6e 0xcb8 0xc1e 0xbe5 0xbdc 0xc16 0xc88 0xd04 0xd45 0xd6b 0xdb4 0xdd1 0xe33 0xe19 0xdd4 0xda6 0xd47 0xc8d 0xbea 0xbbd 0xbe2 0xc0c 0xc87 0xcfb 0xd2c 0xd40 0xd82 0xd90 0xdf6 0xdec 0xdb3 0xd92 0xd4a 0xca6 0xbfb 0xbd9 0xbdf 0xc1a 0xcb4 0xd19 0xd58 0xd7d 0xdcc 0xdeb 0xe44 0xe2a 0xdd8 0xdb1 0xd5f 0xcb1 0xbfc 0xbce 0xb7e 0xb9d 0xc24 0xc73 0xcb0 0xccc 0xcf8 0xd09 0xd3d 0xd33 0xcf8 0xcdf 0xca3 0xc2f 0xb91 0xb7d 0xb77 0xb91 0xc25 0xc8b 0xcd1 0xcf3 0xd33 0xd4b 0xd82 0xd6a 0xd2b 0xd04 0xcc3 0xc34 0xb8a 0xb75 0xafe 0xbb9 0xc53 0xcb4 0xcf1 0xd08 0xd41 0xd4e 0xd80 0xd6f 0xd3d 0xd24 0xcf3 0xc67 0xbc4 0xb13 0xaeb 0xb8e 0xc2d 0xc96 0xce6 0xd09 0xd45 0xd5f 0xd7b 0xd64 0xd28 0xcff 0xcad 0xc26 0xb7e 0xaf0 0xb26 0xb8a 0xc3b 0xcb2 0xced 0xd02 0xd45 0xd47 0xd53 0xd5a 0xd14 0xcf6 0xcbf 0xc34 0xb81 0xb52 0x1400 0x1400 0x1400>;
					PS_Config_Lmt_Short_Rawdata_N = <0x2774 0x2774 0x2774 0x2774 0x2774 0x2774 0x2774 0x2774 0x2774 0x2774 0x2774 0x2774 0x2774 0x2774 0x2774 0x2774 0x2774 0x2774 0x2774 0x2774 0x2774 0x2774 0x2774 0x2774 0x2774 0x2774 0x2774 0x2774 0x2774 0x2774 0x2774 0x2774 0x2774 0x2774 0x2774 0x2774 0x2774 0x2774 0x2774 0x2774 0x2774 0x2774 0x2774 0x2774 0x2774 0x2774 0x2774 0x2774 0x2774 0x2774 0x2774 0x2774 0x2774 0x2774 0x2774 0x2774 0x2774 0x2774 0x2774 0x2774 0x2774 0x2774 0x2774 0x2774 0x2774 0x2774 0x2774 0x2774 0x2774 0x2774 0x2774 0x2774 0x2774 0x2774 0x2774 0x2774 0x2774 0x2774 0x2774 0x2774 0x2774 0x2774 0x2774 0x2774 0x2774 0x2774 0x2774 0x2774 0x2774 0x2774 0x2774 0x2774 0x2774 0x2774 0x2774 0x2774 0x2774 0x2774 0x2774 0x2774 0x2774 0x2774 0x2774 0x2774 0x2774 0x2774 0x2774 0x2774 0x2774 0x2774 0x2774 0x2774 0x2774 0x2774 0x2774 0x2774 0x2774 0x2774 0x2774 0x2774 0x2774 0x2774 0x2774 0x2774 0x2774 0x2774 0x2774 0x2774 0x2774 0x2774 0x2774 0x2774 0x2774 0x2774 0x2774 0x2774 0x2774 0x2774 0x2774 0x2774 0x2774 0x2774 0x2774 0x2774 0x2774 0x2774 0x2774 0x2774 0x2774 0x2774 0x2774 0x2774 0x2774 0x2774 0x2774 0x2774 0x2774 0x2774 0x2774 0x2774 0x2774 0x2774 0x2774 0x2774 0x2774 0x2774 0x2774 0x2774 0x2774 0x2774 0x2774 0x2774 0x2774 0x2774 0x2774 0x2774 0x2774 0x2774 0x2774 0x2774 0x2774 0x2774 0x2774 0x2774 0x2774 0x2774 0x2774 0x2774 0x2774 0x2774 0x2774 0x2774 0x2774 0x2774 0x2774 0x2774 0x2774 0x2774 0x2774 0x2774 0x2774 0x2774 0x2774 0x2774 0x2774 0x2774 0x2774 0x2774 0x2774 0x2774 0x2774 0x2774 0x2774 0x2774 0x2774 0x2774 0x2774 0x2774 0x2774 0x2774 0x2774 0x2774 0x2774 0x2774 0x2774 0x2774 0x2774 0x2774 0x2774 0x2774 0x2774 0x2774 0x2774 0x2774 0x2774 0x2774 0x2774 0x2774 0x2774 0x2774 0x2774 0x2774 0x2774 0x2774 0x2774 0x2774 0x2774 0x2774 0x2774 0x2774 0x2774 0x2774 0x2774 0x2774 0x2774 0x2774 0x2774 0x2774 0x2774 0x2774 0x2774 0x2774 0x2774 0x2774 0x2774 0x2774 0x2774 0x2774 0x2774 0x2774 0x2774 0x2774 0x2774 0x2774 0x2774 0x2774 0x2774 0x2774 0x2774 0x2774 0x2774 0x2774 0x2774 0x2774 0x2774 0x2774 0x2774 0x2774 0x2774 0x2774 0x2774 0x2774 0x2774 0x2774 0x2774 0x2774 0x2774 0x2774 0x2774 0x2774 0x2774 0x2774 0x2774 0x2774 0x2774 0x2774 0x2774 0x2774 0x2774 0x2774 0x2774 0x2774 0x2774 0x2774 0x2774 0x2774 0x2774 0x2774 0x2774 0x2774 0x2774 0x2774 0x2774 0x2774 0x2774 0x2774 0x2774 0x2774 0x2774 0x2774 0x2774 0x2774 0x2774 0x2774 0x2774 0x2774 0x2774 0x2774 0x2774 0x2774 0x2774 0x2774 0x2774 0x2774 0x2774 0x2774 0x2774 0x2774 0x2774 0x2774 0x2774 0x2774 0x2774 0x2774 0x2774 0x2774 0x2774 0x2774 0x2774 0x2774 0x2774 0x2774 0x2774 0x2774 0x2774 0x2774 0x2774 0x2774 0x2774 0x2774 0x2774 0x2774 0x2774 0x2774 0x2774 0x2774 0x2774 0x2774 0x2774 0x2774 0x2774 0x2774 0x2774 0x2774 0x2774 0x2774 0x2774 0x2774 0x2774 0x2774 0x2774 0x2774 0x2774 0x2774 0x2774 0x2774 0x2774 0x2774 0x2774 0x2774 0x2774 0x2774 0x2774 0x2774 0x2774 0x2774 0x2774 0x2774 0x2774 0x2774 0x2774 0x2774 0x2774 0x2774 0x2774 0x2774 0x2774 0x2774 0x2774 0x2774 0x2774 0x2774 0x2774 0x2774 0x2774 0x2774 0x2774 0x2774 0x2774 0x2774 0x2774 0x2774 0x2774 0x2774 0x2774 0x2774 0x2774 0x2774 0x2774 0x2774 0x2774 0x2774 0x2774 0x2774 0x2774 0x2774 0x2774 0x2774 0x2774 0x2774 0x2774 0x2774 0x2774 0x2774 0x2774 0x2774 0x2774 0x2774 0x2774 0x2774 0x2774 0x2774 0x2774 0x2774 0x2774 0x2774 0x2774 0x2774 0x2774 0x2774 0x2774 0x2774 0x2774 0x2774 0x2774 0x2774 0x2774 0x2774 0x2774 0x2774 0x2774 0x2774 0x2774 0x2774 0x2774 0x2774 0x2774 0x2774 0x2774 0x2774 0x2774 0x2774 0x2774 0x2774 0x2774 0x2774 0x2774 0x2774 0x2774 0x2774 0x2774 0x2774 0x2774 0x2774 0x2774 0x2774 0x2774 0x2774 0x2774 0x2774 0x2774 0x2774 0x2774 0x2774 0x2774 0x2774 0x2774 0x2774 0x2774 0x2774 0x2774 0x2774 0x2774 0x2774 0x2774 0x2774 0x2774 0x2774 0x2774 0x2774 0x2774 0x2774 0x2774 0x2774 0x2774 0x2774 0x2774 0x2774 0x2774 0x2774 0x2774 0x2774 0x2774 0x2774 0x2774 0x2774 0x2774 0x2774 0x2774 0x2774 0x2774 0x2774 0x2774 0x2774 0x2774 0x2774 0x2774 0x2774 0x2774 0x2774 0x2774 0x2774 0x2774 0x2774 0x2774 0x2774 0x2774 0x2774 0x2774 0x2774 0x2774 0x2774 0x2774 0x2774 0x2774 0x2774 0x2710 0x2710 0x2710>;
					PS_Config_Lmt_Short_Rawdata_P = <0x36b8 0x36b8 0x36b8 0x36b8 0x36b8 0x36b8 0x36b8 0x36b8 0x36b8 0x36b8 0x36b8 0x36b8 0x36b8 0x36b8 0x36b8 0x36b8 0x36b8 0x36b8 0x36b8 0x36b8 0x36b8 0x36b8 0x36b8 0x36b8 0x36b8 0x36b8 0x36b8 0x36b8 0x36b8 0x36b8 0x36b8 0x36b8 0x36b8 0x36b8 0x36b8 0x36b8 0x36b8 0x36b8 0x36b8 0x36b8 0x36b8 0x36b8 0x36b8 0x36b8 0x36b8 0x36b8 0x36b8 0x36b8 0x36b8 0x36b8 0x36b8 0x36b8 0x36b8 0x36b8 0x36b8 0x36b8 0x36b8 0x36b8 0x36b8 0x36b8 0x36b8 0x36b8 0x36b8 0x36b8 0x36b8 0x36b8 0x36b8 0x36b8 0x36b8 0x36b8 0x36b8 0x36b8 0x36b8 0x36b8 0x36b8 0x36b8 0x36b8 0x36b8 0x36b8 0x36b8 0x36b8 0x36b8 0x36b8 0x36b8 0x36b8 0x36b8 0x36b8 0x36b8 0x36b8 0x36b8 0x36b8 0x36b8 0x36b8 0x36b8 0x36b8 0x36b8 0x36b8 0x36b8 0x36b8 0x36b8 0x36b8 0x36b8 0x36b8 0x36b8 0x36b8 0x36b8 0x36b8 0x36b8 0x36b8 0x36b8 0x36b8 0x36b8 0x36b8 0x36b8 0x36b8 0x36b8 0x36b8 0x36b8 0x36b8 0x36b8 0x36b8 0x36b8 0x36b8 0x36b8 0x36b8 0x36b8 0x36b8 0x36b8 0x36b8 0x36b8 0x36b8 0x36b8 0x36b8 0x36b8 0x36b8 0x36b8 0x36b8 0x36b8 0x36b8 0x36b8 0x36b8 0x36b8 0x36b8 0x36b8 0x36b8 0x36b8 0x36b8 0x36b8 0x36b8 0x36b8 0x36b8 0x36b8 0x36b8 0x36b8 0x36b8 0x36b8 0x36b8 0x36b8 0x36b8 0x36b8 0x36b8 0x36b8 0x36b8 0x36b8 0x36b8 0x36b8 0x36b8 0x36b8 0x36b8 0x36b8 0x36b8 0x36b8 0x36b8 0x36b8 0x36b8 0x36b8 0x36b8 0x36b8 0x36b8 0x36b8 0x36b8 0x36b8 0x36b8 0x36b8 0x36b8 0x36b8 0x36b8 0x36b8 0x36b8 0x36b8 0x36b8 0x36b8 0x36b8 0x36b8 0x36b8 0x36b8 0x36b8 0x36b8 0x36b8 0x36b8 0x36b8 0x36b8 0x36b8 0x36b8 0x36b8 0x36b8 0x36b8 0x36b8 0x36b8 0x36b8 0x36b8 0x36b8 0x36b8 0x36b8 0x36b8 0x36b8 0x36b8 0x36b8 0x36b8 0x36b8 0x36b8 0x36b8 0x36b8 0x36b8 0x36b8 0x36b8 0x36b8 0x36b8 0x36b8 0x36b8 0x36b8 0x36b8 0x36b8 0x36b8 0x36b8 0x36b8 0x36b8 0x36b8 0x36b8 0x36b8 0x36b8 0x36b8 0x36b8 0x36b8 0x36b8 0x36b8 0x36b8 0x36b8 0x36b8 0x36b8 0x36b8 0x36b8 0x36b8 0x36b8 0x36b8 0x36b8 0x36b8 0x36b8 0x36b8 0x36b8 0x36b8 0x36b8 0x36b8 0x36b8 0x36b8 0x36b8 0x36b8 0x36b8 0x36b8 0x36b8 0x36b8 0x36b8 0x36b8 0x36b8 0x36b8 0x36b8 0x36b8 0x36b8 0x36b8 0x36b8 0x36b8 0x36b8 0x36b8 0x36b8 0x36b8 0x36b8 0x36b8 0x36b8 0x36b8 0x36b8 0x36b8 0x36b8 0x36b8 0x36b8 0x36b8 0x36b8 0x36b8 0x36b8 0x36b8 0x36b8 0x36b8 0x36b8 0x36b8 0x36b8 0x36b8 0x36b8 0x36b8 0x36b8 0x36b8 0x36b8 0x36b8 0x36b8 0x36b8 0x36b8 0x36b8 0x36b8 0x36b8 0x36b8 0x36b8 0x36b8 0x36b8 0x36b8 0x36b8 0x36b8 0x36b8 0x36b8 0x36b8 0x36b8 0x36b8 0x36b8 0x36b8 0x36b8 0x36b8 0x36b8 0x36b8 0x36b8 0x36b8 0x36b8 0x36b8 0x36b8 0x36b8 0x36b8 0x36b8 0x36b8 0x36b8 0x36b8 0x36b8 0x36b8 0x36b8 0x36b8 0x36b8 0x36b8 0x36b8 0x36b8 0x36b8 0x36b8 0x36b8 0x36b8 0x36b8 0x36b8 0x36b8 0x36b8 0x36b8 0x36b8 0x36b8 0x36b8 0x36b8 0x36b8 0x36b8 0x36b8 0x36b8 0x36b8 0x36b8 0x36b8 0x36b8 0x36b8 0x36b8 0x36b8 0x36b8 0x36b8 0x36b8 0x36b8 0x36b8 0x36b8 0x36b8 0x36b8 0x36b8 0x36b8 0x36b8 0x36b8 0x36b8 0x36b8 0x36b8 0x36b8 0x36b8 0x36b8 0x36b8 0x36b8 0x36b8 0x36b8 0x36b8 0x36b8 0x36b8 0x36b8 0x36b8 0x36b8 0x36b8 0x36b8 0x36b8 0x36b8 0x36b8 0x36b8 0x36b8 0x36b8 0x36b8 0x36b8 0x36b8 0x36b8 0x36b8 0x36b8 0x36b8 0x36b8 0x36b8 0x36b8 0x36b8 0x36b8 0x36b8 0x36b8 0x36b8 0x36b8 0x36b8 0x36b8 0x36b8 0x36b8 0x36b8 0x36b8 0x36b8 0x36b8 0x36b8 0x36b8 0x36b8 0x36b8 0x36b8 0x36b8 0x36b8 0x36b8 0x36b8 0x36b8 0x36b8 0x36b8 0x36b8 0x36b8 0x36b8 0x36b8 0x36b8 0x36b8 0x36b8 0x36b8 0x36b8 0x36b8 0x36b8 0x36b8 0x36b8 0x36b8 0x36b8 0x36b8 0x36b8 0x36b8 0x36b8 0x36b8 0x36b8 0x36b8 0x36b8 0x36b8 0x36b8 0x36b8 0x36b8 0x36b8 0x36b8 0x36b8 0x36b8 0x36b8 0x36b8 0x36b8 0x36b8 0x36b8 0x36b8 0x36b8 0x36b8 0x36b8 0x36b8 0x36b8 0x36b8 0x36b8 0x36b8 0x36b8 0x36b8 0x36b8 0x36b8 0x36b8 0x36b8 0x36b8 0x36b8 0x36b8 0x36b8 0x36b8 0x36b8 0x36b8 0x36b8 0x36b8 0x36b8 0x36b8 0x36b8 0x36b8 0x36b8 0x36b8 0x36b8 0x36b8 0x36b8 0x36b8 0x36b8 0x36b8 0x36b8 0x36b8 0x36b8 0x36b8 0x36b8 0x36b8 0x36b8 0x36b8 0x36b8 0x36b8 0x36b8 0x36b8 0x36b8 0x36b8 0x36b8 0x36b8 0x36b8 0x36b8 0x36b8 0x36b8 0x36b8 0x36b8 0x36b8 0x36b8 0x36b8 0x36b8 0x36b8 0x36b8 0x36b8 0x36b8 0x36b8 0x36b8 0x36b8 0x36b8 0x36b8 0x36b8 0x36b8 0x36b8 0x36b8 0x36b8 0x36b8 0x36b8 0x36b8 0x36b8 0x36b8 0x36b8 0x36b8 0x36b8 0x36b8 0x36b8 0x36b8 0x36b8 0x36b8 0x36b8 0x36b8 0x36b8 0x36b8>;
					X_Channel = <0x10>;
					Y_Channel = <0x24>;
					compatible = "novatek-mp-criteria-595F";
				};
			};
		};
	};

	fragment@15 {
		target = <0xffffffff>;

		__overlay__ {

			pins_default {
				phandle = <0xf>;
			};

			spimode_default {
				phandle = <0x10>;

				pins_cmd_dat {
					drive-strength = <0x2>;
					pinmux = <0x1e01 0x1d01 0x1b01 0x1c01>;
				};
			};
		};
	};

	fragment@16 {
		target = <0xffffffff>;

		__overlay__ {
			accdet-mic-mode = <0x2>;
			accdet-mic-vol = <0x8>;
			accdet-plugout-debounce = <0x1>;
			eint_use_ext_res = <0x0>;
			headset-four-key-threshold = <0x0 0x3a 0x79 0xc0 0x190>;
			headset-mode-setting = <0x500 0x500 0x1 0x1f0 0x800 0x800 0x20 0x44 0x4 0x1 0x5 0x3 0x3 0x5 0xe>;
			headset-three-key-threshold = <0x0 0x50 0xdc 0x190>;
			headset-three-key-threshold-CDD = <0x0 0x79 0xc0 0x258>;
			status = "okay";
		};
	};

	fragment@17 {
		target = <0xffffffff>;

		__overlay__ {

			led@0 {
				compatible = "mediatek,red";
				data = <0x1>;
				led_mode = <0x0>;
				phandle = <0x4d>;
				pwm_config = <0x0 0x0 0x0 0x0 0x0>;
			};

			led@1 {
				compatible = "mediatek,green";
				data = <0x1>;
				led_mode = <0x0>;
				phandle = <0x4e>;
				pwm_config = <0x0 0x0 0x0 0x0 0x0>;
			};

			led@2 {
				compatible = "mediatek,blue";
				data = <0x1>;
				led_mode = <0x0>;
				phandle = <0x4f>;
				pwm_config = <0x0 0x0 0x0 0x0 0x0>;
			};

			led@3 {
				compatible = "mediatek,jogball-backlight";
				data = <0x1>;
				led_mode = <0x0>;
				phandle = <0x50>;
				pwm_config = <0x0 0x0 0x0 0x0 0x0>;
			};

			led@4 {
				compatible = "mediatek,keyboard-backlight";
				data = <0x1>;
				led_mode = <0x0>;
				phandle = <0x51>;
				pwm_config = <0x0 0x0 0x0 0x0 0x0>;
			};

			led@5 {
				compatible = "mediatek,button-backlight";
				data = <0x1>;
				led_mode = <0x0>;
				phandle = <0x52>;
				pwm_config = <0x0 0x0 0x0 0x0 0x0>;
			};

			led@6 {
				compatible = "mediatek,lcd-backlight";
				data = <0x1>;
				led_mode = <0x4>;
				phandle = <0x53>;
			};

			vibrator@0 {
				compatible = "mediatek,vibrator";
				phandle = <0x54>;
				vib_limit = <0x9>;
				vib_timer = <0x19>;
				vib_vol = <0x9>;
			};
		};
	};

	fragment@18 {
		target = <0xffffffff>;

		__overlay__ {
			clock-frequency = <0x61a80>;
			mediatek,use-open-drain;
			status = "okay";

			st21nfc@8 {
				compatible = "mediatek,nfc-gpio-v2";
				gpio-irq = <0x5>;
				gpio-irq-std = <0xffffffff 0x5 0x0>;
				gpio-rst = <0x5c>;
				gpio-rst-std = <0xffffffff 0x5c 0x0>;
				phandle = <0x55>;
				reg = <0x8>;
				status = "okay";
			};
		};
	};

	fragment@19 {
		target = <0xffffffff>;

		__overlay__ {

			gps_default {
				phandle = <0x13>;
			};

			gps_l1_lna@0 {
				phandle = <0x14>;

				pins_cmd_dat {
					output-low;
					pinmux = <0x8c00>;
				};
			};

			gps_l1_lna@1 {
				phandle = <0x15>;

				pins_cmd_dat {
					pinmux = <0x8c01>;
				};
			};

			gps_l1_lna@2 {
				phandle = <0x16>;

				pins_cmd_dat {
					output-high;
					pinmux = <0x8c00>;
				};
			};

			gps_l5_lna@0 {
				phandle = <0x17>;

				pins_cmd_dat {
					output-low;
					pinmux = <0x5b00>;
				};
			};

			gps_l5_lna@1 {
				phandle = <0x18>;

				pins_cmd_dat {
					pinmux = <0x5b04>;
				};
			};

			gps_l5_lna@2 {
				phandle = <0x19>;

				pins_cmd_dat {
					output-high;
					pinmux = <0x5b00>;
				};
			};
		};
	};

	fragment@2 {
		target = <0xffffffff>;

		__overlay__ {
			mt6360,intr_gpio = <0xffffffff 0xa 0x0>;
			mt6360,intr_gpio_num = <0xa>;
		};
	};

	fragment@20 {
		target = <0xffffffff>;

		__overlay__ {
			pinctrl-0 = <0x13>;
			pinctrl-1 = <0x14>;
			pinctrl-2 = <0x15>;
			pinctrl-3 = <0x16>;
			pinctrl-4 = <0x17>;
			pinctrl-5 = <0x18>;
			pinctrl-6 = <0x19>;
			pinctrl-names = "default", "gps_l1_lna_disable", "gps_l1_lna_dsp_ctrl", "gps_l1_lna_enable", "gps_l5_lna_disable", "gps_l5_lna_dsp_ctrl", "gps_l5_lna_enable";
			status = "okay";
		};
	};

	fragment@21 {
		target = <0xffffffff>;

		__overlay__ {

			fpsensor_fpc_rst_high {
				phandle = <0x1b>;

				pins_cmd_dat {
					output-high;
					pinmux = <0x1100>;
					slew-rate = <0x1>;
				};
			};

			fpsensor_fpc_rst_low {
				phandle = <0x1a>;

				pins_cmd_dat {
					output-low;
					pinmux = <0x1100>;
					slew-rate = <0x1>;
				};
			};
		};
	};

	fragment@22 {
		target = <0xffffffff>;

		__overlay__ {

			fpsensor_goodix_rst_high {
				phandle = <0x1d>;

				pins_cmd_dat {
					output-high;
					pinmux = <0x1100>;
					slew-rate = <0x1>;
				};
			};

			fpsensor_goodix_rst_low {
				phandle = <0x1c>;

				pins_cmd_dat {
					output-low;
					pinmux = <0x1100>;
					slew-rate = <0x1>;
				};
			};
		};
	};

	fragment@23 {
		target = <0xffffffff>;

		__overlay__ {

			fpc_spi@0 {
				compatible = "fpc,fpc_spi";
				fpc,enable-wakeup;
				netlink-event = <0x1f>;
				pinctrl-0 = <0x1a>;
				pinctrl-1 = <0x1b>;
				pinctrl-names = "fpsensor_fpc_rst_low", "fpsensor_fpc_rst_high";
				reg = <0x0>;
				spi-max-frequency = <0x989680>;
				status = "okay";
				vfp-supply = <0xffffffff>;
			};
		};
	};

	fragment@24 {
		target = <0xffffffff>;

		__overlay__ {
			int-gpios = <0xffffffff 0x12 0x0>;
			interrupt-parent = <0xffffffff>;
			interrupts = <0x12 0x1 0x12 0x0>;
			pinctrl-0 = <0x1c>;
			pinctrl-1 = <0x1d>;
			pinctrl-names = "fpsensor_goodix_rst_low", "fpsensor_goodix_rst_high";
			status = "okay";
		};
	};

	fragment@25 {
		target = <0xffffffff>;

		__overlay__ {
			disable-hpb;
			disable-wb;
		};
	};

	fragment@26 {
		target = <0xffffffff>;

		__overlay__ {

			cam0@0 {
				phandle = <0x1f>;

				pins_cmd_dat {
					output-low;
					pinmux = <0x3600>;
					slew-rate = <0x1>;
				};
			};

			cam0@1 {
				phandle = <0x20>;

				pins_cmd_dat {
					output-high;
					pinmux = <0x3600>;
					slew-rate = <0x1>;
				};
			};

			cam1@0 {
				phandle = <0x21>;

				pins_cmd_dat {
					output-low;
					pinmux = <0x3c00>;
					slew-rate = <0x1>;
				};
			};

			cam1@1 {
				phandle = <0x22>;

				pins_cmd_dat {
					output-high;
					pinmux = <0x3c00>;
					slew-rate = <0x1>;
				};
			};

			cam2@0 {
				phandle = <0x23>;

				pins_cmd_dat {
					output-low;
					pinmux = <0x3a00>;
					slew-rate = <0x1>;
				};
			};

			cam2@1 {
				phandle = <0x24>;

				pins_cmd_dat {
					output-high;
					pinmux = <0x3a00>;
					slew-rate = <0x1>;
				};
			};

			cam4@0 {
				phandle = <0x25>;

				pins_cmd_dat {
					output-low;
					pinmux = <0x3800>;
					slew-rate = <0x1>;
				};
			};

			cam4@1 {
				phandle = <0x26>;

				pins_cmd_dat {
					output-high;
					pinmux = <0x3800>;
					slew-rate = <0x1>;
				};
			};

			camdefault {
				phandle = <0x1e>;
			};

			camera_pins_cam0_mclk_2ma {
				phandle = <0x28>;

				pins_cmd_dat {
					drive-strength = <0x0>;
					pinmux = <0x3101>;
				};
			};

			camera_pins_cam0_mclk_4ma {
				phandle = <0x29>;

				pins_cmd_dat {
					drive-strength = <0x1>;
					pinmux = <0x3101>;
				};
			};

			camera_pins_cam0_mclk_6ma {
				phandle = <0x2a>;

				pins_cmd_dat {
					drive-strength = <0x2>;
					pinmux = <0x3101>;
				};
			};

			camera_pins_cam0_mclk_8ma {
				phandle = <0x2b>;

				pins_cmd_dat {
					drive-strength = <0x3>;
					pinmux = <0x3101>;
				};
			};

			camera_pins_cam0_mclk_off {
				phandle = <0x27>;

				pins_cmd_dat {
					drive-strength = <0x1>;
					pinmux = <0x3100>;
				};
			};

			camera_pins_cam1_mclk_2ma {
				phandle = <0x2d>;

				pins_cmd_dat {
					drive-strength = <0x0>;
					pinmux = <0x3401>;
				};
			};

			camera_pins_cam1_mclk_4ma {
				phandle = <0x2e>;

				pins_cmd_dat {
					drive-strength = <0x1>;
					pinmux = <0x3401>;
				};
			};

			camera_pins_cam1_mclk_6ma {
				phandle = <0x2f>;

				pins_cmd_dat {
					drive-strength = <0x2>;
					pinmux = <0x3401>;
				};
			};

			camera_pins_cam1_mclk_8ma {
				phandle = <0x30>;

				pins_cmd_dat {
					drive-strength = <0x3>;
					pinmux = <0x3401>;
				};
			};

			camera_pins_cam1_mclk_off {
				phandle = <0x2c>;

				pins_cmd_dat {
					drive-strength = <0x1>;
					pinmux = <0x3400>;
				};
			};

			camera_pins_cam2_mclk_2ma {
				phandle = <0x32>;

				pins_cmd_dat {
					drive-strength = <0x0>;
					pinmux = <0x3301>;
				};
			};

			camera_pins_cam2_mclk_4ma {
				phandle = <0x33>;

				pins_cmd_dat {
					drive-strength = <0x1>;
					pinmux = <0x3301>;
				};
			};

			camera_pins_cam2_mclk_6ma {
				phandle = <0x34>;

				pins_cmd_dat {
					drive-strength = <0x2>;
					pinmux = <0x3301>;
				};
			};

			camera_pins_cam2_mclk_8ma {
				phandle = <0x35>;

				pins_cmd_dat {
					drive-strength = <0x3>;
					pinmux = <0x3301>;
				};
			};

			camera_pins_cam2_mclk_off {
				phandle = <0x31>;

				pins_cmd_dat {
					drive-strength = <0x1>;
					pinmux = <0x3300>;
				};
			};

			camera_pins_cam4_mclk_2ma {
				phandle = <0x37>;

				pins_cmd_dat {
					drive-strength = <0x0>;
					pinmux = <0x3201>;
				};
			};

			camera_pins_cam4_mclk_4ma {
				phandle = <0x38>;

				pins_cmd_dat {
					drive-strength = <0x1>;
					pinmux = <0x3201>;
				};
			};

			camera_pins_cam4_mclk_6ma {
				phandle = <0x39>;

				pins_cmd_dat {
					drive-strength = <0x2>;
					pinmux = <0x3201>;
				};
			};

			camera_pins_cam4_mclk_8ma {
				phandle = <0x3a>;

				pins_cmd_dat {
					drive-strength = <0x3>;
					pinmux = <0x3201>;
				};
			};

			camera_pins_cam4_mclk_off {
				phandle = <0x36>;

				pins_cmd_dat {
					drive-strength = <0x1>;
					pinmux = <0x3200>;
				};
			};

			ldo_vcamd2@0 {
				phandle = <0x3f>;

				pins_cmd_dat {
					output-low;
					pinmux = <0x5d00>;
					slew-rate = <0x1>;
				};
			};

			ldo_vcamd2@1 {
				phandle = <0x40>;

				pins_cmd_dat {
					output-high;
					pinmux = <0x5d00>;
					slew-rate = <0x1>;
				};
			};

			ldo_vcamd@0 {
				phandle = <0x3d>;

				pins_cmd_dat {
					output-low;
					pinmux = <0x5d00>;
					slew-rate = <0x1>;
				};
			};

			ldo_vcamd@1 {
				phandle = <0x3e>;

				pins_cmd_dat {
					output-high;
					pinmux = <0x5d00>;
					slew-rate = <0x1>;
				};
			};

			mipi_sel@0 {
				phandle = <0x3c>;

				pins_cmd_dat {
					output-low;
					pinmux = <0x2b00>;
					slew-rate = <0x1>;
				};
			};

			mipi_sel@1 {
				phandle = <0x3b>;

				pins_cmd_dat {
					output-high;
					pinmux = <0x2b00>;
					slew-rate = <0x1>;
				};
			};
		};
	};

	fragment@27 {
		target = <0xffffffff>;

		__overlay__ {
			cam0_vcama-supply = <0x42>;
			cam0_vcamd-supply = <0x41>;
			cam0_vcamio-supply = <0xffffffff>;
			cam1_vcama-supply = <0x43>;
			cam1_vcamd-supply = <0x44>;
			cam1_vcamio-supply = <0xffffffff>;
			cam2_vcama-supply = <0x43>;
			cam2_vcamd-supply = <0x44>;
			cam2_vcamio-supply = <0xffffffff>;
			cam4_vcama-supply = <0x43>;
			cam4_vcamio-supply = <0xffffffff>;
			pinctrl-0 = <0x1e>;
			pinctrl-1 = <0x1f>;
			pinctrl-10 = <0x28>;
			pinctrl-11 = <0x29>;
			pinctrl-12 = <0x2a>;
			pinctrl-13 = <0x2b>;
			pinctrl-14 = <0x2c>;
			pinctrl-15 = <0x2d>;
			pinctrl-16 = <0x2e>;
			pinctrl-17 = <0x2f>;
			pinctrl-18 = <0x30>;
			pinctrl-19 = <0x31>;
			pinctrl-2 = <0x20>;
			pinctrl-20 = <0x32>;
			pinctrl-21 = <0x33>;
			pinctrl-22 = <0x34>;
			pinctrl-23 = <0x35>;
			pinctrl-24 = <0x36>;
			pinctrl-25 = <0x37>;
			pinctrl-26 = <0x38>;
			pinctrl-27 = <0x39>;
			pinctrl-28 = <0x3a>;
			pinctrl-29 = <0x3b>;
			pinctrl-3 = <0x21>;
			pinctrl-30 = <0x3c>;
			pinctrl-31 = <0x3d>;
			pinctrl-32 = <0x3e>;
			pinctrl-33 = <0x3f>;
			pinctrl-34 = <0x40>;
			pinctrl-4 = <0x22>;
			pinctrl-5 = <0x23>;
			pinctrl-6 = <0x24>;
			pinctrl-7 = <0x25>;
			pinctrl-8 = <0x26>;
			pinctrl-9 = <0x27>;
			pinctrl-names = "default", "cam0_rst0", "cam0_rst1", "cam1_rst0", "cam1_rst1", "cam2_rst0", "cam2_rst1", "cam4_rst0", "cam4_rst1", "cam0_mclk_off", "cam0_mclk_2mA", "cam0_mclk_4mA", "cam0_mclk_6mA", "cam0_mclk_8mA", "cam1_mclk_off", "cam1_mclk_2mA", "cam1_mclk_4mA", "cam1_mclk_6mA", "cam1_mclk_8mA", "cam2_mclk_off", "cam2_mclk_2mA", "cam2_mclk_4mA", "cam2_mclk_6mA", "cam2_mclk_8mA", "cam4_mclk_off", "cam4_mclk_2mA", "cam4_mclk_4mA", "cam4_mclk_6mA", "cam4_mclk_8mA", "cam_mipi_switch_sel_1", "cam_mipi_switch_sel_0", "cam1_ldo_vcamd_0", "cam1_ldo_vcamd_1", "cam2_ldo_vcamd_0", "cam2_ldo_vcamd_1";
			status = "okay";
		};
	};

	fragment@28 {
		target = <0xffffffff>;

		__overlay__ {
			cam0_enable_sensor = "s5kjn1sunny_mipi_raw ov50c40ofilm_mipi_raw";
			cam1_enable_sensor = "ov16a1qofilm_mipi_raw ov16a1qqtech_mipi_raw";
			cam2_enable_sensor = "imx355ofilm_mipi_raw imx355sunny_mipi_raw";
			cam3_enable_sensor = [00];
			cam4_enable_sensor = [00];
		};
	};

	fragment@29 {
		target = <0xffffffff>;

		__overlay__ {

			camera_eeprom0@50 {
				compatible = "mediatek,camera_eeprom";
				phandle = <0x56>;
				reg = <0x50>;
				status = "okay";
			};
		};
	};

	fragment@3 {
		target = <0xffffffff>;

		__overlay__ {
			pwr_off_seq = <0x4000002>;
		};
	};

	fragment@30 {
		target = <0xffffffff>;

		__overlay__ {

			camera_eeprom1@51 {
				compatible = "mediatek,camera_eeprom";
				phandle = <0x57>;
				reg = <0x51>;
				status = "okay";
			};

			camera_eeprom2@50 {
				compatible = "mediatek,camera_eeprom";
				phandle = <0x58>;
				reg = <0x50>;
				status = "okay";
			};
		};
	};

	fragment@31 {
		target = <0xffffffff>;

		__overlay__ {

			camera_eeprom4@51 {
				compatible = "mediatek,camera_eeprom";
				phandle = <0x59>;
				reg = <0x51>;
				status = "okay";
			};
		};
	};

	fragment@32 {
		target = <0xffffffff>;

		__overlay__ {

			wl2866d@28 {
				compatible = "xiaomi,wl2866d";
				en-gpio = <0xffffffff 0x3b 0x0>;
				phandle = <0x5a>;
				reg = <0x28>;

				wl2866d_avdd1@2 {
					init-voltage = <0x2ab980>;
					iout_ua = <0x9eb10>;
					min-dropout-voltage = <0x15f90>;
					offset = [00 02];
					phandle = <0x42>;
					regulator-max-microvolt = <0x42f2ac>;
					regulator-min-microvolt = <0x124f80>;
					regulator-name = "wl2866d_avdd1";
				};

				wl2866d_avdd2@3 {
					init-voltage = <0x2ab980>;
					iout_ua = <0x9eb10>;
					min-dropout-voltage = <0x15f90>;
					offset = [00 03];
					phandle = <0x43>;
					regulator-max-microvolt = <0x42f2ac>;
					regulator-min-microvolt = <0x124f80>;
					regulator-name = "wl2866d_avdd2";
				};

				wl2866d_dvdd1@0 {
					init-voltage = <0x124f80>;
					iout_ua = <0x9eb10>;
					min-dropout-voltage = <0x13880>;
					offset = [00 00];
					phandle = <0x41>;
					regulator-max-microvolt = <0x208050>;
					regulator-min-microvolt = <0x927c0>;
					regulator-name = "wl2866d_dvdd1";
				};

				wl2866d_dvdd2@1 {
					init-voltage = <0x100590>;
					iout_ua = <0x9eb10>;
					min-dropout-voltage = <0x11940>;
					offset = [00 01];
					phandle = <0x44>;
					regulator-max-microvolt = <0x208050>;
					regulator-min-microvolt = <0x927c0>;
					regulator-name = "wl2866d_dvdd2";
				};
			};
		};
	};

	fragment@33 {
		target = <0xffffffff>;

		__overlay__ {

			adc_channel@ {
				compatible = "mediatek,adc_channel";
				mediatek,adc_fdd_rf_params_dynamic_custom_ch = <0x2>;
				mediatek,temperature0 = <0x0>;
				mediatek,temperature1 = <0x1>;
				status = "okay";
			};
		};
	};

	fragment@34 {
		target = <0xffffffff>;

		__overlay__ {
			io-channels = <0xffffffff 0x2>;
		};
	};

	fragment@35 {
		target = <0xffffffff>;

		__overlay__ {
			mediatek,clkbuf-config = <0x2 0x1 0x1 0x2 0x0 0x0 0x1>;
			mediatek,clkbuf-controls-for-desense = <0x0 0x4 0x0 0x4 0x0 0x0 0x0>;
			mediatek,clkbuf-output-impedance = <0x6 0x4 0x4 0x4 0x0 0x0 0x4>;
			mediatek,clkbuf-quantity = <0x7>;
			status = "okay";
		};
	};

	fragment@36 {
		target = <0xffffffff>;

		__overlay__ {
			#address-cells = <0x1>;
			#size-cells = <0x0>;
			clock-frequency = <0x61a80>;
			mediatek,use-open-drain;
		};
	};

	fragment@37 {
		target = <0xffffffff>;

		__overlay__ {
			#address-cells = <0x1>;
			#size-cells = <0x0>;
			clock-frequency = <0x61a80>;
			mediatek,use-open-drain;
		};
	};

	fragment@38 {
		target = <0xffffffff>;

		__overlay__ {
			#address-cells = <0x1>;
			#size-cells = <0x0>;
			clock-frequency = <0x61a80>;
			mediatek,use-open-drain;

			camera_main@5a {
				compatible = "mediatek,camera_main";
				phandle = <0x5b>;
				reg = <0x5a>;
				status = "okay";
			};

			camera_main_af@18 {
				compatible = "mediatek,camera_main_af";
				phandle = <0x5c>;
				reg = <0x18>;
				status = "okay";
			};
		};
	};

	fragment@39 {
		target = <0xffffffff>;

		__overlay__ {
			#address-cells = <0x1>;
			#size-cells = <0x0>;
			clock-frequency = <0x61a80>;
			mediatek,use-open-drain;

			nfc@08 {
				compatible = "mediatek,nfc";
				phandle = <0x5d>;
				reg = <0x8>;
				status = "okay";
			};
		};
	};

	fragment@4 {
		target = <0xffffffff>;

		__overlay__ {
			mt6360pd,intr_gpio = <0xffffffff 0x9 0x0>;
			mt6360pd,intr_gpio_num = <0x9>;
		};
	};

	fragment@40 {
		target = <0xffffffff>;

		__overlay__ {
			#address-cells = <0x1>;
			#size-cells = <0x0>;
			clock-frequency = <0x61a80>;
			mediatek,use-open-drain;

			camera_main_two@2b {
				compatible = "mediatek,camera_main_two";
				phandle = <0x5e>;
				reg = <0x2b>;
				status = "okay";
			};

			camera_sub@12 {
				compatible = "mediatek,camera_sub";
				phandle = <0x5f>;
				reg = <0x12>;
				status = "okay";
			};
		};
	};

	fragment@41 {
		target = <0xffffffff>;

		__overlay__ {
			#address-cells = <0x1>;
			#size-cells = <0x0>;
			clock-frequency = <0x33e140>;
			mediatek,use-push-pull;

			subpmic@34 {
				compatible = "mediatek,subpmic";
				phandle = <0x60>;
				reg = <0x34>;
				status = "okay";
			};

			subpmic_ldo@64 {
				compatible = "mediatek,subpmic_ldo";
				phandle = <0x63>;
				reg = <0x64>;
				status = "okay";
			};

			subpmic_pmic@1a {
				compatible = "mediatek,subpmic_pmic";
				phandle = <0x62>;
				reg = <0x1a>;
				status = "okay";
			};

			usb_type_c@4e {
				compatible = "mediatek,usb_type_c";
				phandle = <0x61>;
				reg = <0x4e>;
				status = "okay";
			};
		};
	};

	fragment@42 {
		target = <0xffffffff>;

		__overlay__ {
			#address-cells = <0x1>;
			#size-cells = <0x0>;
			clock-frequency = <0x61a80>;
			mediatek,use-open-drain;

			i2c_lcd_bias@11 {
				compatible = "mediatek,i2c_lcd_bias";
				phandle = <0x64>;
				reg = <0x11>;
				status = "okay";
			};
		};
	};

	fragment@43 {
		target = <0xffffffff>;

		__overlay__ {
			#address-cells = <0x1>;
			#size-cells = <0x0>;
			clock-frequency = <0x61a80>;
			mediatek,use-open-drain;
		};
	};

	fragment@44 {
		target = <0xffffffff>;

		__overlay__ {
			#address-cells = <0x1>;
			#size-cells = <0x0>;
			clock-frequency = <0x61a80>;
			mediatek,use-open-drain;

			camera_main_three@7d {
				compatible = "mediatek,camera_main_three";
				phandle = <0x66>;
				reg = <0x7d>;
				status = "okay";
			};

			camera_sub_two@71 {
				compatible = "mediatek,camera_sub_two";
				phandle = <0x65>;
				reg = <0x71>;
				status = "okay";
			};
		};
	};

	fragment@45 {
		target = <0xffffffff>;

		__overlay__ {
			#address-cells = <0x1>;
			#size-cells = <0x0>;
			clock-frequency = <0x61a80>;
			mediatek,use-open-drain;
		};
	};

	fragment@46 {
		target = <0xffffffff>;

		__overlay__ {
			GPIO_FDD_BAND_SUPPORT_DETECT_1ST_PIN = <0xffffffff 0x2c 0x0>;
			GPIO_FDD_BAND_SUPPORT_DETECT_2ND_PIN = <0xffffffff 0x2d 0x0>;
			GPIO_FDD_BAND_SUPPORT_DETECT_3RD_PIN = <0xffffffff 0x2e 0x0>;
			GPIO_FDD_BAND_SUPPORT_DETECT_4TH_PIN = <0xffffffff 0x2f 0x0>;
			GPIO_FDD_BAND_SUPPORT_DETECT_5TH_PIN = <0xffffffff 0x30 0x0>;
			GPIO_RF_PWREN_RST_PIN = <0xffffffff 0xab 0x0>;
			GPIO_SIM1_HOT_PLUG = <0xffffffff 0x4d 0x0>;
			GPIO_SIM1_SCLK = <0xffffffff 0x7c 0x0>;
			GPIO_SIM1_SIO = <0xffffffff 0x7a 0x0>;
			GPIO_SIM1_SRST = <0xffffffff 0x7b 0x0>;
			GPIO_SIM2_HOT_PLUG = <0xffffffff 0x4e 0x0>;
			GPIO_SIM2_SCLK = <0xffffffff 0x77 0x0>;
			GPIO_SIM2_SIO = <0xffffffff 0x79 0x0>;
			GPIO_SIM2_SRST = <0xffffffff 0x78 0x0>;
		};
	};

	fragment@47 {
		target = <0xffffffff>;

		__overlay__ {
			gpio_init_default = <0x0 0x0 0x0 0x0 0x1 0x0 0x1 0x1 0x0 0x0 0x0 0x1 0x1 0x1 0x2 0x0 0x0 0x0 0x1 0x1 0x1 0x3 0x0 0x0 0x0 0x1 0x0 0x1 0x4 0x0 0x0 0x0 0x1 0x1 0x1 0x5 0x0 0x0 0x0 0x1 0x0 0x1 0x6 0x0 0x1 0x0 0x1 0x0 0x1 0x7 0x0 0x1 0x0 0x1 0x0 0x1 0x8 0x7 0x0 0x0 0x1 0x0 0x1 0x9 0x0 0x0 0x0 0x1 0x1 0x1 0xa 0x0 0x0 0x0 0x1 0x1 0x1 0xb 0x0 0x0 0x0 0x1 0x1 0x1 0xc 0x2 0x0 0x0 0x1 0x0 0x1 0xd 0x2 0x0 0x0 0x1 0x0 0x1 0xe 0x0 0x0 0x0 0x1 0x1 0x1 0xf 0x0 0x0 0x0 0x1 0x1 0x1 0x10 0x0 0x0 0x0 0x1 0x1 0x1 0x11 0x0 0x1 0x0 0x1 0x0 0x1 0x12 0x0 0x0 0x0 0x1 0x0 0x1 0x13 0x0 0x0 0x0 0x1 0x1 0x1 0x14 0x0 0x0 0x0 0x1 0x1 0x1 0x15 0x7 0x0 0x0 0x1 0x0 0x1 0x16 0x7 0x0 0x0 0x1 0x0 0x1 0x17 0x7 0x0 0x0 0x1 0x0 0x1 0x18 0x7 0x0 0x0 0x1 0x0 0x1 0x19 0x7 0x0 0x0 0x1 0x0 0x1 0x1a 0x7 0x0 0x0 0x1 0x0 0x1 0x1b 0x1 0x0 0x0 0x0 0x0 0x1 0x1c 0x1 0x0 0x0 0x0 0x0 0x1 0x1d 0x1 0x0 0x0 0x0 0x0 0x1 0x1e 0x1 0x0 0x0 0x1 0x0 0x1 0x1f 0x2 0x0 0x0 0x0 0x0 0x1 0x20 0x2 0x0 0x0 0x0 0x0 0x1 0x21 0x2 0x0 0x0 0x0 0x0 0x1 0x22 0x2 0x0 0x0 0x1 0x0 0x1 0x23 0x1 0x0 0x0 0x0 0x0 0x1 0x24 0x1 0x0 0x0 0x0 0x0 0x1 0x25 0x1 0x0 0x0 0x0 0x0 0x1 0x26 0x1 0x0 0x0 0x1 0x0 0x1 0x27 0x0 0x0 0x0 0x1 0x1 0x1 0x28 0x1 0x0 0x0 0x0 0x0 0x1 0x29 0x1 0x0 0x0 0x0 0x0 0x1 0x2a 0x1 0x0 0x0 0x1 0x0 0x0 0x2b 0x0 0x1 0x0 0x1 0x0 0x0 0x2c 0x0 0x0 0x0 0x1 0x1 0x1 0x2d 0x0 0x0 0x0 0x1 0x1 0x1 0x2e 0x0 0x0 0x0 0x1 0x1 0x1 0x2f 0x0 0x0 0x0 0x1 0x1 0x1 0x30 0x0 0x0 0x0 0x1 0x1 0x1 0x31 0x1 0x0 0x0 0x0 0x0 0x1 0x32 0x1 0x0 0x0 0x0 0x0 0x1 0x33 0x1 0x0 0x0 0x0 0x0 0x1 0x34 0x1 0x0 0x0 0x0 0x0 0x1 0x35 0x0 0x1 0x0 0x1 0x0 0x1 0x36 0x0 0x1 0x0 0x1 0x0 0x1 0x37 0x0 0x1 0x0 0x1 0x0 0x1 0x38 0x0 0x1 0x0 0x1 0x0 0x1 0x39 0x0 0x0 0x0 0x1 0x0 0x1 0x3a 0x0 0x1 0x0 0x1 0x0 0x1 0x3b 0x0 0x1 0x0 0x1 0x0 0x0 0x3c 0x0 0x1 0x0 0x1 0x0 0x1 0x3d 0x1 0x0 0x0 0x1 0x1 0x1 0x3e 0x1 0x0 0x0 0x0 0x0 0x1 0x3f 0x1 0x0 0x0 0x1 0x1 0x1 0x40 0x1 0x0 0x0 0x0 0x0 0x1 0x4d 0x1 0x0 0x0 0x1 0x1 0x1 0x4e 0x1 0x0 0x0 0x1 0x1 0x1 0x4f 0x1 0x0 0x0 0x1 0x1 0x1 0x50 0x0 0x1 0x0 0x1 0x0 0x1 0x51 0x3 0x0 0x0 0x1 0x0 0x1 0x52 0x0 0x1 0x0 0x1 0x0 0x1 0x53 0x1 0x0 0x0 0x0 0x0 0x1 0x54 0x1 0x0 0x0 0x1 0x0 0x1 0x55 0x1 0x0 0x0 0x0 0x0 0x1 0x56 0x1 0x0 0x0 0x0 0x0 0x1 0x57 0x0 0x1 0x1 0x1 0x0 0x0 0x58 0x0 0x0 0x0 0x1 0x0 0x1 0x59 0x0 0x0 0x0 0x1 0x0 0x1 0x5a 0x1 0x0 0x0 0x0 0x0 0x1 0x5b 0x0 0x0 0x0 0x1 0x0 0x1 0x5c 0x0 0x1 0x0 0x1 0x0 0x1 0x5d 0x0 0x1 0x0 0x1 0x0 0x1 0x5e 0x0 0x1 0x0 0x1 0x0 0x1 0x5f 0x1 0x0 0x0 0x1 0x0 0x0 0x60 0x1 0x0 0x0 0x1 0x0 0x0 0x61 0x1 0x0 0x0 0x1 0x1 0x1 0x62 0x1 0x0 0x0 0x1 0x1 0x1 0x63 0x2 0x0 0x0 0x1 0x1 0x1 0x64 0x2 0x0 0x0 0x1 0x1 0x1 0x65 0x1 0x0 0x0 0x1 0x1 0x1 0x66 0x1 0x0 0x0 0x1 0x1 0x1 0x67 0x1 0x0 0x0 0x1 0x1 0x1 0x68 0x1 0x0 0x0 0x1 0x1 0x1 0x69 0x1 0x0 0x0 0x1 0x1 0x1 0x6a 0x1 0x0 0x0 0x1 0x1 0x1 0x6b 0x1 0x0 0x0 0x1 0x1 0x1 0x6c 0x1 0x0 0x0 0x1 0x1 0x1 0x6d 0x1 0x0 0x0 0x1 0x1 0x1 0x6e 0x1 0x0 0x0 0x1 0x1 0x1 0x6f 0x7 0x0 0x0 0x1 0x0 0x1 0x70 0x5 0x0 0x0 0x1 0x0 0x1 0x71 0x1 0x0 0x0 0x1 0x1 0x1 0x72 0x1 0x0 0x0 0x1 0x1 0x1 0x73 0x1 0x0 0x0 0x1 0x0 0x1 0x74 0x1 0x0 0x0 0x1 0x0 0x1 0x75 0x0 0x0 0x0 0x1 0x0 0x1 0x76 0x0 0x0 0x0 0x1 0x0 0x1 0x77 0x1 0x0 0x0 0x0 0x0 0x1 0x78 0x1 0x0 0x0 0x0 0x0 0x1 0x79 0x1 0x0 0x0 0x1 0x1 0x1 0x7a 0x1 0x0 0x0 0x1 0x1 0x1 0x7b 0x1 0x0 0x0 0x0 0x0 0x1 0x7c 0x1 0x0 0x0 0x0 0x0 0x1 0x7d 0x1 0x0 0x0 0x0 0x0 0x1 0x7e 0x1 0x0 0x0 0x1 0x1 0x1 0x7f 0x1 0x0 0x0 0x1 0x1 0x1 0x80 0x1 0x0 0x0 0x1 0x1 0x1 0x81 0x1 0x0 0x0 0x1 0x1 0x1 0x82 0x1 0x0 0x0 0x1 0x1 0x1 0x83 0x0 0x1 0x1 0x1 0x0 0x1 0x84 0x0 0x1 0x0 0x1 0x0 0x1 0x85 0x0 0x1 0x0 0x1 0x0 0x1 0x86 0x0 0x1 0x0 0x1 0x0 0x1 0x87 0x0 0x1 0x0 0x1 0x0 0x1 0x88 0x0 0x1 0x1 0x1 0x0 0x1 0x89 0x0 0x1 0x0 0x1 0x0 0x1 0x8a 0x0 0x1 0x0 0x1 0x0 0x1 0x8b 0x1 0x0 0x0 0x1 0x0 0x1 0x8c 0x1 0x0 0x0 0x1 0x0 0x1 0x8d 0x1 0x0 0x0 0x1 0x1 0x1 0x8e 0x1 0x0 0x0 0x1 0x1 0x1 0x8f 0x1 0x0 0x0 0x0 0x0 0x1 0x90 0x1 0x0 0x0 0x0 0x0 0x1 0x91 0x1 0x0 0x0 0x0 0x0 0x1 0x92 0x1 0x0 0x0 0x0 0x0 0x1 0x93 0x1 0x0 0x0 0x0 0x0 0x1 0x94 0x1 0x0 0x0 0x0 0x0 0x1 0x95 0x1 0x0 0x0 0x1 0x0 0x1 0x96 0x1 0x0 0x0 0x1 0x0 0x1 0x97 0x1 0x0 0x0 0x1 0x0 0x1 0x98 0x1 0x0 0x0 0x1 0x0 0x1 0x99 0x1 0x0 0x0 0x0 0x0 0x1 0x9a 0x1 0x0 0x0 0x0 0x0 0x1 0x9b 0x1 0x0 0x0 0x0 0x0 0x1 0x9c 0x1 0x0 0x0 0x0 0x0 0x1 0x9d 0x1 0x0 0x0 0x0 0x0 0x1 0x9e 0x1 0x0 0x0 0x0 0x0 0x1 0x9f 0x1 0x0 0x0 0x1 0x0 0x1 0xa0 0x1 0x0 0x0 0x1 0x0 0x1 0xa1 0x1 0x0 0x0 0x1 0x0 0x1 0xa2 0x1 0x0 0x0 0x0 0x0 0x0 0xa3 0x1 0x0 0x0 0x1 0x0 0x0 0xa4 0x1 0x0 0x0 0x1 0x0 0x1 0xa5 0x1 0x0 0x0 0x1 0x0 0x1 0xa6 0x1 0x0 0x0 0x0 0x0 0x1 0xa7 0x1 0x0 0x0 0x0 0x0 0x1 0xa8 0x1 0x0 0x0 0x0 0x0 0x1 0xa9 0x1 0x0 0x0 0x0 0x0 0x1 0xaa 0x1 0x0 0x0 0x0 0x0 0x1 0xab 0x0 0x1 0x1 0x1 0x0 0x1 0xac 0x1 0x0 0x0 0x0 0x0 0x1 0xad 0x1 0x0 0x0 0x0 0x0 0x1 0xae 0x1 0x0 0x0 0x0 0x0 0x1 0xaf 0x1 0x0 0x0 0x0 0x0 0x1 0xb0 0x1 0x0 0x0 0x0 0x0 0x1 0xb1 0x1 0x0 0x0 0x0 0x0 0x1 0xb2 0x1 0x0 0x0 0x0 0x0 0x1 0xb3 0x1 0x0 0x0 0x0 0x0 0x1 0xb4 0x1 0x0 0x0 0x0 0x0 0x1 0xb5 0x1 0x0 0x0 0x0 0x0 0x1 0xb6 0x1 0x0 0x0 0x0 0x0 0x1 0xb7 0x1 0x0 0x0 0x0 0x0 0x1 0xb8 0x1 0x0 0x0 0x0 0x0 0x1 0xb9 0x0 0x0 0x0 0x1 0x1 0x1 0xba 0x0 0x0 0x0 0x1 0x1 0x1 0xbb 0x0 0x0 0x0 0x1 0x1 0x1 0xbc 0x1 0x0 0x0 0x0 0x0 0x0 0xbd 0x1 0x0 0x0 0x1 0x0 0x0 0xbe 0x1 0x0 0x0 0x0 0x0 0x0 0xbf 0x1 0x0 0x0 0x1 0x0 0x0 0xc0 0x0 0x0 0x0 0x1 0x0 0x1 0xc1 0x0 0x0 0x0 0x1 0x0 0x1 0xc2 0x0 0x0 0x0 0x1 0x0 0x1 0xc3 0x0 0x0 0x0 0x1 0x0 0x1 0xc4 0x0 0x0 0x0 0x1 0x0 0x1 0xc5 0x0 0x0 0x0 0x1 0x0 0x1 0xc6 0x0 0x0 0x0 0x1 0x0 0x1 0xc7 0x0 0x0 0x0 0x1 0x0 0x1 0xc8 0x0 0x0 0x0 0x1 0x0 0x1>;
		};
	};

	fragment@48 {
		target = <0xffffffff>;

		__overlay__ {
			deb-gpios = <0xffffffff 0x1 0x0>;
			debounce = <0x7d000>;
			interrupt-parent = <0xffffffff>;
			interrupts = <0x1 0x8>;
			status = "okay";
		};
	};

	fragment@49 {
		target = <0xffffffff>;

		__overlay__ {
			deb-gpios = <0xffffffff 0x2 0x0>;
			debounce = <0x3e800>;
			interrupt-parent = <0xffffffff>;
			interrupts = <0x2 0x4>;
			status = "okay";
		};
	};

	fragment@5 {
		target = <0xffffffff>;

		__overlay__ {

			awinic_interrupt_high {
				phandle = <0x3>;

				pins_cmd_dat {
					bias-pull-up;
					drive-strength = <0x2>;
					input-enable;
					pinmux = <0x600>;
					slew-rate = <0x0>;
				};
			};

			awinic_reset_high {
				phandle = <0x2>;

				pins_cmd_dat {
					bias-disable;
					drive-strength = <0x2>;
					output-high;
					pinmux = <0x8400>;
					slew-rate = <0x1>;
				};
			};

			awinic_reset_low {
				phandle = <0x1>;

				pins_cmd_dat {
					bias-disable;
					drive-strength = <0x2>;
					output-low;
					pinmux = <0x8400>;
					slew-rate = <0x1>;
				};
			};
		};
	};

	fragment@50 {
		target = <0xffffffff>;

		__overlay__ {
			interrupt-parent = <0xffffffff>;
			interrupts = <0x4 0x1>;
			status = "okay";
		};
	};

	fragment@51 {
		target = <0xffffffff>;

		__overlay__ {
			interrupt-parent = <0xffffffff>;
			interrupts = <0x5 0x4>;
			status = "okay";
		};
	};

	fragment@52 {
		target = <0xffffffff>;

		__overlay__ {
			interrupt-parent = <0xffffffff>;
			interrupts = <0xa 0x2>;
			status = "okay";
		};
	};

	fragment@53 {
		target = <0xffffffff>;

		__overlay__ {
			interrupt-parent = <0xffffffff>;
			interrupts = <0xe 0x8>;
			status = "okay";
		};
	};

	fragment@54 {
		target = <0xffffffff>;

		__overlay__ {
			deb-gpios = <0xffffffff 0x10 0x0>;
			debounce = <0x3e800>;
			interrupt-parent = <0xffffffff>;
			interrupts = <0x10 0x4>;
			status = "okay";
		};
	};

	fragment@55 {
		target = <0xffffffff>;

		__overlay__ {
			deb-gpios = <0xffffffff 0x13 0x0>;
			debounce = <0x3e800>;
			interrupt-parent = <0xffffffff>;
			interrupts = <0x13 0x8>;
			status = "okay";
		};
	};

	fragment@56 {
		target = <0xffffffff>;

		__overlay__ {
			deb-gpios = <0xffffffff 0x14 0x0>;
			debounce = <0x3e800>;
			interrupt-parent = <0xffffffff>;
			interrupts = <0x14 0x8>;
			status = "okay";
		};
	};

	fragment@57 {
		target = <0xffffffff>;

		__overlay__ {
			interrupt-parent = <0xffffffff>;
			interrupts = <0x54 0x1>;
			status = "okay";
		};
	};

	fragment@58 {
		target = <0xffffffff>;

		__overlay__ {
			compatible = "mediatek,md1_sim1_hot_plug_eint-eint";
			debounce = <0x0 0xc350>;
			dedicated = <0x0 0x0>;
			interrupts = <0x0 0x8>;
			sockettype = <0x0 0x0>;
			src_pin = <0x0 0x1>;
			status = "okay";
		};
	};

	fragment@59 {
		target = <0xffffffff>;

		__overlay__ {
			regulator-default-on = <0x1>;
			regulator-name = "vcamio";
			status = "okay";
		};
	};

	fragment@6 {
		target = <0xffffffff>;

		__overlay__ {
			status = "ok";

			aw8697_haptic@5a {
				aw86907_vib_brk_bst_md = <0x0>;
				aw86907_vib_bst_vol_default = <0x16>;
				aw86907_vib_bst_vol_ram = <0x16>;
				aw86907_vib_bst_vol_rtp = <0x15>;
				aw86907_vib_bstcfg = <0x20 0x24 0x96 0x40 0x11>;
				aw86907_vib_cont_bemf_set = <0x2>;
				aw86907_vib_cont_brk_gain = <0x8>;
				aw86907_vib_cont_brk_time = <0x8>;
				aw86907_vib_cont_bst_brk_gain = <0x5>;
				aw86907_vib_cont_drv1_lvl = <0x7f>;
				aw86907_vib_cont_drv1_time = <0x4>;
				aw86907_vib_cont_drv2_lvl = <0x36>;
				aw86907_vib_cont_drv2_time = <0x14>;
				aw86907_vib_cont_drv_width = <0x6a>;
				aw86907_vib_cont_track_margin = <0x12>;
				aw86907_vib_cont_tset = <0x6>;
				aw86907_vib_cont_wait_num = <0x6>;
				aw86907_vib_d2s_gain = <0x4>;
				aw86907_vib_f0_cali_percent = <0x7>;
				aw86907_vib_f0_ref = <0x6a4>;
				aw86907_vib_mode = <0x0>;
				aw86907_vib_prctmode = <0x2d 0x3e 0x3f>;
				aw86907_vib_sine_array = <0x5 0xb2 0xff 0xef>;
				aw86907_vib_trig_config = <0x0 0x0 0x0 0x1 0x0 0x2 0x0 0x0 0x0 0x0 0x0 0x1 0x0 0x2 0x0 0x0 0x0 0x0 0x0 0x1 0x0 0x2 0x0 0x0>;
				aw86927_vib_brk_bst_md = <0x0>;
				aw86927_vib_bst_vol_default = <0x47>;
				aw86927_vib_bst_vol_ram = <0x47>;
				aw86927_vib_bst_vol_rtp = <0x47>;
				aw86927_vib_cont_bemf_set = <0x2>;
				aw86927_vib_cont_brk_gain = <0x8>;
				aw86927_vib_cont_brk_time = <0x8>;
				aw86927_vib_cont_bst_brk_gain = <0x5>;
				aw86927_vib_cont_drv1_lvl = <0x7f>;
				aw86927_vib_cont_drv1_time = <0x4>;
				aw86927_vib_cont_drv2_lvl = <0x36>;
				aw86927_vib_cont_drv2_time = <0x6>;
				aw86927_vib_cont_drv_width = <0x6a>;
				aw86927_vib_cont_track_margin = <0xc>;
				aw86927_vib_cont_tset = <0x6>;
				aw86927_vib_cont_wait_num = <0x6>;
				aw86927_vib_d2s_gain = <0x4>;
				aw86927_vib_f0_cali_percen = <0x7>;
				aw86927_vib_f0_pre = <0x6a4>;
				aw86927_vib_mode = <0x0>;
				aw86927_vib_trig_config = <0x0 0x0 0x0 0x1 0x0 0x2 0x0 0x0 0x0 0x0 0x0 0x1 0x0 0x2 0x0 0x0 0x0 0x0 0x0 0x1 0x0 0x2 0x0 0x0>;
				aw8697_vib_bemf_config = <0x10 0x8 0x3 0xf8>;
				aw8697_vib_bst_vol_default = <0x10>;
				aw8697_vib_bst_vol_ram = <0x11>;
				aw8697_vib_bst_vol_rtp = <0x10>;
				aw8697_vib_bstdbg = <0x30 0xeb 0xd4 0x0 0x0 0x0>;
				aw8697_vib_cont_drv_lev = <0x35>;
				aw8697_vib_cont_drv_lvl_ov = <0x35>;
				aw8697_vib_cont_num_brk = <0x3>;
				aw8697_vib_cont_td = <0x9a>;
				aw8697_vib_cont_zc_thr = <0xff1>;
				aw8697_vib_f0_cali_percen = <0x7>;
				aw8697_vib_f0_coeff = <0x104>;
				aw8697_vib_f0_pre = <0x6a4>;
				aw8697_vib_f0_trace_parameter = <0x5 0x3 0x2 0xf>;
				aw8697_vib_mode = <0x0>;
				aw8697_vib_r_spare = <0x68>;
				aw8697_vib_sw_brake = <0x2c>;
				aw8697_vib_trig_config = <0x0 0x1 0x0 0x1 0x2 0x0 0x1 0x0 0x1 0x2 0x0 0x1 0x0 0x1 0x2>;
				aw8697_vib_tset = <0x12>;
				compatible = "awinic,awinic_haptic";
				irq-gpio = <0xffffffff 0x6 0x0>;
				pinctrl-0 = <0x1>;
				pinctrl-1 = <0x2>;
				pinctrl-2 = <0x3>;
				pinctrl-names = "awinic_reset_low", "awinic_reset_high", "awinic_interrupt_high";
				reg = <0x5a>;
				reset-gpio = <0xffffffff 0x84 0x0>;
				status = "okay";
				vib_effect_id_boundary = <0xa>;
				vib_effect_max = <0xc5>;
				vib_rtp_time = <0x14 0x14 0x14 0x14 0x14 0x14 0x14 0x14 0x4e20 0x3a98 0x3a98 0x4e20 0x61a8 0x3a98 0x7530 0x61a8 0x4e20 0x4e20 0x4e20 0x4e20 0x4e20 0x4e20 0x4e20 0x4e20 0x4e20 0x4e20 0x4e20 0x4e20 0x4e20 0x4e20 0x4e20 0x4e20 0x4e20 0x4e20 0x4e20 0x4e20 0x4e20 0x4e20 0x4e20 0x4e20 0x4e20 0x4e20 0x4e20 0x4e20 0x4e20 0x4e20 0x4e20 0x4e20 0x4e20 0x4e20 0x4e20 0x4e20 0x4e20 0x4e20 0x4e20 0x4e20 0x4e20 0x4e20 0x4e20 0x4e20 0x4e20 0x4e20 0x4e20 0x4e20 0x4e20 0x4e20 0x4e20 0x4e20 0x4e20 0x4e20 0x4e20 0x4e20 0x4e20 0x4e20 0x4e20 0x4e20 0x4e20 0x4e20 0x4e20 0x4e20 0x4e20 0x4e20 0x4e20 0x4e20 0x4e20 0x4e20 0x4e20 0x4e20 0x4e20 0x4e20 0x4e20 0x4e20 0x4e20 0x4e20 0x4e20 0x4e20 0x4e20 0x4e20 0x4e20 0x4e20 0x4e20 0x4e20 0x4e20 0x4e20 0x4e20 0x4e20 0x4e20 0x4e20 0x4e20 0x4e20 0x4e20 0x4e20 0x4e20 0x4e20 0x4e20 0x4e20 0x4e20 0x4e20 0x4e20 0x4e20 0x4e20 0x4e20 0x4e20 0x4e20 0x4e20 0x4e20 0x4e20 0x4e20 0x4e20 0x4e20 0x4e20 0x4e20 0x4e20 0x4e20 0x4e20 0x4e20 0x4e20 0x4e20 0x4e20 0x4e20 0x4e20 0x4e20 0x4e20 0x4e20 0x4e20 0x4e20 0x4e20 0x4e20 0x4e20 0x4e20 0x4e20 0x4e20 0x4e20 0x4e20 0x4e20 0x4e20 0x4e20 0x4e20 0x4e20 0x4e20 0x4e20 0x4e20 0x4e20 0x4e20 0x4e20 0x4e20 0x4e20 0x4e20 0x4e20 0x4e20 0x4e20 0x4e20 0x4e20 0x4e20 0x4e20>;

				wf_0 {
					mtk,effect-id = <0x0>;
					mtk,wf-brake-pattern = <0x2010000>;
					mtk,wf-pattern = [3e 3e];
					mtk,wf-play-rate-us = <0x4e20>;
					mtk,wf-vmax-mv = <0xe10>;
				};

				wf_1 {
					mtk,effect-id = <0x1>;
					mtk,wf-brake-pattern = <0x3010000>;
					mtk,wf-pattern = [7e 3e];
					mtk,wf-play-rate-us = <0x4e20>;
					mtk,wf-vmax-mv = <0xe10>;
				};

				wf_2 {
					mtk,effect-id = <0x2>;
					mtk,wf-brake-pattern = <0x2010000>;
					mtk,wf-pattern = [7e 3e];
					mtk,wf-play-rate-us = <0x4e20>;
					mtk,wf-vmax-mv = <0xe10>;
				};

				wf_3 {
					mtk,effect-id = <0x3>;
					mtk,wf-brake-pattern = <0x2010000>;
					mtk,wf-pattern = [3e 3e];
					mtk,wf-play-rate-us = <0x4e20>;
					mtk,wf-vmax-mv = <0xe10>;
				};

				wf_4 {
					mtk,effect-id = <0x4>;
					mtk,wf-brake-pattern = <0x2010000>;
					mtk,wf-pattern = [3e 3e];
					mtk,wf-play-rate-us = <0x6d60>;
					mtk,wf-vmax-mv = <0xe10>;
				};

				wf_5 {
					mtk,effect-id = <0x5>;
					mtk,wf-brake-pattern = <0x3030100>;
					mtk,wf-pattern = [7e 7e 7e];
					mtk,wf-play-rate-us = <0x4e20>;
					mtk,wf-vmax-mv = <0xe10>;
				};

				wf_6 {
					mtk,effect-id = <0x6>;
					mtk,wf-brake-pattern = <0x2010000>;
					mtk,wf-pattern = [3e 3e];
					mtk,wf-play-rate-us = <0x4e20>;
					mtk,wf-vmax-mv = <0xe10>;
				};

				wf_7 {
					mtk,effect-id = <0x7>;
					mtk,wf-brake-pattern = <0x2010000>;
					mtk,wf-pattern = [3e 3e];
					mtk,wf-play-rate-us = <0x4e20>;
					mtk,wf-vmax-mv = <0xe10>;
				};

				wf_8 {
					mtk,effect-id = <0x8>;
					mtk,wf-brake-pattern = <0x2010000>;
					mtk,wf-pattern = [3e 3e];
					mtk,wf-play-rate-us = <0x4e20>;
					mtk,wf-vmax-mv = <0xe10>;
				};

				wf_9 {
					mtk,effect-id = <0x9>;
					mtk,wf-brake-pattern = <0x2010000>;
					mtk,wf-pattern = [3e 3e];
					mtk,wf-play-rate-us = <0x4e20>;
					mtk,wf-vmax-mv = <0xe10>;
				};
			};
		};
	};

	fragment@60 {
		target = <0xffffffff>;

		__overlay__ {
			regulator-default-on = <0x1>;
			regulator-name = "vtp";
			status = "okay";
		};
	};

	fragment@61 {
		target = <0xffffffff>;

		__overlay__ {
			status = "okay";
		};
	};

	fragment@62 {
		target = <0xffffffff>;

		__overlay__ {
			status = "okay";
			vtouch-supply = <0xffffffff>;
		};
	};

	fragment@63 {
		target = <0xffffffff>;

		__overlay__ {
			mediatek,kpd-hw-dl-key0 = <0x11>;
			mediatek,kpd-hw-dl-key1 = <0x0>;
			mediatek,kpd-hw-dl-key2 = <0x8>;
			mediatek,kpd-hw-factory-key = <0x0>;
			mediatek,kpd-hw-init-map = <0x72 0x0 0x0 0x0 0x0 0x0 0x0 0x0 0x0 0x0 0x0 0x0 0x0 0x0 0x0 0x0 0x0 0x0 0x0 0x0 0x0 0x0 0x0 0x0 0x0 0x0 0x0 0x0 0x0 0x0 0x0 0x0 0x0 0x0 0x0 0x0 0x0 0x0 0x0 0x0 0x0 0x0 0x0 0x0 0x0 0x0 0x0 0x0 0x0 0x0 0x0 0x0 0x0 0x0 0x0 0x0 0x0 0x0 0x0 0x0 0x0 0x0 0x0 0x0 0x0 0x0 0x0 0x0 0x0 0x0 0x0 0x0>;
			mediatek,kpd-hw-map-num = <0x48>;
			mediatek,kpd-hw-pwrkey = <0x8>;
			mediatek,kpd-hw-recovery-key = <0x11>;
			mediatek,kpd-hw-rstkey = <0x11>;
			mediatek,kpd-key-debounce = <0x400>;
			mediatek,kpd-pwkey-gpio-din = <0x0>;
			mediatek,kpd-pwrkey-eint-gpio = <0x0>;
			mediatek,kpd-sw-pwrkey = <0x74>;
			mediatek,kpd-sw-rstkey = <0x73>;
			mediatek,kpd-use-extend-type = <0x0>;
			status = "okay";
		};
	};

	fragment@64 {
		target = <0xffffffff>;

		__overlay__ {

			sia81xx_gpio_L {
				phandle = <0x45>;

				pins_cmd_dat {
					bias-disable;
					pinmux = <0x8300>;
					slew-rate = <0x1>;
				};
			};
		};
	};

	fragment@65 {
		target = <0xffffffff>;

		__overlay__ {

			sia81xx@L {
				channel_num = <0x1>;
				compatible = "si,sia8109";
				dynamic_updata_vdd_port = <0x2>;
				en_dynamic_updata_pvdd = <0x0>;
				en_dynamic_updata_vdd = <0x1>;
				en_x_filter = <0x0>;
				owi_mode = <0x1>;
				phandle = <0x47>;
				pinctrl-0 = <0x45>;
				pinctrl-names = "sia81xx_gpio";
				si,sia81xx_disable_pin = <0x0>;
				si,sia81xx_owi = <0xffffffff 0x83 0x0>;
				si,sia81xx_reset = <0xffffffff 0x83 0x0>;
				si,sia81xx_type = "sia81x9";
				timer_task_hdl = <0x0>;
			};

			sia81xx@R {
				channel_num = <0x0>;
				compatible = "si,sia8152";
				dynamic_updata_vdd_port = <0x2>;
				en_dynamic_updata_pvdd = <0x1>;
				en_dynamic_updata_vdd = <0x1>;
				en_x_filter = <0x0>;
				owi_mode = <0x1>;
				phandle = <0x46>;
				si,sia81xx_disable_pin = <0x1>;
				si,sia81xx_type = "sia8152";
				timer_task_hdl = <0x0>;
			};
		};
	};

	fragment@66 {
		target = <0xffffffff>;

		__overlay__ {
			si,sia81xx-aux-devs = <0x46 0x47>;
			si,sia81xx-aux-devs-prefix = "SpkrRight", "SpkrLeft";
			si,sia81xx-max-num = <0x2>;
		};
	};

	fragment@67 {
		target = <0xffffffff>;

		__overlay__ {
			#address-cells = <0x1>;
			#size-cells = <0x0>;
			clock-frequency = <0x61a80>;
			mediatek,use-open-drain;

			sia81xx_i2c@L {
				compatible = "si,sia8109-i2c";
				phandle = <0x68>;
				reg = <0x2a>;
				si,sia81xx-dev = <0x47>;
			};

			sia81xx_i2c@R {
				compatible = "si,sia8152-i2c";
				phandle = <0x67>;
				reg = <0x58>;
				si,sia81xx-dev = <0x46>;
			};
		};
	};

	fragment@68 {
		target = <0xffffffff>;

		__overlay__ {
			status = "okay";

			sc8551-charger@66 {
				compatible = "sc,sc8551-standalone";
				reg = <0x66>;
				sc,sc8551,ac-ovp-threshold = <0xe>;
				sc,sc8551,bat-ocp-alarm-threshold = <0x2648>;
				sc,sc8551,bat-ocp-threshold = <0x2710>;
				sc,sc8551,bat-ovp-alarm-threshold = <0x1162>;
				sc,sc8551,bat-ovp-threshold = <0x1194>;
				sc,sc8551,bat-therm-disable = <0x0>;
				sc,sc8551,bat-therm-threshold = <0x15>;
				sc,sc8551,bat-ucp-alarm-threshold = <0x7d0>;
				sc,sc8551,bus-ocp-alarm-threshold = <0xdac>;
				sc,sc8551,bus-ocp-threshold = <0xea6>;
				sc,sc8551,bus-ovp-alarm-threshold = <0x2af8>;
				sc,sc8551,bus-ovp-threshold = <0x2ee0>;
				sc,sc8551,bus-therm-disable = <0x0>;
				sc,sc8551,bus-therm-threshold = <0x15>;
				sc,sc8551,die-therm-threshold = <0x7d>;
				sc,sc8551,interrupt_gpios = <0xffffffff 0xb 0x0>;
				sc,sc8551,sense-resistor-mohm = <0x5>;
			};
		};
	};

	fragment@69 {
		target = <0xffffffff>;

		__overlay__ {
			status = "okay";

			ln8000_charger@51 {
				compatible = "lionsemi,ln8000";
				ln8000_charger,bat-ovp-alarm-threshold = <0x11ad>;
				ln8000_charger,bat-ovp-threshold = <0x11c6>;
				ln8000_charger,bus-ocp-alarm-threshold = <0xdac>;
				ln8000_charger,bus-ocp-threshold = <0xea6>;
				ln8000_charger,bus-ovp-alarm-threshold = <0x2af8>;
				ln8000_charger,bus-ovp-threshold = <0x3200>;
				ln8000_charger,iin-ocp-disable;
				ln8000_charger,iin-reg-disable;
				ln8000_charger,ntc-alarm-cfg = <0xe2>;
				ln8000_charger,tbat-mon-disable;
				ln8000_charger,tbus-mon-disable;
				ln8000_charger,tdie-prot-disable;
				ln8000_charger,tdie-reg-disable;
				ln8000_charger,vbat-reg-disable;
				reg = <0x51>;
			};
		};
	};

	fragment@7 {
		target = <0xffffffff>;

		__overlay__ {

			onewire_gpio_active@gpio53 {
				phandle = <0x4>;

				pins_cmd_dat {
					bias-disable;
					drive-strength = <0x4>;
					output-high;
					pinmux = <0x3500>;
					slew-rate = <0x1>;
				};
			};

			onewire_gpio_sleep@gpio53 {
				phandle = <0x5>;

				pins_cmd_dat {
					bias-disable;
					drive-strength = <0x4>;
					output-high;
					pinmux = <0x3500>;
					slew-rate = <0x1>;
				};
			};
		};
	};

	fragment@70 {
		target = <0xffffffff>;

		__overlay__ {
			pinctrl-0 = <0x48>;
			pinctrl-1 = <0x49>;
			pinctrl-names = "irtx_gpio_led_default", "irtx_gpio_led_set";
			status = "okay";
		};
	};

	fragment@71 {
		target = <0xffffffff>;

		__overlay__ {

			irtx_gpio_led_def@gpio139 {
				phandle = <0x48>;

				pins_cmd_dat {
					bias-disable;
					input-schmitt-enable = <0x0>;
					output-low;
					pinmux = <0x8b00>;
					slew-rate = <0x1>;
				};
			};

			irtx_gpio_led_set@gpio139 {
				phandle = <0x49>;

				pins_cmd_dat {
					output-high;
					pinmux = <0x8b01>;
					slew-rate = <0x1>;
				};
			};
		};
	};

	fragment@8 {
		target = <0xffffffff>;

		__overlay__ {
			compatible = "xiaomi,onewire_gpio";
			label = "xm_onewire";
			mi,onewire-gpio-din-addr = <0x10005210>;
			mi,onewire-gpio-dir-addr = <0x10005010>;
			mi,onewire-gpio-dir-clr-addr = <0x10005018>;
			mi,onewire-gpio-dir-set-addr = <0x10005014>;
			mi,onewire-gpio-dout-addr = <0x10005110>;
			mi,onewire-gpio-dout-clr-addr = <0x10005118>;
			mi,onewire-gpio-dout-set-addr = <0x10005114>;
			pinctrl-0 = <0x4>;
			pinctrl-1 = <0x5>;
			pinctrl-names = "onewire_active", "onewire_sleep";
			status = "okay";
			xiaomi,gpio_number = <0x35>;
			xiaomi,ow_gpio = <0xffffffff 0x35 0x0>;
			xiaomi,version = <0x1>;
		};
	};

	fragment@9 {
		target = <0xffffffff>;

		__overlay__ {
			compatible = "maxim,ds28e16";
			label = "max_ds28e16";
			maxim,version = <0x1>;
			status = "okay";
		};
	};
};
